/dts-v1/;

/ {
	model = "MT6765";
	compatible = "mediatek,MT6765";
	interrupt-parent = <0x01>;
	#address-cells = <0x02>;
	#size-cells = <0x02>;

	chosen {
		bootargs = "console=tty0 console=ttyS0,921600n1 vmalloc=400M slub_debug=OFZPU page_owner=on swiotlb=noforce androidboot.hardware=mt6765 maxcpus=8 loop.max_part=7 firmware_class.path=/vendor/firmware";
		kaslr-seed = <0x00 0x00>;
		linux,phandle = <0x4f>;
		phandle = <0x4f>;
	};

	cpus {
		#address-cells = <0x01>;
		#size-cells = <0x00>;

		cpu@000 {
			device_type = "cpu";
			compatible = "arm,cortex-a53";
			reg = <0x00>;
			enable-method = "psci";
			clock-frequency = <0x89267940>;
			cpu-idle-states = <0x02 0x03 0x04 0x05 0x06 0x07 0x08>;
			linux,phandle = <0x09>;
			phandle = <0x09>;
		};

		cpu@001 {
			device_type = "cpu";
			compatible = "arm,cortex-a53";
			reg = <0x01>;
			enable-method = "psci";
			clock-frequency = <0x89267940>;
			cpu-idle-states = <0x02 0x03 0x04 0x05 0x06 0x07 0x08>;
			linux,phandle = <0x0a>;
			phandle = <0x0a>;
		};

		cpu@002 {
			device_type = "cpu";
			compatible = "arm,cortex-a53";
			reg = <0x02>;
			enable-method = "psci";
			clock-frequency = <0x89267940>;
			cpu-idle-states = <0x02 0x03 0x04 0x05 0x06 0x07 0x08>;
			linux,phandle = <0x0b>;
			phandle = <0x0b>;
		};

		cpu@003 {
			device_type = "cpu";
			compatible = "arm,cortex-a53";
			reg = <0x03>;
			enable-method = "psci";
			clock-frequency = <0x89267940>;
			cpu-idle-states = <0x02 0x03 0x04 0x05 0x06 0x07 0x08>;
			linux,phandle = <0x0c>;
			phandle = <0x0c>;
		};

		cpu@100 {
			device_type = "cpu";
			compatible = "arm,cortex-a53";
			reg = <0x100>;
			enable-method = "psci";
			clock-frequency = <0x6b49d200>;
			cpu-idle-states = <0x02 0x03 0x04 0x05 0x06 0x07 0x08>;
			linux,phandle = <0x0d>;
			phandle = <0x0d>;
		};

		cpu@101 {
			device_type = "cpu";
			compatible = "arm,cortex-a53";
			reg = <0x101>;
			enable-method = "psci";
			clock-frequency = <0x6b49d200>;
			cpu-idle-states = <0x02 0x03 0x04 0x05 0x06 0x07 0x08>;
			linux,phandle = <0x0e>;
			phandle = <0x0e>;
		};

		cpu@102 {
			device_type = "cpu";
			compatible = "arm,cortex-a53";
			reg = <0x102>;
			enable-method = "psci";
			clock-frequency = <0x6b49d200>;
			cpu-idle-states = <0x02 0x03 0x04 0x05 0x06 0x07 0x08>;
			linux,phandle = <0x0f>;
			phandle = <0x0f>;
		};

		cpu@103 {
			device_type = "cpu";
			compatible = "arm,cortex-a53";
			reg = <0x103>;
			enable-method = "psci";
			clock-frequency = <0x6b49d200>;
			cpu-idle-states = <0x02 0x03 0x04 0x05 0x06 0x07 0x08>;
			linux,phandle = <0x10>;
			phandle = <0x10>;
		};

		cpu-map {

			cluster0 {

				core0 {
					cpu = <0x09>;
				};

				core1 {
					cpu = <0x0a>;
				};

				core2 {
					cpu = <0x0b>;
				};

				core3 {
					cpu = <0x0c>;
				};
			};

			cluster1 {

				core0 {
					cpu = <0x0d>;
				};

				core1 {
					cpu = <0x0e>;
				};

				core2 {
					cpu = <0x0f>;
				};

				core3 {
					cpu = <0x10>;
				};
			};
		};

		idle-states {
			entry-method = "arm,psci";

			standby {
				compatible = "arm,idle-state";
				arm,psci-suspend-param = <0x01>;
				entry-latency-us = <0x258>;
				exit-latency-us = <0x258>;
				min-residency-us = <0x4b0>;
				linux,phandle = <0x02>;
				phandle = <0x02>;
			};

			mcdi-cpu {
				compatible = "arm,idle-state";
				arm,psci-suspend-param = <0x10001>;
				entry-latency-us = <0x258>;
				exit-latency-us = <0x258>;
				min-residency-us = <0x4b0>;
				linux,phandle = <0x03>;
				phandle = <0x03>;
			};

			mcdi-cluster {
				compatible = "arm,idle-state";
				arm,psci-suspend-param = <0x1010001>;
				entry-latency-us = <0x258>;
				exit-latency-us = <0x258>;
				min-residency-us = <0x4b0>;
				linux,phandle = <0x04>;
				phandle = <0x04>;
			};

			sodi {
				compatible = "arm,idle-state";
				arm,psci-suspend-param = <0x1010002>;
				entry-latency-us = <0x320>;
				exit-latency-us = <0x3e8>;
				min-residency-us = <0x7d0>;
				linux,phandle = <0x05>;
				phandle = <0x05>;
			};

			sodi3 {
				compatible = "arm,idle-state";
				arm,psci-suspend-param = <0x1010003>;
				entry-latency-us = <0x320>;
				exit-latency-us = <0x3e8>;
				min-residency-us = <0x7d0>;
				linux,phandle = <0x06>;
				phandle = <0x06>;
			};

			dpidle {
				compatible = "arm,idle-state";
				arm,psci-suspend-param = <0x1010004>;
				entry-latency-us = <0x320>;
				exit-latency-us = <0x3e8>;
				min-residency-us = <0x7d0>;
				linux,phandle = <0x07>;
				phandle = <0x07>;
			};

			suspend {
				compatible = "arm,idle-state";
				arm,psci-suspend-param = <0x1010005>;
				entry-latency-us = <0x320>;
				exit-latency-us = <0x3e8>;
				min-residency-us = <0x7d0>;
				linux,phandle = <0x08>;
				phandle = <0x08>;
			};
		};
	};

	psci {
		compatible = "arm,psci-1.0";
		method = "smc";
	};

	pmu {
		compatible = "arm,armv8-pmuv3";
		interrupt-parent = <0x11>;
		interrupts = <0x01 0x07 0x08>;
	};

	l2c_parity {
		compatible = "mediatek,l2c_parity-v1";
		interrupts = <0x00 0x18 0x04 0x00 0x19 0x04>;
	};

	memory {
		device_type = "memory";
		reg = <0x00 0x40000000 0x00 0x20000000>;
	};

	reserved-memory {
		#address-cells = <0x02>;
		#size-cells = <0x02>;
		ranges;
		linux,phandle = <0x50>;
		phandle = <0x50>;

		ram_console-reserved-memory@47c80000 {
			compatible = "mediatek,ram_console";
			reg = <0x00 0x47c80000 0x00 0x10000>;
		};

		pstore-reserved-memory@47c90000 {
			compatible = "mediatek,pstore";
			reg = <0x00 0x47c90000 0x00 0xe0000>;
		};

		minirdump-reserved-memory@47d70000 {
			compatible = "mediatek,minirdump";
			reg = <0x00 0x47d70000 0x00 0x10000>;
		};

		zmc-default {
			compatible = "mediatek,zone_movable_cma";
			size = <0x00 0xffc00000>;
			alignment = <0x00 0x10000000>;
			alloc-ranges = <0x00 0xc0000000 0x01 0x80000000>;
		};

		reserve-memory-sspm_share {
			compatible = "mediatek,reserve-memory-sspm_share";
			no-map;
			status = "okay";
			size = <0x00 0x510000>;
			alignment = <0x00 0x10000>;
			alloc-ranges = <0x00 0x40000000 0x00 0x60000000>;
		};

		reserve-memory-scp_share {
			compatible = "mediatek,reserve-memory-scp_share";
			no-map;
			size = <0x00 0x300000>;
			alignment = <0x00 0x1000000>;
			alloc-ranges = <0x00 0x40000000 0x00 0x50000000>;
		};

		consys-reserve-memory {
			compatible = "mediatek,consys-reserve-memory";
			no-map;
			size = <0x00 0x400000>;
			alignment = <0x00 0x1000000>;
			alloc-ranges = <0x00 0x40000000 0x00 0x80000000>;
		};

		wifi-reserve-memory {
			compatible = "mediatek,wifi-reserve-memory";
			no-map;
			size = <0x00 0x300000>;
			alignment = <0x00 0x1000000>;
			alloc-ranges = <0x00 0x40000000 0x00 0x80000000>;
		};

		soter-shared-mem {
			compatible = "microtrust,shared_mem";
			no-map;
			size = <0x00 0x200000>;
			alloc-ranges = <0x00 0x40000000 0x00 0x50000000>;
		};
	};

	cpu_dbgapb@0d410000 {
		compatible = "mediatek,hw_dbg";
		num = <0x08>;
		reg = <0x00 0xd410000 0x00 0x1000 0x00 0xd510000 0x00 0x1000 0x00 0xd610000 0x00 0x1000 0x00 0xd710000 0x00 0x1000 0x00 0xd810000 0x00 0x1000 0x00 0xd910000 0x00 0x1000 0x00 0xda10000 0x00 0x1000 0x00 0xdb10000 0x00 0x1000>;
		linux,phandle = <0x51>;
		phandle = <0x51>;
	};

	atf_logger {
		compatible = "mediatek,atf_logger";
		interrupts = <0x00 0xf7 0x01>;
	};

	amms_control {
		compatible = "mediatek,amms";
		interrupts = <0x00 0x86 0x01>;
	};

	utos {
		compatible = "microtrust,utos";
		interrupts = <0x00 0xf9 0x01 0x00 0xfa 0x01>;
	};

	utos_tester {
		compatible = "microtrust,tester-v1";
	};

	tkcore {
		compatible = "trustkernel,tkcore";
		interrupts = <0x00 0xf8 0x01>;
	};

	plat_sram_flag@0011db00 {
		compatible = "mediatek,plat_sram_flag";
		reg = <0x00 0x10e5f0 0x00 0x10>;
	};

	interrupt-controller@0c000000 {
		compatible = "arm,gic-v3";
		#interrupt-cells = <0x03>;
		#address-cells = <0x02>;
		#size-cells = <0x02>;
		#redistributor-regions = <0x01>;
		interrupt-parent = <0x11>;
		interrupt-controller;
		reg = <0x00 0xc000000 0x00 0x40000 0x00 0xc100000 0x00 0x200000 0x00 0x10200a80 0x00 0x50>;
		interrupts = <0x01 0x09 0x04>;
		linux,phandle = <0x11>;
		phandle = <0x11>;
	};

	intpol-controller@10200a80 {
		compatible = "mediatek,mt6577-sysirq";
		interrupt-controller;
		#interrupt-cells = <0x03>;
		interrupt-parent = <0x11>;
		reg = <0x00 0x10200a80 0x00 0x50>;
		linux,phandle = <0x01>;
		phandle = <0x01>;
	};

	infracfg_ao@10001000 {
		compatible = "mediatek,infracfg_ao", "mediatek,mt6765-infracfg", "syscon";
		reg = <0x00 0x10001000 0x00 0x1000>;
		interrupts = <0x00 0x93 0x01>;
		#clock-cells = <0x01>;
		linux,phandle = <0x24>;
		phandle = <0x24>;
	};

	mcdi@0010fc00 {
		compatible = "mediatek,mt6765-mcdi";
		reg = <0x00 0x10fc00 0x00 0x800>;
	};

	scpsys@10001000 {
		compatible = "mediatek,scpsys", "mediatek,mt6765-scpsys", "syscon";
		reg = <0x00 0x10001000 0x00 0x1000 0x00 0x10006000 0x00 0x1000 0x00 0x14002000 0x00 0x1000 0x00 0x1020e000 0x00 0x1000 0x00 0x18004000 0x00 0x1000 0x00 0x18002000 0x00 0x1000>;
		#clock-cells = <0x01>;
		linux,phandle = <0x25>;
		phandle = <0x25>;
	};

	topckgen@10000000 {
		compatible = "mediatek,topckgen", "mediatek,mt6765-topckgen", "syscon";
		reg = <0x00 0x10000000 0x00 0x1000>;
		#clock-cells = <0x01>;
		linux,phandle = <0x1e>;
		phandle = <0x1e>;
	};

	io_cfg_lt@10002000 {
		compatible = "mediatek,io_cfg_lt";
		reg = <0x00 0x10002000 0x00 0x200>;
	};

	syscfg_pctl_1@0x10002000 {
		compatible = "mediatek,mt6765-pctl-1-syscfg", "syscon";
		reg = <0x00 0x10002000 0x00 0x1000>;
		linux,phandle = <0x13>;
		phandle = <0x13>;
	};

	io_cfg_lm@10002200 {
		compatible = "mediatek,io_cfg_lm";
		reg = <0x00 0x10002200 0x00 0x200>;
	};

	syscfg_pctl_2@0x10002200 {
		compatible = "mediatek,mt6765-pctl-2-syscfg", "syscon";
		reg = <0x00 0x10002200 0x00 0x1000>;
		linux,phandle = <0x14>;
		phandle = <0x14>;
	};

	io_cfg_lb@10002400 {
		compatible = "mediatek,io_cfg_lb";
		reg = <0x00 0x10002400 0x00 0x200>;
	};

	syscfg_pctl_3@0x10002400 {
		compatible = "mediatek,mt6765-pctl-3-syscfg", "syscon";
		reg = <0x00 0x10002400 0x00 0x1000>;
		linux,phandle = <0x15>;
		phandle = <0x15>;
	};

	io_cfg_bl@10002600 {
		compatible = "mediatek,io_cfg_bl";
		reg = <0x00 0x10002600 0x00 0x200>;
	};

	syscfg_pctl_4@0x10002600 {
		compatible = "mediatek,mt6765-pctl-4-syscfg", "syscon";
		reg = <0x00 0x10002600 0x00 0x1000>;
		linux,phandle = <0x16>;
		phandle = <0x16>;
	};

	io_cfg_rr@10002800 {
		compatible = "mediatek,io_cfg_rr";
		reg = <0x00 0x10002800 0x00 0x200>;
	};

	syscfg_pctl_5@0x10002800 {
		compatible = "mediatek,mt6765-pctl-5-syscfg", "syscon";
		reg = <0x00 0x10002800 0x00 0x1000>;
		linux,phandle = <0x17>;
		phandle = <0x17>;
	};

	io_cfg_rb@10002a00 {
		compatible = "mediatek,io_cfg_rb";
		reg = <0x00 0x10002a00 0x00 0x200>;
	};

	syscfg_pctl_6@0x10002a00 {
		compatible = "mediatek,mt6765-pctl-6-syscfg", "syscon";
		reg = <0x00 0x10002a00 0x00 0x1000>;
		linux,phandle = <0x18>;
		phandle = <0x18>;
	};

	io_cfg_rt@10002c00 {
		compatible = "mediatek,io_cfg_rt";
		reg = <0x00 0x10002c00 0x00 0x200>;
	};

	syscfg_pctl_7@0x10002c00 {
		compatible = "mediatek,mt6765-pctl-7-syscfg", "syscon";
		reg = <0x00 0x10002c00 0x00 0x1000>;
		linux,phandle = <0x19>;
		phandle = <0x19>;
	};

	pericfg@10003000 {
		compatible = "mediatek,pericfg", "syscon";
		reg = <0x00 0x10003000 0x00 0x1000>;
		#clock-cells = <0x01>;
		linux,phandle = <0x52>;
		phandle = <0x52>;
	};

	efuse_dbg@10004000 {
		compatible = "mediatek,efuse_dbg";
		reg = <0x00 0x10004000 0x00 0x1000>;
	};

	gpio {
		compatible = "mediatek,gpio_usage_mapping";
		linux,phandle = <0x53>;
		phandle = <0x53>;
	};

	gpio@10005000 {
		compatible = "mediatek,gpio";
		reg = <0x00 0x10005000 0x00 0x1000>;
		linux,phandle = <0x54>;
		phandle = <0x54>;
	};

	syscfg_pctl_0@10005000 {
		compatible = "mediatek,mt6765-pctl-0-syscfg", "syscon";
		reg = <0x00 0x10005000 0x00 0x1000>;
		linux,phandle = <0x12>;
		phandle = <0x12>;
	};

	eint@1000b000 {
		compatible = "mediatek,eint";
		reg = <0x00 0x1000b000 0x00 0x1000>;
	};

	pinctrl@1000b000 {
		compatible = "mediatek,mt6765-pinctrl";
		reg = <0x00 0x1000b000 0x00 0x1000>;
		mediatek,pctl-regmap = <0x12 0x13 0x14 0x15 0x16 0x17 0x18 0x19>;
		reg_bases = <0x12 0x13 0x14 0x15 0x16 0x17 0x18 0x19>;
		pins-are-numbered;
		gpio-controller;
		#gpio-cells = <0x02>;
		interrupt-controller;
		#interrupt-cells = <0x04>;
		interrupts = <0x00 0xab 0x04>;
		linux,phandle = <0x3c>;
		phandle = <0x3c>;

		msdc0@default {
			linux,phandle = <0x32>;
			phandle = <0x32>;

			pins_cmd {
				drive-strength = [03];
			};

			pins_dat {
				drive-strength = [03];
			};

			pins_clk {
				drive-strength = [03];
			};

			pins_rst {
				drive-strength = [03];
			};

			pins_ds {
				drive-strength = [03];
			};
		};

		msdc0@hs400 {
			linux,phandle = <0x33>;
			phandle = <0x33>;

			pins_cmd {
				drive-strength = [03];
			};

			pins_dat {
				drive-strength = [04];
			};

			pins_clk {
				drive-strength = [04];
			};

			pins_rst {
				drive-strength = [03];
			};

			pins_ds {
				drive-strength = [04];
			};
		};

		msdc0@hs200 {
			linux,phandle = <0x34>;
			phandle = <0x34>;

			pins_cmd {
				drive-strength = [03];
			};

			pins_dat {
				drive-strength = [04];
			};

			pins_clk {
				drive-strength = [04];
			};

			pins_rst {
				drive-strength = [03];
			};

			pins_ds {
				drive-strength = [04];
			};
		};

		msdc0@register_default {
			cmd_edge = [00];
			rdata_edge = [00];
			wdata_edge = [00];
			linux,phandle = <0x35>;
			phandle = <0x35>;
		};

		msdc1@default {
			linux,phandle = <0x37>;
			phandle = <0x37>;

			pins_cmd {
				drive-strength = [03];
			};

			pins_dat {
				drive-strength = [03];
			};

			pins_clk {
				drive-strength = [03];
			};
		};

		msdc1@sdr104 {
			linux,phandle = <0x38>;
			phandle = <0x38>;

			pins_cmd {
				drive-strength = [03];
			};

			pins_dat {
				drive-strength = [03];
			};

			pins_clk {
				drive-strength = [03];
			};
		};

		msdc1@sdr50 {
			linux,phandle = <0x39>;
			phandle = <0x39>;

			pins_cmd {
				drive-strength = [03];
			};

			pins_dat {
				drive-strength = [03];
			};

			pins_clk {
				drive-strength = [03];
			};
		};

		msdc1@ddr50 {
			linux,phandle = <0x3a>;
			phandle = <0x3a>;

			pins_cmd {
				drive-strength = [03];
			};

			pins_dat {
				drive-strength = [03];
			};

			pins_clk {
				drive-strength = [03];
			};
		};

		msdc1@register_default {
			cmd_edge = [00];
			rdata_edge = [00];
			wdata_edge = [00];
			linux,phandle = <0x3b>;
			phandle = <0x3b>;
		};

		msdc3@default {
			linux,phandle = <0x55>;
			phandle = <0x55>;

			pins_cmd {
				drive-strength = [04];
			};

			pins_dat {
				drive-strength = [04];
			};

			pins_clk {
				drive-strength = [04];
			};
		};

		msdc3@register_default {
			cmd_edge = [01];
			rdata_edge = [01];
			wdata_edge = [01];
			linux,phandle = <0x56>;
			phandle = <0x56>;
		};
	};

	sleep@10006000 {
		compatible = "mediatek,sleep";
		reg = <0x00 0x10006000 0x00 0x1000>;
		interrupts = <0x00 0xb5 0x08>;
		wakeup-source = <0x1a 0x00 0x04 0x1b 0x01 0x20 0x1c 0x03 0x2000000>;
	};

	toprgu@10007000 {
		compatible = "mediatek,mt6765-toprgu";
		reg = <0x00 0x10007000 0x00 0x1000>;
		interrupts = <0x00 0x8b 0x00>;
	};

	chipid@08000000 {
		compatible = "mediatek,chipid";
		reg = <0x00 0x8000000 0x00 0x04 0x00 0x8000004 0x00 0x04 0x00 0x8000008 0x00 0x04 0x00 0x800000c 0x00 0x04>;
	};

	mobicore {
		compatible = "trustonic,mobicore";
		interrupts = <0x00 0x10f 0x01>;
	};

	timer {
		compatible = "arm,armv8-timer";
		interrupt-parent = <0x11>;
		interrupts = <0x01 0x0d 0x08 0x01 0x0e 0x08 0x01 0x0b 0x08 0x01 0x0a 0x08>;
		clock-frequency = <0xc65d40>;
	};

	clocks {

		clk26m {
			compatible = "fixed-clock";
			#clock-cells = <0x00>;
			clock-frequency = <0x18cba80>;
			linux,phandle = <0x1f>;
			phandle = <0x1f>;
		};

		clk32k {
			compatible = "fixed-clock";
			#clock-cells = <0x00>;
			clock-frequency = <0x7d00>;
			linux,phandle = <0x1d>;
			phandle = <0x1d>;
		};
	};

	apxgpt@10008000 {
		compatible = "mediatek,apxgpt";
		reg = <0x00 0x10008000 0x00 0x1000>;
		interrupts = <0x00 0xaa 0x08>;
		clocks = <0x1d>;
	};

	hacc@1000a000 {
		compatible = "mediatek,hacc";
		reg = <0x00 0x1000a000 0x00 0x1000>;
		interrupts = <0x00 0xbd 0x08>;
	};

	apmixed@1000c000 {
		compatible = "mediatek,apmixed", "mediatek,mt6765-apmixedsys", "syscon";
		reg = <0x00 0x1000c000 0x00 0x1000>;
		#clock-cells = <0x01>;
		linux,phandle = <0x41>;
		phandle = <0x41>;
	};

	fhctl@1000ce00 {
		compatible = "mediatek,fhctl";
		reg = <0x00 0x1000ce00 0x00 0x200>;
	};

	pwrap@1000d000 {
		compatible = "mediatek,pwrap";
		reg = <0x00 0x1000d000 0x00 0x1000>;
		interrupts = <0x00 0xb3 0x04>;
	};

	mt-pmic {
		compatible = "mediatek,mt_pmic";
		interrupt-controller;
		linux,phandle = <0x57>;
		phandle = <0x57>;

		mt635x-auxadc {
			compatible = "mediatek,mt635x-auxadc";
			#io-channel-cells = <0x01>;
			linux,phandle = <0x58>;
			phandle = <0x58>;

			batadc {
				channel = <0x00>;
				resistance-ratio = <0x03 0x01>;
				avg-num = <0x80>;
			};

			isense {
				channel = <0x01>;
				resistance-ratio = <0x03 0x01>;
				avg-num = <0x80>;
			};

			vcdt {
				channel = <0x02>;
			};

			bat_temp {
				channel = <0x03>;
				resistance-ratio = <0x01 0x01>;
			};

			chip_temp {
				channel = <0x05>;
			};

			vcore_temp {
				channel = <0x06>;
			};

			vproc_temp {
				channel = <0x07>;
			};

			accdet {
				channel = <0x09>;
			};

			tsx_temp {
				channel = <0x0b>;
				avg-num = <0x80>;
			};

			hpofs_cal {
				channel = <0x0c>;
				avg-num = <0x100>;
			};

			dcxo_temp {
				channel = <0x0d>;
				avg-num = <0x10>;
			};

			vbif {
				channel = <0x0e>;
				resistance-ratio = <0x01 0x01>;
			};
		};

		buck_regulators {

			buck_vs1 {
				regulator-name = "vs1";
				regulator-min-microvolt = <0x124f80>;
				regulator-max-microvolt = <0x2191c0>;
				regulator-ramp-delay = <0x30d4>;
				regulator-enable-ramp-delay = <0xdc>;
				linux,phandle = <0x59>;
				phandle = <0x59>;
			};

			buck_vmodem {
				regulator-name = "vmodem";
				regulator-min-microvolt = <0x7a120>;
				regulator-max-microvolt = <0x123716>;
				regulator-ramp-delay = <0x186a>;
				regulator-enable-ramp-delay = <0xdc>;
				linux,phandle = <0x5a>;
				phandle = <0x5a>;
			};

			buck_vcore {
				regulator-name = "vcore";
				regulator-min-microvolt = <0x7ea5e>;
				regulator-max-microvolt = <0x1406f4>;
				regulator-ramp-delay = <0x186a>;
				regulator-enable-ramp-delay = <0xdc>;
				linux,phandle = <0x5b>;
				phandle = <0x5b>;
			};

			buck_vproc {
				regulator-name = "vproc";
				regulator-min-microvolt = <0x7ea5e>;
				regulator-max-microvolt = <0x1406f4>;
				regulator-ramp-delay = <0x186a>;
				regulator-enable-ramp-delay = <0xdc>;
				linux,phandle = <0x5c>;
				phandle = <0x5c>;
			};

			buck_vpa {
				regulator-name = "vpa";
				regulator-min-microvolt = <0x7a120>;
				regulator-max-microvolt = <0x37b1d0>;
				regulator-ramp-delay = <0xc350>;
				regulator-enable-ramp-delay = <0xdc>;
				linux,phandle = <0x5d>;
				phandle = <0x5d>;
			};
		};

		ldo_regulators {

			ldo_vfe28 {
				compatible = "regulator-fixed";
				regulator-name = "vfe28";
				regulator-min-microvolt = <0x2ab980>;
				regulator-max-microvolt = <0x2ab980>;
				regulator-enable-ramp-delay = <0x108>;
				linux,phandle = <0x5e>;
				phandle = <0x5e>;
			};

			ldo_vxo22 {
				regulator-name = "vxo22";
				regulator-min-microvolt = <0x2191c0>;
				regulator-max-microvolt = <0x249f00>;
				regulator-enable-ramp-delay = <0x6e>;
				linux,phandle = <0x5f>;
				phandle = <0x5f>;
			};

			ldo_vrf18 {
				compatible = "regulator-fixed";
				regulator-name = "vrf18";
				regulator-min-microvolt = <0x1b7740>;
				regulator-max-microvolt = <0x1b7740>;
				regulator-enable-ramp-delay = <0x6e>;
				linux,phandle = <0x60>;
				phandle = <0x60>;
			};

			ldo_vrf12 {
				compatible = "regulator-fixed";
				regulator-name = "vrf12";
				regulator-min-microvolt = <0x124f80>;
				regulator-max-microvolt = <0x124f80>;
				regulator-enable-ramp-delay = <0x6e>;
				linux,phandle = <0x61>;
				phandle = <0x61>;
			};

			ldo_vefuse {
				regulator-name = "vefuse";
				regulator-min-microvolt = <0x124f80>;
				regulator-max-microvolt = <0x325aa0>;
				regulator-enable-ramp-delay = <0x108>;
				linux,phandle = <0x62>;
				phandle = <0x62>;
			};

			ldo_vcn33_bt {
				regulator-name = "vcn33_bt";
				regulator-min-microvolt = <0x325aa0>;
				regulator-max-microvolt = <0x3567e0>;
				regulator-enable-ramp-delay = <0x108>;
				linux,phandle = <0x63>;
				phandle = <0x63>;
			};

			ldo_vcn33_wifi {
				regulator-name = "vcn33_wifi";
				regulator-min-microvolt = <0x325aa0>;
				regulator-max-microvolt = <0x3567e0>;
				regulator-enable-ramp-delay = <0x108>;
				linux,phandle = <0x64>;
				phandle = <0x64>;
			};

			ldo_vcn28 {
				compatible = "regulator-fixed";
				regulator-name = "vcn28";
				regulator-min-microvolt = <0x2ab980>;
				regulator-max-microvolt = <0x2ab980>;
				regulator-enable-ramp-delay = <0x108>;
				linux,phandle = <0x65>;
				phandle = <0x65>;
			};

			ldo_vcn18 {
				compatible = "regulator-fixed";
				regulator-name = "vcn18";
				regulator-min-microvolt = <0x1b7740>;
				regulator-max-microvolt = <0x1b7740>;
				regulator-enable-ramp-delay = <0x108>;
				linux,phandle = <0x66>;
				phandle = <0x66>;
			};

			ldo_vcama {
				regulator-name = "vcama";
				regulator-min-microvolt = <0x2625a0>;
				regulator-max-microvolt = <0x2ab980>;
				regulator-enable-ramp-delay = <0x108>;
				linux,phandle = <0x45>;
				phandle = <0x45>;
			};

			ldo_vcamd {
				regulator-name = "vcamd";
				regulator-min-microvolt = <0xf4240>;
				regulator-max-microvolt = <0x1b7740>;
				regulator-enable-ramp-delay = <0x108>;
				linux,phandle = <0x46>;
				phandle = <0x46>;
			};

			ldo_vcamio {
				compatible = "regulator-fixed";
				regulator-name = "vcamio";
				regulator-min-microvolt = <0x1b7740>;
				regulator-max-microvolt = <0x1b7740>;
				regulator-enable-ramp-delay = <0x108>;
				linux,phandle = <0x47>;
				phandle = <0x47>;
			};

			ldo_vldo28 {
				regulator-name = "vldo28";
				regulator-min-microvolt = <0x2ab980>;
				regulator-max-microvolt = <0x2dc6c0>;
				regulator-enable-ramp-delay = <0x108>;
				linux,phandle = <0x67>;
				phandle = <0x67>;
			};

			ldo_vsram_others {
				regulator-name = "vsram_others";
				regulator-min-microvolt = <0x7ea5e>;
				regulator-max-microvolt = <0x1406f4>;
				regulator-ramp-delay = <0x186a>;
				regulator-enable-ramp-delay = <0x6e>;
				linux,phandle = <0x68>;
				phandle = <0x68>;
			};

			ldo_vsram_proc {
				regulator-name = "vsram_proc";
				regulator-min-microvolt = <0x7ea5e>;
				regulator-max-microvolt = <0x1406f4>;
				regulator-ramp-delay = <0x186a>;
				regulator-enable-ramp-delay = <0x6e>;
				linux,phandle = <0x69>;
				phandle = <0x69>;
			};

			ldo_vaux18 {
				compatible = "regulator-fixed";
				regulator-name = "vaux18";
				regulator-min-microvolt = <0x1b7740>;
				regulator-max-microvolt = <0x1b7740>;
				regulator-enable-ramp-delay = <0x108>;
				linux,phandle = <0x6a>;
				phandle = <0x6a>;
			};

			ldo_vaud28 {
				compatible = "regulator-fixed";
				regulator-name = "vaud28";
				regulator-min-microvolt = <0x2ab980>;
				regulator-max-microvolt = <0x2ab980>;
				regulator-enable-ramp-delay = <0x108>;
				linux,phandle = <0x6b>;
				phandle = <0x6b>;
			};

			ldo_vio28 {
				compatible = "regulator-fixed";
				regulator-name = "vio28";
				regulator-min-microvolt = <0x2ab980>;
				regulator-max-microvolt = <0x2ab980>;
				regulator-enable-ramp-delay = <0x108>;
				linux,phandle = <0x6c>;
				phandle = <0x6c>;
			};

			ldo_vio18 {
				compatible = "regulator-fixed";
				regulator-name = "vio18";
				regulator-min-microvolt = <0x1b7740>;
				regulator-max-microvolt = <0x1b7740>;
				regulator-enable-ramp-delay = <0x108>;
				linux,phandle = <0x6d>;
				phandle = <0x6d>;
			};

			ldo_vdram {
				regulator-name = "vdram";
				regulator-min-microvolt = <0x10c8e0>;
				regulator-max-microvolt = <0x124f80>;
				regulator-enable-ramp-delay = <0xce4>;
				linux,phandle = <0x6e>;
				phandle = <0x6e>;
			};

			ldo_vmc {
				regulator-name = "vmc";
				regulator-min-microvolt = <0x1b7740>;
				regulator-max-microvolt = <0x325aa0>;
				regulator-enable-ramp-delay = <0x2c>;
				linux,phandle = <0x3e>;
				phandle = <0x3e>;
			};

			ldo_vmch {
				regulator-name = "vmch";
				regulator-min-microvolt = <0x2c4020>;
				regulator-max-microvolt = <0x325aa0>;
				regulator-enable-ramp-delay = <0x2c>;
				linux,phandle = <0x3d>;
				phandle = <0x3d>;
			};

			ldo_vemc {
				regulator-name = "vemc";
				regulator-min-microvolt = <0x2c4020>;
				regulator-max-microvolt = <0x325aa0>;
				regulator-enable-ramp-delay = <0x2c>;
				linux,phandle = <0x36>;
				phandle = <0x36>;
			};

			ldo_vsim1 {
				regulator-name = "vsim1";
				regulator-min-microvolt = <0x19f0a0>;
				regulator-max-microvolt = <0x2f4d60>;
				regulator-enable-ramp-delay = <0x108>;
				linux,phandle = <0x6f>;
				phandle = <0x6f>;
			};

			ldo_vsim2 {
				regulator-name = "vsim2";
				regulator-min-microvolt = <0x19f0a0>;
				regulator-max-microvolt = <0x2f4d60>;
				regulator-enable-ramp-delay = <0x108>;
				linux,phandle = <0x70>;
				phandle = <0x70>;
			};

			ldo_vibr {
				regulator-name = "vibr";
				regulator-min-microvolt = <0x124f80>;
				regulator-max-microvolt = <0x325aa0>;
				regulator-enable-ramp-delay = <0x2c>;
				linux,phandle = <0x71>;
				phandle = <0x71>;
			};

			ldo_vusb33 {
				regulator-name = "vusb33";
				regulator-min-microvolt = <0x2dc6c0>;
				regulator-max-microvolt = <0x2f4d60>;
				regulator-enable-ramp-delay = <0x108>;
				linux,phandle = <0x72>;
				phandle = <0x72>;
			};
		};
	};

	scp@10500000 {
		compatible = "mediatek,scp";
		status = "okay";
		reg = <0x00 0x10500000 0x00 0x40000 0x00 0x105c0000 0x00 0x3000 0x00 0x105c4000 0x00 0x1000 0x00 0x105d4000 0x00 0x6000>;
		interrupts = <0x00 0xc0 0x04>;
		core_1 = "enable";
		scp_sramSize = <0x40000>;
	};

	scp_dvfs {
		compatible = "mediatek,scp_dvfs";
		clocks = <0x1e 0x63 0x1f 0x1e 0x0e 0x1e 0x1a 0x1e 0x02 0x1e 0x17 0x1e 0x06 0x1e 0x19>;
		clock-names = "clk_mux", "clk_pll_0", "clk_pll_1", "clk_pll_2", "clk_pll_3", "clk_pll_4", "clk_pll_5", "clk_pll_6";
	};

	sleep_reg_md@1000f000 {
		compatible = "mediatek,sleep_reg_md";
		reg = <0x00 0x1000f000 0x00 0x1000>;
	};

	kp@10010000 {
		compatible = "mediatek,kp";
		reg = <0x00 0x10010000 0x00 0x1000>;
		interrupts = <0x00 0xb4 0x02>;
		linux,phandle = <0x1a>;
		phandle = <0x1a>;
	};

	otg_iddig {
		compatible = "mediatek,usb_iddig_bi_eint";
		linux,phandle = <0x73>;
		phandle = <0x73>;
	};

	mrdump_ext_rst {
		compatible = "mediatek, mrdump_ext_rst-eint";
		force_mode = "EINT";
		mode = "IRQ";
		status = "okay";
		linux,phandle = <0x74>;
		phandle = <0x74>;
	};

	touch {
		compatible = "mediatek,touch";
		linux,phandle = <0x75>;
		phandle = <0x75>;
	};

	accdet {
		compatible = "mediatek,pmic-accdet";
		linux,phandle = <0x76>;
		phandle = <0x76>;
	};

	fingerprint {
		compatible = "mediatek,fpc1022_irq", "mediatek,goodix-fp";
		linux,phandle = <0x77>;
		phandle = <0x77>;
	};

	mt6357_gauge {
		compatible = "mediatek,mt6357_gauge";
		gauge_name = "gauge";
		alias_name = "mt6357";
	};

	gauge_timer {
		compatible = "mediatek,gauge_timer_service";
	};

	battery {
		compatible = "mediatek,bat_gm30";
		DIFFERENCE_FULLOCV_ITH = <0xc8>;
		SHUTDOWN_1_TIME = <0x02>;
		KEEP_100_PERCENT = <0x02>;
		R_FG_VALUE = <0x0a>;
		EMBEDDED_SEL = <0x01>;
		PMIC_SHUTDOWN_CURRENT = <0x14>;
		FG_METER_RESISTANCE = <0x4b>;
		CAR_TUNE_VALUE = <0x65>;
		PMIC_MIN_VOL = <0x82dc>;
		POWERON_SYSTEM_IBOOT = <0x1f4>;
		SHUTDOWN_GAUGE0_VOLTAGE = <0x84d0>;
		TEMPERATURE_T0 = <0x32>;
		TEMPERATURE_T1 = <0x19>;
		TEMPERATURE_T2 = <0x0a>;
		TEMPERATURE_T3 = <0x00>;
		TEMPERATURE_T4 = <0xfffffff6>;
		g_FG_PSEUDO100_T0 = <0x62>;
		g_FG_PSEUDO100_T1 = <0x62>;
		g_FG_PSEUDO100_T2 = <0x5f>;
		g_FG_PSEUDO100_T3 = <0x5a>;
		g_FG_PSEUDO100_T4 = <0x50>;
		Q_MAX_SYS_VOLTAGE_BAT0 = <0xd16>;
		Q_MAX_SYS_VOLTAGE_BAT1 = <0xd16>;
		Q_MAX_SYS_VOLTAGE_BAT2 = <0xd16>;
		Q_MAX_SYS_VOLTAGE_BAT3 = <0xd16>;
		SHUTDOWN_GAUGE1_VBAT_EN = <0x00>;
		CHARGE_PSEUDO_FULL_LEVEL = <0x2328>;
		AGING_FACTOR_MIN = <0x4b>;
		DIFFERENCE_FGC_FGV_TH2 = <0x190>;
		DIFFERENCE_FGC_FGV_TH3 = <0xc8>;
		ZCV_SUSPEND_TIME = <0x06>;
		SLEEP_CURRENT_AVG = <0x64>;
		FG_TRACKING_CURRENT = <0x3a98>;
		UI_LOW_LIMIT_SOC0 = <0x190>;
		UI_LOW_LIMIT_VTH0 = <0x8aac>;
		UI_LOW_LIMIT_SOC1 = <0x190>;
		UI_LOW_LIMIT_VTH1 = <0x8aac>;
		UI_LOW_LIMIT_SOC2 = <0x12c>;
		UI_LOW_LIMIT_VTH2 = <0x88b8>;
		UI_LOW_LIMIT_SOC3 = <0x12c>;
		UI_LOW_LIMIT_VTH3 = <0x88b8>;
		g_Q_MAX = <0xb82 0xa98 0x9ba 0x7ad 0xaec 0xb23 0x9a4 0x7c0 0xa9e 0x980 0x906 0x79a 0x8fc 0x7c7 0x742 0x751 0x8fc 0x7a8 0x733 0x73b 0x8a3 0x674 0x5fd 0x605 0x899 0x66a 0x5f3 0x5fb 0x88f 0x660 0x5e9 0x5f1 0x885 0x656 0x5df 0x5e7 0x87b 0x64c 0x5d5 0x5dd>;
		g_Q_MAX_H_CURRENT = <0xa56 0x96c 0x88e 0x681 0x9c0 0x9f7 0x878 0x694 0x972 0x854 0x7da 0x66e 0x8fc 0x69b 0x616 0x625 0x8fc 0x67c 0x607 0x60f 0x8a2 0x672 0x5fd 0x605 0x898 0x668 0x5f3 0x5fb 0x88e 0x65e 0x5e9 0x5f1 0x884 0x654 0x5df 0x5e7 0x87a 0x64a 0x5d5 0x5dd>;
		g_PMIC_MIN_VOL = <0x81ec 0x8188 0x8188 0x8020 0x8340 0x8188 0x8188 0x8020 0x8764 0x8188 0x84d0 0x8214 0x7d46 0x7d00 0x84d0 0x80e8 0x7896 0x77ce 0x85fc 0x7148 0x7896 0x7896 0x7896 0x7896 0x7896 0x7896 0x7896 0x7896 0x7896 0x7896 0x7896 0x7896 0x7896 0x7896 0x7896 0x7896 0x7896 0x7896 0x7896 0x7896>;
		g_QMAX_SYS_VOL = <0x81b0 0x841e 0x841e 0x7fbc 0x83d6 0x841e 0x841e 0x802c 0x84d0 0x82a6 0x84d0 0x84d0 0x7e5e 0x80e8 0x846c 0x7be4 0x8020 0x80e8 0x7f58 0x7be4 0x8020 0x8020 0x8020 0x8020 0x8020 0x8020 0x8020 0x8020 0x8020 0x8020 0x8020 0x8020 0x8020 0x8020 0x8020 0x8020 0x8020 0x8020 0x8020 0x8020>;
		battery0_profile_t0_num = <0x64>;
		battery0_profile_t0 = <0x00 0xab2c 0x271 0x12c 0xaa9d 0x271 0x258 0xaa19 0x27c 0x384 0xa99f 0x28a 0x4b0 0xa92d 0x28a 0x5dc 0xa8bb 0x28a 0x708 0xa844 0x28a 0x834 0xa7c8 0x28a 0x960 0xa756 0x28a 0xa8c 0xa6df 0x28a 0xbb8 0xa665 0x285 0xce4 0xa5e8 0x273 0xe10 0xa575 0x281 0xf3c 0xa503 0x28a 0x1068 0xa490 0x28a 0x1194 0xa413 0x28a 0x12c0 0xa39e 0x28a 0x13ec 0xa32e 0x290 0x1518 0xa2c3 0x2a2 0x1644 0xa24f 0x2a3 0x1770 0xa1db 0x2a3 0x189c 0xa16a 0x2a6 0x19c8 0xa0ff 0x2b8 0x1af4 0xa08c 0x2ae 0x1c20 0xa01b 0x2a3 0x1d4c 0x9fb0 0x2a3 0x1e78 0x9f4a 0x2b5 0x1fa4 0x9ee5 0x2bc 0x20d0 0x9e81 0x2c0 0x21fc 0x9e1d 0x2d2 0x2328 0x9db7 0x2d5 0x2454 0x9d55 0x2dd 0x2580 0x9cf7 0x2ee 0x26ac 0x9c93 0x2ee 0x27d8 0x9c3c 0x2fa 0x2904 0x9bea 0x30c 0x2a30 0x9b95 0x31e 0x2b5c 0x9b3f 0x320 0x2c88 0x9ae8 0x329 0x2db4 0x9a91 0x33b 0x2ee0 0x9a3b 0x34d 0x300c 0x99e0 0x36c 0x3138 0x996f 0x35f 0x3264 0x98d5 0x2f2 0x3390 0x985b 0x2ba 0x34bc 0x97f5 0x2a3 0x35e8 0x97a2 0x2a0 0x3714 0x9759 0x28e 0x3840 0x9717 0x28a 0x396c 0x96d9 0x28a 0x3a98 0x96a0 0x28a 0x3bc4 0x9665 0x28a 0x3cf0 0x9630 0x28a 0x3e1c 0x95fe 0x28e 0x3f48 0x95cc 0x2a0 0x4074 0x9599 0x294 0x41a0 0x956a 0x292 0x42cc 0x953f 0x2a3 0x43f8 0x9514 0x2a3 0x4524 0x94ee 0x2af 0x4650 0x94c7 0x2b7 0x477c 0x949c 0x2a5 0x48a8 0x9478 0x2b3 0x49d4 0x9457 0x2c5 0x4b00 0x943a 0x2d7 0x4c2c 0x941e 0x2e9 0x4d58 0x93fc 0x2ee 0x4e84 0x93da 0x2f4 0x4fb0 0x93bd 0x306 0x50dc 0x938c 0x2e4 0x5208 0x9348 0x2c0 0x5334 0x92fb 0x2a3 0x5460 0x92bb 0x2a3 0x558c 0x9286 0x2a3 0x56b8 0x9256 0x2aa 0x57e4 0x922a 0x2bb 0x5910 0x91f8 0x2aa 0x5a3c 0x91cf 0x2ae 0x5b68 0x91ab 0x2bc 0x5c94 0x9187 0x2bc 0x5dc0 0x915d 0x2bc 0x5eec 0x912b 0x2bc 0x6018 0x90f2 0x2bb 0x6144 0x90b0 0x2a8 0x6270 0x9074 0x2b0 0x639c 0x9034 0x2b7 0x64c8 0x8fe6 0x2a5 0x65f4 0x8fbd 0x2a3 0x6720 0x8fa8 0x2ad 0x684c 0x8fa0 0x2be 0x6978 0x8f92 0x2d0 0x6aa4 0x8f79 0x2f0 0x6bd0 0x8f41 0x307 0x6cfc 0x8edd 0x307 0x6e28 0x8d73 0x307 0x6f54 0x8b8a 0x326 0x7080 0x890c 0x372 0x71ac 0x859e 0x413 0x72d8 0x7e9d 0x10ec 0x7404 0x70a8 0x8fc>;
		battery0_profile_t1_num = <0x64>;
		battery0_profile_t1 = <0x00 0xaaa0 0x39d 0x12c 0xaa18 0x39d 0x258 0xa993 0x39d 0x384 0xa913 0x39d 0x4b0 0xa8a1 0x39d 0x5dc 0xa823 0x38e 0x708 0xa7a7 0x38c 0x834 0xa732 0x39c 0x960 0xa6b8 0x38a 0xa8c 0xa644 0x390 0xbb8 0xa5cf 0x39d 0xce4 0xa552 0x39d 0xe10 0xa4df 0x39d 0xf3c 0xa46d 0x3a6 0x1068 0xa3fa 0x3b4 0x1194 0xa37d 0x3a2 0x12c0 0xa30d 0x3aa 0x13ec 0xa2a0 0x3b6 0x1518 0xa22e 0x3b6 0x1644 0xa1b9 0x3b6 0x1770 0xa149 0x3c0 0x189c 0xa0de 0x3d2 0x19c8 0xa073 0x3e4 0x1af4 0xa006 0x3e8 0x1c20 0x9f9c 0x3ef 0x1d4c 0x9f38 0x401 0x1e78 0x9ee0 0x413 0x1fa4 0x9e7c 0x41a 0x20d0 0x9e11 0x41e 0x21fc 0x9da6 0x430 0x2328 0x9d39 0x451 0x2454 0x9ccf 0x465 0x2580 0x9c6b 0x465 0x26ac 0x9c07 0x465 0x27d8 0x9bb0 0x47d 0x2904 0x9b60 0x49c 0x2a30 0x9b12 0x4ae 0x2b5c 0x9aca 0x4c0 0x2c88 0x9a7a 0x4d2 0x2db4 0x9a20 0x4e0 0x2ee0 0x99b5 0x4ce 0x300c 0x992f 0x46d 0x3138 0x98a7 0x402 0x3264 0x982a 0x3b8 0x3390 0x97d3 0x3a5 0x34bc 0x9781 0x389 0x35e8 0x9735 0x36b 0x3714 0x96f3 0x36b 0x3840 0x96be 0x379 0x396c 0x9689 0x37d 0x3a98 0x9650 0x36b 0x3bc4 0x961d 0x37d 0x3cf0 0x95ea 0x379 0x3e1c 0x95ba 0x36f 0x3f48 0x958f 0x381 0x4074 0x9563 0x384 0x41a0 0x9538 0x38c 0x42cc 0x950e 0x39d 0x43f8 0x94ea 0x39d 0x4524 0x94c6 0x3a9 0x4650 0x94a3 0x3bb 0x477c 0x9487 0x3cd 0x48a8 0x9464 0x3cf 0x49d4 0x9443 0x3d8 0x4b00 0x9426 0x3e8 0x4c2c 0x940a 0x3e8 0x4d58 0x93ed 0x3e8 0x4e84 0x93d0 0x3ee 0x4fb0 0x93b3 0x400 0x50dc 0x9389 0x3de 0x5208 0x935d 0x3c5 0x5334 0x9331 0x3b2 0x5460 0x9307 0x3a1 0x558c 0x92dc 0x38f 0x56b8 0x92b0 0x384 0x57e4 0x9285 0x385 0x5910 0x9268 0x396 0x5a3c 0x9247 0x39d 0x5b68 0x9222 0x39d 0x5c94 0x91f6 0x39d 0x5dc0 0x91c5 0x3ac 0x5eec 0x918c 0x3b6 0x6018 0x914d 0x3b7 0x6144 0x9119 0x3ca 0x6270 0x90d3 0x3c3 0x639c 0x908b 0x3b6 0x64c8 0x9052 0x3b6 0x65f4 0x9038 0x3b6 0x6720 0x9026 0x3c9 0x684c 0x9018 0x3ef 0x6978 0x900a 0x425 0x6aa4 0x8fe0 0x44e 0x6bd0 0x8f5c 0x45e 0x6cfc 0x8e4d 0x44d 0x6e28 0x8c5a 0x4a2 0x6f54 0x89be 0x512 0x7080 0x860d 0x60e 0x71ac 0x7ff1 0x8fc 0x72d8 0x71c0 0xb6d 0x7404 0x71c0 0xb6d>;
		battery0_profile_t2_num = <0x64>;
		battery0_profile_t2 = <0x00 0xa9a6 0x753 0x12c 0xa8fb 0x753 0x258 0xa85e 0x769 0x384 0xa7d2 0x789 0x4b0 0xa758 0x79b 0x5dc 0xa6df 0x79e 0x708 0xa664 0x7a6 0x834 0xa5e8 0x7b7 0x960 0xa56e 0x7b7 0xa8c 0xa4f5 0x7ab 0xbb8 0xa47d 0x79e 0xce4 0xa408 0x79e 0xe10 0xa39c 0x7ae 0xf3c 0xa32d 0x7b7 0x1068 0xa2ba 0x7b9 0x1194 0xa245 0x7cb 0x12c0 0xa1d2 0x7c3 0x13ec 0xa162 0x7c3 0x1518 0xa0f7 0x7e7 0x1644 0xa08a 0x7fa 0x1770 0xa01d 0x7f8 0x189c 0x9fb6 0x7f2 0x19c8 0x9f60 0x828 0x1af4 0x9f09 0x85e 0x1c20 0x9eac 0x894 0x1d4c 0x9e48 0x8ca 0x1e78 0x9db6 0x8a5 0x1fa4 0x9d26 0x881 0x20d0 0x9c9f 0x86a 0x21fc 0x9c34 0x87c 0x2328 0x9bdf 0x89d 0x2454 0x9b93 0x8b9 0x2580 0x9b4b 0x8ca 0x26ac 0x9afc 0x8ca 0x27d8 0x9aa7 0x8ca 0x2904 0x9a50 0x8ca 0x2a30 0x99fb 0x8ca 0x2b5c 0x997e 0x87a 0x2c88 0x98fc 0x81f 0x2db4 0x987d 0x7c9 0x2ee0 0x9819 0x793 0x300c 0x97bf 0x76b 0x3138 0x976e 0x753 0x3264 0x9724 0x753 0x3390 0x96e4 0x764 0x34bc 0x96a8 0x762 0x35e8 0x966e 0x753 0x3714 0x9634 0x753 0x3840 0x9600 0x770 0x396c 0x95d1 0x785 0x3a98 0x95a6 0x785 0x3bc4 0x957a 0x797 0x3cf0 0x954f 0x79e 0x3e1c 0x9524 0x79e 0x3f48 0x94f9 0x79e 0x4074 0x94d4 0x7ad 0x41a0 0x94af 0x7c8 0x42cc 0x948c 0x7ea 0x43f8 0x9470 0x7fc 0x4524 0x944e 0x80e 0x4650 0x942b 0x81b 0x477c 0x940f 0x81b 0x48a8 0x93f2 0x81b 0x49d4 0x93d9 0x82d 0x4b00 0x93c3 0x852 0x4c2c 0x93ae 0x875 0x4d58 0x9398 0x87f 0x4e84 0x9383 0x88b 0x4fb0 0x936d 0x8b0 0x50dc 0x9349 0x8b1 0x5208 0x9325 0x8bb 0x5334 0x92ff 0x8ca 0x5460 0x92d5 0x8ca 0x558c 0x92af 0x8d8 0x56b8 0x9288 0x8f2 0x57e4 0x925d 0x917 0x5910 0x9232 0x95f 0x5a3c 0x91f9 0x990 0x5b68 0x91ba 0x9b8 0x5c94 0x9180 0x9ef 0x5dc0 0x9140 0xa34 0x5eec 0x90f6 0xa7b 0x6018 0x90a3 0xac4 0x6144 0x906f 0xb20 0x6270 0x9051 0xb9f 0x639c 0x903c 0xc3e 0x64c8 0x9026 0xd02 0x65f4 0x900a 0xdec 0x6720 0x8fca 0xef3 0x684c 0x8f48 0x1005 0x6978 0x8dcd 0x10ca 0x6aa4 0x8b9b 0x124d 0x6bd0 0x88a0 0x148f 0x6cfc 0x84bf 0x17a1 0x6e28 0x7c46 0x2431 0x6f54 0x7288 0xd93 0x7080 0x7288 0xd93 0x71ac 0x7288 0xd93 0x72d8 0x7288 0xd93 0x7404 0x7288 0xd93>;
		battery0_profile_t3_num = <0x64>;
		battery0_profile_t3 = <0x00 0xa92e 0xcb2 0x12c 0xa7c2 0xcb2 0x258 0xa6b5 0xdfb 0x384 0xa5f8 0xfad 0x4b0 0xa571 0xfe2 0x5dc 0xa4e9 0x1009 0x708 0xa466 0x103d 0x834 0xa3ea 0x107f 0x960 0xa378 0x105b 0xa8c 0xa301 0x1073 0xbb8 0xa28b 0x1095 0xce4 0xa21d 0x1083 0xe10 0xa1ab 0x1091 0xf3c 0xa139 0x10a3 0x1068 0xa0c7 0x10b7 0x1194 0xa059 0x10db 0x12c0 0x9ff8 0x110c 0x13ec 0x9f9d 0x1136 0x1518 0x9f48 0x1148 0x1644 0x9ee2 0x117c 0x1770 0x9e69 0x1194 0x189c 0x9ddf 0x118e 0x19c8 0x9d49 0x116a 0x1af4 0x9cb0 0x1138 0x1c20 0x9c26 0x1117 0x1d4c 0x9bb4 0x1117 0x1e78 0x9b4e 0x1117 0x1fa4 0x9aed 0x1117 0x20d0 0x9a8f 0x110f 0x21fc 0x9a2b 0x10eb 0x2328 0x99b8 0x1099 0x2454 0x994b 0x104f 0x2580 0x98e8 0x101c 0x26ac 0x988b 0x100a 0x27d8 0x9831 0xfec 0x2904 0x97dc 0xfd7 0x2a30 0x978e 0xfe9 0x2b5c 0x974c 0x100b 0x2c88 0x970b 0x1014 0x2db4 0x96c9 0x1004 0x2ee0 0x9689 0x1004 0x300c 0x9653 0x1011 0x3138 0x9621 0x1023 0x3264 0x95ee 0x1035 0x3390 0x95bc 0x1047 0x34bc 0x958a 0x1063 0x35e8 0x9559 0x1084 0x3714 0x952d 0x1096 0x3840 0x9502 0x10b7 0x396c 0x94da 0x10e1 0x3a98 0x94b6 0x1117 0x3bc4 0x9491 0x1172 0x3cf0 0x946d 0x1189 0x3e1c 0x944b 0x1183 0x3f48 0x942f 0x11a7 0x4074 0x9418 0x1218 0x41a0 0x93ff 0x1275 0x42cc 0x93e3 0x12ab 0x43f8 0x93cd 0x12e0 0x4524 0x93b7 0x1317 0x4650 0x939f 0x1342 0x477c 0x9383 0x1354 0x48a8 0x9366 0x13d7 0x49d4 0x9346 0x1427 0x4b00 0x9321 0x143e 0x4c2c 0x92fe 0x1474 0x4d58 0x92d5 0x14c3 0x4e84 0x92a9 0x1530 0x4fb0 0x927d 0x15c2 0x50dc 0x9245 0x160c 0x5208 0x920b 0x1693 0x5334 0x91cf 0x1745 0x5460 0x918f 0x17e6 0x558c 0x9143 0x1887 0x56b8 0x90f7 0x1922 0x57e4 0x90ae 0x19b4 0x5910 0x907c 0x1a43 0x5a3c 0x905c 0x1b2c 0x5b68 0x9045 0x1c61 0x5c94 0x9028 0x1de1 0x5dc0 0x8ff2 0x1f59 0x5eec 0x8f87 0x20fa 0x6018 0x8ed1 0x22c8 0x6144 0x8d1a 0x247f 0x6270 0x8ab6 0x2729 0x639c 0x8761 0x2b0c 0x64c8 0x8286 0x30d6 0x65f4 0x75f8 0x165d 0x6720 0x75f8 0x165d 0x684c 0x75f8 0x165d 0x6978 0x75f8 0x165d 0x6aa4 0x75f8 0x165d 0x6bd0 0x75f8 0x165d 0x6cfc 0x75f8 0x165d 0x6e28 0x75f8 0x165d 0x6f54 0x75f8 0x165d 0x7080 0x75f8 0x165d 0x71ac 0x75f8 0x165d 0x72d8 0x75f8 0x165d 0x7404 0x75f8 0x165d>;
		battery0_profile_t4_num = <0x64>;
		battery0_profile_t4 = <0x00 0xa7da 0x1f59 0x12c 0xa70b 0x1f59 0x258 0xa627 0x1fc7 0x384 0xa52d 0x2096 0x4b0 0xa416 0x21b3 0x5dc 0xa318 0x23bf 0x708 0xa244 0x25a9 0x834 0xa1a4 0x2714 0x960 0xa116 0x2749 0xa8c 0xa090 0x274f 0xbb8 0xa011 0x2733 0xce4 0x9f94 0x26fc 0xe10 0x9f0e 0x26f7 0xf3c 0x9e7b 0x26f7 0x1068 0x9dda 0x26e5 0x1194 0x9d15 0x262e 0x12c0 0x9c53 0x2587 0x13ec 0x9b9e 0x250a 0x1518 0x9b00 0x24d5 0x1644 0x9a7b 0x249e 0x1770 0x9a09 0x2486 0x189c 0x99a9 0x248f 0x19c8 0x995a 0x24c5 0x1af4 0x9910 0x24d1 0x1c20 0x98ca 0x24e6 0x1d4c 0x988a 0x251c 0x1e78 0x9841 0x24f7 0x1fa4 0x97fd 0x24df 0x20d0 0x97bd 0x24d5 0x21fc 0x977d 0x24e7 0x2328 0x973b 0x24db 0x2454 0x96fa 0x24c9 0x2580 0x96ba 0x24b8 0x26ac 0x9681 0x24b8 0x27d8 0x9647 0x24d0 0x2904 0x960d 0x24f5 0x2a30 0x95d4 0x2518 0x2b5c 0x959b 0x251c 0x2c88 0x9564 0x2525 0x2db4 0x9531 0x253a 0x2ee0 0x94ff 0x255d 0x300c 0x94cd 0x258e 0x3138 0x949d 0x25c4 0x3264 0x9471 0x25fb 0x3390 0x9447 0x2676 0x34bc 0x9418 0x26c0 0x35e8 0x93e5 0x26f6 0x3714 0x93b2 0x2789 0x3840 0x9380 0x27d1 0x396c 0x934b 0x2815 0x3a98 0x9312 0x286e 0x3bc4 0x92d0 0x2900 0x3cf0 0x928f 0x297a 0x3e1c 0x924d 0x29d9 0x3f48 0x9206 0x2a0e 0x4074 0x91bd 0x2a63 0x41a0 0x9178 0x2abe 0x42cc 0x9139 0x2b1c 0x43f8 0x9107 0x2bbc 0x4524 0x90d9 0x2c84 0x4650 0x90a9 0x2d69 0x477c 0x9070 0x2e63 0x48a8 0x9010 0x2f2d 0x49d4 0x8f74 0x302a 0x4b00 0x8e81 0x3149 0x4c2c 0x8cc6 0x31c6 0x4d58 0x8a1a 0x32c6 0x4e84 0x864b 0x3401 0x4fb0 0x800c 0x2ec7 0x50dc 0x7b5c 0x230f 0x5208 0x7b5c 0x230f 0x5334 0x7b5c 0x230f 0x5460 0x7b5c 0x230f 0x558c 0x7b5c 0x230f 0x56b8 0x7b5c 0x230f 0x57e4 0x7b5c 0x230f 0x5910 0x7b5c 0x230f 0x5a3c 0x7b5c 0x230f 0x5b68 0x7b5c 0x230f 0x5c94 0x7b5c 0x230f 0x5dc0 0x7b5c 0x230f 0x5eec 0x7b5c 0x230f 0x6018 0x7b5c 0x230f 0x6144 0x7b5c 0x230f 0x6270 0x7b5c 0x230f 0x639c 0x7b5c 0x230f 0x64c8 0x7b5c 0x230f 0x65f4 0x7b5c 0x230f 0x6720 0x7b5c 0x230f 0x684c 0x7b5c 0x230f 0x6978 0x7b5c 0x230f 0x6aa4 0x7b5c 0x230f 0x6bd0 0x7b5c 0x230f 0x6cfc 0x7b5c 0x230f 0x6e28 0x7b5c 0x230f 0x6f54 0x7b5c 0x230f 0x7080 0x7b5c 0x230f 0x71ac 0x7b5c 0x230f 0x72d8 0x7b5c 0x230f 0x7404 0x7b5c 0x230f>;
		battery1_profile_t0_num = <0x64>;
		battery1_profile_t0 = <0x00 0xaaaa 0x410 0x12b 0xaa1c 0x410 0x256 0xa994 0x410 0x380 0xa913 0x410 0x4ab 0xa89a 0x410 0x5d6 0xa81f 0x410 0x701 0xa7a4 0x410 0x82c 0xa72c 0x410 0x956 0xa6ba 0x410 0xa81 0xa642 0x410 0xbac 0xa5c8 0x417 0xcd7 0xa557 0x434 0xe01 0xa4e5 0x420 0xf2c 0xa472 0x41d 0x1057 0xa3fd 0x438 0x1182 0xa38b 0x438 0x12ad 0xa318 0x438 0x13d7 0xa2a4 0x438 0x1502 0xa232 0x438 0x162d 0xa1be 0x438 0x1758 0xa14e 0x438 0x1883 0xa0e4 0x43b 0x19ad 0xa079 0x458 0x1ad8 0xa00c 0x44b 0x1c03 0x9fa2 0x442 0x1d2e 0x9f3f 0x45e 0x1e58 0x9ed2 0x460 0x1f83 0x9e6e 0x470 0x20ae 0x9e11 0x48c 0x21d9 0x9db3 0x4aa 0x2304 0x9d4b 0x49a 0x242e 0x9ce5 0x488 0x2559 0x9c89 0x488 0x2684 0x9c38 0x4a4 0x27af 0x9be5 0x4c1 0x28da 0x9b91 0x4de 0x2a04 0x9b40 0x4fb 0x2b2f 0x9aec 0x517 0x2c5a 0x9a9a 0x534 0x2d85 0x9a4b 0x550 0x2eb0 0x99ec 0x56d 0x2fda 0x9978 0x542 0x3105 0x98f6 0x4e5 0x3230 0x986c 0x470 0x335b 0x9809 0x448 0x3485 0x97b2 0x42b 0x35b0 0x9763 0x410 0x36db 0x9723 0x410 0x3806 0x96e8 0x410 0x3931 0x96ae 0x410 0x3a5b 0x9674 0x410 0x3b86 0x963b 0x410 0x3cb1 0x9608 0x41e 0x3ddc 0x95dc 0x435 0x3f07 0x95aa 0x418 0x4031 0x957e 0x424 0x415c 0x9553 0x438 0x4287 0x9527 0x438 0x43b2 0x9503 0x453 0x44dc 0x94df 0x460 0x4607 0x94b9 0x460 0x4732 0x948f 0x460 0x485d 0x946e 0x476 0x4988 0x944e 0x488 0x4ab2 0x942b 0x488 0x4bdd 0x940e 0x4a4 0x4d08 0x93f1 0x4c1 0x4e33 0x93d3 0x4d8 0x4f5e 0x93af 0x4d8 0x5088 0x937a 0x4aa 0x51b3 0x9334 0x464 0x52de 0x92df 0x410 0x5409 0x92ac 0x42e 0x5534 0x927f 0x44a 0x565e 0x9252 0x459 0x5789 0x9220 0x43d 0x58b4 0x91f4 0x438 0x59df 0x91cc 0x445 0x5b09 0x91a8 0x460 0x5c34 0x9184 0x460 0x5d5f 0x915b 0x460 0x5e8a 0x912c 0x460 0x5fb5 0x90f4 0x460 0x60df 0x90b3 0x447 0x620a 0x9076 0x446 0x6335 0x903b 0x45d 0x6460 0x8feb 0x440 0x658b 0x8fc0 0x438 0x66b5 0x8fa7 0x438 0x67e0 0x8f99 0x438 0x690b 0x8f91 0x488 0x6a36 0x8f7b 0x4b0 0x6b60 0x8f48 0x4b0 0x6c8b 0x8eaf 0x4b0 0x6db6 0x8d5d 0x4db 0x6ee1 0x8b86 0x529 0x700c 0x8929 0x59e 0x7136 0x8585 0x6d2 0x7261 0x7f00 0x151e 0x738c 0x70d0 0xe88>;
		battery1_profile_t1_num = <0x64>;
		battery1_profile_t1 = <0x00 0xaa0a 0x5a0 0x12b 0xa97c 0x5a0 0x256 0xa8f8 0x5c3 0x380 0xa87d 0x5f0 0x4ab 0xa804 0x5f0 0x5d6 0xa78f 0x5f0 0x701 0xa718 0x5f0 0x82c 0xa6a0 0x5f0 0x956 0xa62e 0x5f0 0xa81 0xa5b6 0x5f0 0xbac 0xa53c 0x5f0 0xcd7 0xa4cb 0x5f0 0xe01 0xa456 0x5f0 0xf2c 0xa3e3 0x5f0 0x1057 0xa372 0x5f2 0x1182 0xa307 0x60f 0x12ad 0xa296 0x618 0x13d7 0xa224 0x621 0x1502 0xa1b9 0x63d 0x162d 0xa146 0x626 0x1758 0xa0d6 0x627 0x1883 0xa06c 0x643 0x19ad 0xa009 0x660 0x1ad8 0x9f9e 0x668 0x1c03 0x9f3c 0x67b 0x1d2e 0x9eed 0x6b4 0x1e58 0x9e90 0x6d3 0x1f83 0x9e22 0x6e0 0x20ae 0x9daa 0x6e0 0x21d9 0x9d35 0x6e0 0x2304 0x9cce 0x6f6 0x242e 0x9c70 0x713 0x2559 0x9c1b 0x72f 0x2684 0x9bc3 0x74c 0x27af 0x9b6d 0x758 0x28da 0x9b1b 0x763 0x2a04 0x9ada 0x79e 0x2b2f 0x9a8e 0x7bf 0x2c5a 0x9a37 0x7c4 0x2d85 0x99d3 0x7a7 0x2eb0 0x9957 0x732 0x2fda 0x98d8 0x6ad 0x3105 0x985e 0x633 0x3230 0x97f8 0x5f8 0x335b 0x97a1 0x5bf 0x3485 0x9754 0x5ad 0x35b0 0x9713 0x5c8 0x36db 0x96da 0x5c8 0x3806 0x96a2 0x5c8 0x3931 0x966a 0x5c8 0x3a5b 0x9637 0x5c8 0x3b86 0x9605 0x5c8 0x3cb1 0x95d3 0x5c8 0x3ddc 0x95a1 0x5c8 0x3f07 0x9576 0x5c8 0x4031 0x9551 0x5dc 0x415c 0x952b 0x5f0 0x4287 0x94ff 0x5f0 0x43b2 0x94e1 0x625 0x44dc 0x94c1 0x640 0x4607 0x949c 0x640 0x4732 0x9479 0x640 0x485d 0x945a 0x656 0x4988 0x943d 0x668 0x4ab2 0x9421 0x668 0x4bdd 0x9404 0x684 0x4d08 0x93e7 0x690 0x4e33 0x93c9 0x68a 0x4f5e 0x93a5 0x66e 0x5088 0x937b 0x63a 0x51b3 0x9350 0x60c 0x52de 0x9325 0x5f0 0x5409 0x92fa 0x5d2 0x5534 0x92cf 0x5c8 0x565e 0x92a6 0x5cf 0x5789 0x9282 0x5eb 0x58b4 0x925e 0x5d8 0x59df 0x923d 0x5e2 0x5b09 0x9220 0x618 0x5c34 0x91f4 0x618 0x5d5f 0x91bf 0x618 0x5e8a 0x9186 0x618 0x5fb5 0x914e 0x618 0x60df 0x9113 0x631 0x620a 0x90cf 0x640 0x6335 0x9083 0x63d 0x6460 0x9050 0x620 0x658b 0x9038 0x62c 0x66b5 0x9029 0x652 0x67e0 0x901b 0x68d 0x690b 0x9006 0x6c6 0x6a36 0x8fda 0x70e 0x6b60 0x8f79 0x758 0x6c8b 0x8e38 0x758 0x6db6 0x8c5c 0x7c4 0x6ee1 0x89e5 0x872 0x700c 0x86ae 0x95b 0x7136 0x81e7 0x1a74 0x7261 0x758d 0x21b7 0x738c 0x74cc 0x1db0>;
		battery1_profile_t2_num = <0x64>;
		battery1_profile_t2 = <0x00 0xa8b6 0xb18 0x12b 0xa80b 0xb18 0x256 0xa774 0xb3b 0x380 0xa6ec 0xb6e 0x4ab 0xa66c 0xb8b 0x5d6 0xa5f5 0xba8 0x701 0xa57e 0xbb8 0x82c 0xa506 0xbb8 0x956 0xa491 0xbb8 0xa81 0xa41e 0xbcb 0xbac 0xa3ac 0xbe0 0xcd7 0xa33b 0xbe0 0xe01 0xa2cd 0xbf9 0xf2c 0xa25d 0xc08 0x1057 0xa1ec 0xc0a 0x1182 0xa17e 0xc27 0x12ad 0xa113 0xc30 0x13d7 0xa0a8 0xc39 0x1502 0xa03d 0xc55 0x162d 0x9fd7 0xc58 0x1758 0x9f79 0xc76 0x1883 0x9f24 0xcb5 0x19ad 0x9ecc 0xd2a 0x1ad8 0x9e67 0xd5d 0x1c03 0x9def 0xd52 0x1d2e 0x9d5d 0xcfb 0x1e58 0x9cdc 0xcf8 0x1f83 0x9c68 0xcf8 0x20ae 0x9c03 0xd05 0x21d9 0x9bba 0xd5d 0x2304 0x9b72 0xd86 0x242e 0x9b28 0xd98 0x2559 0x9ad8 0xd98 0x2684 0x9a89 0xd98 0x27af 0x9a37 0xd98 0x28da 0x99dc 0xd82 0x2a04 0x9967 0xd0d 0x2b2f 0x98e9 0xc83 0x2c5a 0x9871 0xc0c 0x2d85 0x9804 0xbb6 0x2eb0 0x97af 0xb7d 0x2fda 0x9762 0xb7b 0x3105 0x971b 0xb88 0x3230 0x96db 0xb6c 0x335b 0x96a1 0xb80 0x3485 0x9668 0xb83 0x35b0 0x962e 0xb6a 0x36db 0x95fc 0xb87 0x3806 0x95ca 0xba4 0x3931 0x9599 0xbc1 0x3a5b 0x956e 0xbdd 0x3b86 0x9544 0xbe0 0x3cb1 0x951c 0xbee 0x3ddc 0x94f8 0xc0b 0x3f07 0x94d4 0xc28 0x4031 0x94b0 0xc45 0x415c 0x948e 0xc62 0x4287 0x9472 0xc7e 0x43b2 0x944f 0xc80 0x44dc 0x942f 0xc8f 0x4607 0x9413 0xcad 0x4732 0x93fd 0xcc9 0x485d 0x93e2 0xce6 0x4988 0x93c8 0xd03 0x4ab2 0x93b3 0xd1f 0x4bdd 0x939d 0xd3c 0x4d08 0x9387 0xd59 0x4e33 0x9370 0xd76 0x4f5e 0x9354 0xd92 0x5088 0x932b 0xd98 0x51b3 0x9303 0xda4 0x52de 0x92e0 0xdc1 0x5409 0x92bb 0xdfb 0x5534 0x9297 0xe34 0x565e 0x9272 0xe6e 0x5789 0x9246 0xea8 0x58b4 0x920f 0xefa 0x59df 0x91d3 0xf4f 0x5b09 0x9193 0xfa6 0x5c34 0x9160 0x101b 0x5d5f 0x911b 0x107a 0x5e8a 0x90cc 0x10d0 0x5fb5 0x907c 0x1127 0x60df 0x905a 0x11ca 0x620a 0x9045 0x129f 0x6335 0x9036 0x13a5 0x6460 0x9020 0x14e6 0x658b 0x8ff6 0x164a 0x66b5 0x8f8d 0x17b3 0x67e0 0x8ea9 0x1908 0x690b 0x8cc5 0x1ab4 0x6a36 0x8a49 0x1d76 0x6b60 0x86ff 0x21ab 0x6c8b 0x8138 0x2986 0x6db6 0x7292 0x15e0 0x6ee1 0x7292 0x15e0 0x700c 0x7292 0x15e0 0x7136 0x7292 0x15e0 0x7261 0x7292 0x15e0 0x738c 0x7292 0x15e0>;
		battery1_profile_t3_num = <0x64>;
		battery1_profile_t3 = <0x00 0xa848 0x20f4 0x12b 0xa6eb 0x20f4 0x256 0xa5dc 0x2244 0x380 0xa514 0x241f 0x4ab 0xa48d 0x24c1 0x5d6 0xa411 0x2514 0x701 0xa397 0x2548 0x82c 0xa31c 0x2569 0x956 0xa2aa 0x258a 0xa81 0xa238 0x2581 0xbac 0xa1c6 0x2568 0xcd7 0xa151 0x2568 0xe01 0xa0e5 0x259f 0xf2c 0xa07c 0x263b 0x1057 0xa017 0x273a 0x1182 0x9fba 0x27bc 0x12ad 0x9f67 0x27d1 0x13d7 0x9f11 0x2795 0x1502 0x9ea4 0x2711 0x162d 0x9e1f 0x261b 0x1758 0x9d8e 0x24d4 0x1883 0x9cf3 0x2365 0x19ad 0x9c68 0x2345 0x1ad8 0x9bf4 0x2352 0x1c03 0x9b90 0x2385 0x1d2e 0x9b3b 0x23e2 0x1e58 0x9aea 0x2409 0x1f83 0x9a93 0x2439 0x20ae 0x9a35 0x2470 0x21d9 0x99ca 0x2470 0x2304 0x995e 0x2470 0x242e 0x98f4 0x245b 0x2559 0x9890 0x241c 0x2684 0x9831 0x23dc 0x27af 0x97dc 0x239d 0x28da 0x978f 0x235e 0x2a04 0x9748 0x231f 0x2b2f 0x96ff 0x2310 0x2c5a 0x96bc 0x2310 0x2d85 0x9683 0x2310 0x2eb0 0x9650 0x232f 0x2fda 0x961a 0x233c 0x3105 0x95e2 0x234f 0x3230 0x95b0 0x23ac 0x335b 0x9583 0x23f3 0x3485 0x9558 0x2432 0x35b0 0x952d 0x2470 0x36db 0x9502 0x2491 0x3806 0x94db 0x24b0 0x3931 0x94b7 0x24ee 0x3a5b 0x9493 0x258e 0x3b86 0x946f 0x25f5 0x3cb1 0x944f 0x2653 0x3ddc 0x9433 0x26b8 0x3f07 0x941d 0x2798 0x4031 0x9407 0x2860 0x415c 0x93f2 0x2935 0x4287 0x93dd 0x2a4f 0x43b2 0x93c7 0x2b1b 0x44dc 0x93b1 0x2c18 0x4607 0x939b 0x2d54 0x4732 0x937e 0x2eb5 0x485d 0x9362 0x2ff9 0x4988 0x9343 0x313c 0x4ab2 0x931f 0x3294 0x4bdd 0x92fb 0x3411 0x4d08 0x92d3 0x359e 0x4e33 0x92a8 0x3732 0x4f5e 0x927d 0x38b3 0x5088 0x9247 0x3a5c 0x51b3 0x920d 0x3c0b 0x52de 0x91d3 0x3dac 0x5409 0x9193 0x3f43 0x5534 0x914f 0x410f 0x565e 0x9108 0x4306 0x5789 0x90bf 0x4507 0x58b4 0x9088 0x4718 0x59df 0x905f 0x494a 0x5b09 0x9041 0x4bac 0x5c34 0x9025 0x4e3d 0x5d5f 0x8ffb 0x50cf 0x5e8a 0x8fb3 0x5377 0x5fb5 0x8f13 0x5679 0x60df 0x8da6 0x5937 0x620a 0x8b9e 0x5bb8 0x6335 0x88e6 0x5df1 0x6460 0x847b 0x5fa7 0x658b 0x7d1d 0x6334 0x66b5 0x74ea 0x3180 0x67e0 0x74ea 0x3180 0x690b 0x74ea 0x3180 0x6a36 0x74ea 0x3180 0x6b60 0x74ea 0x3180 0x6c8b 0x74ea 0x3180 0x6db6 0x74ea 0x3180 0x6ee1 0x74ea 0x3180 0x700c 0x74ea 0x3180 0x7136 0x74ea 0x3180 0x7261 0x74ea 0x3180 0x738c 0x74ea 0x3180>;
		battery1_profile_t4_num = <0x64>;
		battery1_profile_t4 = <0x00 0xa848 0x20f4 0x12b 0xa6eb 0x20f4 0x256 0xa5dc 0x2244 0x380 0xa514 0x241f 0x4ab 0xa48d 0x24c1 0x5d6 0xa411 0x2514 0x701 0xa397 0x2548 0x82c 0xa31c 0x2569 0x956 0xa2aa 0x258a 0xa81 0xa238 0x2581 0xbac 0xa1c6 0x2568 0xcd7 0xa151 0x2568 0xe01 0xa0e5 0x259f 0xf2c 0xa07c 0x263b 0x1057 0xa017 0x273a 0x1182 0x9fba 0x27bc 0x12ad 0x9f67 0x27d1 0x13d7 0x9f11 0x2795 0x1502 0x9ea4 0x2711 0x162d 0x9e1f 0x261b 0x1758 0x9d8e 0x24d4 0x1883 0x9cf3 0x2365 0x19ad 0x9c68 0x2345 0x1ad8 0x9bf4 0x2352 0x1c03 0x9b90 0x2385 0x1d2e 0x9b3b 0x23e2 0x1e58 0x9aea 0x2409 0x1f83 0x9a93 0x2439 0x20ae 0x9a35 0x2470 0x21d9 0x99ca 0x2470 0x2304 0x995e 0x2470 0x242e 0x98f4 0x245b 0x2559 0x9890 0x241c 0x2684 0x9831 0x23dc 0x27af 0x97dc 0x239d 0x28da 0x978f 0x235e 0x2a04 0x9748 0x231f 0x2b2f 0x96ff 0x2310 0x2c5a 0x96bc 0x2310 0x2d85 0x9683 0x2310 0x2eb0 0x9650 0x232f 0x2fda 0x961a 0x233c 0x3105 0x95e2 0x234f 0x3230 0x95b0 0x23ac 0x335b 0x9583 0x23f3 0x3485 0x9558 0x2432 0x35b0 0x952d 0x2470 0x36db 0x9502 0x2491 0x3806 0x94db 0x24b0 0x3931 0x94b7 0x24ee 0x3a5b 0x9493 0x258e 0x3b86 0x946f 0x25f5 0x3cb1 0x944f 0x2653 0x3ddc 0x9433 0x26b8 0x3f07 0x941d 0x2798 0x4031 0x9407 0x2860 0x415c 0x93f2 0x2935 0x4287 0x93dd 0x2a4f 0x43b2 0x93c7 0x2b1b 0x44dc 0x93b1 0x2c18 0x4607 0x939b 0x2d54 0x4732 0x937e 0x2eb5 0x485d 0x9362 0x2ff9 0x4988 0x9343 0x313c 0x4ab2 0x931f 0x3294 0x4bdd 0x92fb 0x3411 0x4d08 0x92d3 0x359e 0x4e33 0x92a8 0x3732 0x4f5e 0x927d 0x38b3 0x5088 0x9247 0x3a5c 0x51b3 0x920d 0x3c0b 0x52de 0x91d3 0x3dac 0x5409 0x9193 0x3f43 0x5534 0x914f 0x410f 0x565e 0x9108 0x4306 0x5789 0x90bf 0x4507 0x58b4 0x9088 0x4718 0x59df 0x905f 0x494a 0x5b09 0x9041 0x4bac 0x5c34 0x9025 0x4e3d 0x5d5f 0x8ffb 0x50cf 0x5e8a 0x8fb3 0x5377 0x5fb5 0x8f13 0x5679 0x60df 0x8da6 0x5937 0x620a 0x8b9e 0x5bb8 0x6335 0x88e6 0x5df1 0x6460 0x847b 0x5fa7 0x658b 0x7d1d 0x6334 0x66b5 0x74ea 0x3180 0x67e0 0x74ea 0x3180 0x690b 0x74ea 0x3180 0x6a36 0x74ea 0x3180 0x6b60 0x74ea 0x3180 0x6c8b 0x74ea 0x3180 0x6db6 0x74ea 0x3180 0x6ee1 0x74ea 0x3180 0x700c 0x74ea 0x3180 0x7136 0x74ea 0x3180 0x7261 0x74ea 0x3180 0x738c 0x74ea 0x3180>;
		battery2_profile_t0_num = <0x64>;
		battery2_profile_t0 = <0x00 0xab18 0x2bc 0x135 0xaa6f 0x2bc 0x269 0xa9d2 0x2b0 0x39e 0xa943 0x2a9 0x4d2 0xa8c6 0x2bb 0x607 0xa849 0x2bc 0x73c 0xa7cb 0x2bc 0x870 0xa74c 0x2b7 0x9a5 0xa6cf 0x2a5 0xad9 0xa658 0x2b4 0xc0e 0xa5e1 0x2bc 0xd42 0xa568 0x2b8 0xe77 0xa4eb 0x2a6 0xfac 0xa474 0x2a3 0x10e0 0xa3fd 0x2a3 0x1215 0xa387 0x2a6 0x1349 0xa318 0x2b8 0x147e 0xa2a4 0x2ad 0x15b3 0xa231 0x2ab 0x16e7 0xa1c0 0x2be 0x181c 0xa152 0x2d0 0x1950 0xa0de 0x2c7 0x1a85 0xa06d 0x2c3 0x1bb9 0xa004 0x2d4 0x1cee 0x9f96 0x2c2 0x1e23 0x9f2b 0x2c9 0x1f57 0x9ec2 0x2d5 0x208c 0x9e5b 0x2d5 0x21c0 0x9dfc 0x2e7 0x22f5 0x9d96 0x2e2 0x242a 0x9d2d 0x2db 0x255e 0x9cc7 0x2ed 0x2693 0x9c6e 0x2ee 0x27c7 0x9c19 0x2f9 0x28fc 0x9bc5 0x307 0x2a31 0x9b6c 0x307 0x2b65 0x9b1b 0x318 0x2c9a 0x9ac9 0x32a 0x2dce 0x9a77 0x33d 0x2f03 0x9a26 0x34f 0x3037 0x99d5 0x371 0x316c 0x997c 0x384 0x32a1 0x9916 0x37e 0x33d5 0x9899 0x359 0x350a 0x980d 0x306 0x363e 0x9798 0x2cc 0x3773 0x9741 0x2ba 0x38a8 0x96f0 0x2a8 0x39dc 0x96af 0x2b1 0x3b11 0x9673 0x2bc 0x3c45 0x9639 0x2bc 0x3d7a 0x9604 0x2bc 0x3eae 0x95d0 0x2bc 0x3fe3 0x959d 0x2b5 0x4118 0x9569 0x2a3 0x424c 0x953c 0x2b6 0x4381 0x9515 0x2bc 0x44b5 0x94ee 0x2bc 0x45ea 0x94c2 0x2bc 0x471f 0x949c 0x2bc 0x4853 0x9477 0x2c8 0x4988 0x9454 0x2da 0x4abc 0x9437 0x2ec 0x4bf1 0x9412 0x2dd 0x4d25 0x93f1 0x2e0 0x4e5a 0x93d5 0x2f2 0x4f8f 0x93bf 0x304 0x50c3 0x93a2 0x307 0x51f8 0x9384 0x307 0x532c 0x9363 0x304 0x5461 0x9330 0x2f2 0x5596 0x92e3 0x2d0 0x56ca 0x929c 0x2b3 0x57ff 0x9264 0x2a5 0x5933 0x923f 0x2b8 0x5a68 0x9214 0x2bc 0x5b9d 0x91e7 0x2b4 0x5cd1 0x91bc 0x2a4 0x5e06 0x919f 0x2b7 0x5f3a 0x917b 0x2bc 0x606f 0x9156 0x2c3 0x61a3 0x9131 0x2d5 0x62d8 0x90f6 0x2d5 0x640d 0x90b6 0x2c9 0x6541 0x9077 0x2c2 0x6676 0x9044 0x2d4 0x67aa 0x8ff4 0x2d5 0x68df 0x8fb9 0x2ca 0x6a14 0x8f96 0x2c1 0x6b48 0x8f8f 0x2d3 0x6c7d 0x8f81 0x2e6 0x6db1 0x8f6d 0x2f8 0x6ee6 0x8f4a 0x30f 0x701a 0x8ef9 0x334 0x714f 0x8da8 0x339 0x7284 0x8bca 0x360 0x73b8 0x895e 0x3ba 0x74ed 0x85f4 0x45f 0x7621 0x7f1e 0xfa1 0x7756 0x72a6 0xe42>;
		battery2_profile_t1_num = <0x64>;
		battery2_profile_t1 = <0x00 0xaa8c 0x41a 0x135 0xa9f2 0x41a 0x269 0xa95f 0x41a 0x39e 0xa8d3 0x41a 0x4d2 0xa84f 0x41a 0x607 0xa7d1 0x41a 0x73c 0xa757 0x425 0x870 0xa6de 0x42e 0x9a5 0xa661 0x41c 0xad9 0xa5ea 0x41a 0xc0e 0xa573 0x41a 0xd42 0xa4fb 0x41a 0xe77 0xa486 0x41a 0xfac 0xa410 0x41a 0x10e0 0xa39d 0x423 0x1215 0xa32b 0x430 0x1349 0xa2b6 0x41e 0x147e 0xa246 0x429 0x15b3 0xa1d7 0x433 0x16e7 0xa166 0x435 0x181c 0xa0f8 0x447 0x1950 0xa084 0x43e 0x1a85 0xa013 0x43a 0x1bb9 0x9fab 0x44c 0x1cee 0x9f4b 0x44c 0x1e23 0x9f09 0x48d 0x1f57 0x9eca 0x4d6 0x208c 0x9e79 0x4fb 0x21c0 0x9dcc 0x4af 0x22f5 0x9d18 0x472 0x242a 0x9c73 0x452 0x255e 0x9bf6 0x464 0x2693 0x9b9a 0x465 0x27c7 0x9b5c 0x493 0x28fc 0x9b32 0x4dd 0x2a31 0x9b0c 0x528 0x2b65 0x9acc 0x51c 0x2c9a 0x9a81 0x514 0x2dce 0x9a2f 0x518 0x2f03 0x99d4 0x52b 0x3037 0x9975 0x52d 0x316c 0x9905 0x505 0x32a1 0x9885 0x4b7 0x33d5 0x9809 0x45b 0x350a 0x979c 0x41d 0x363e 0x973f 0x3ee 0x3773 0x96f0 0x3cf 0x38a8 0x96ae 0x3cf 0x39dc 0x9671 0x3cf 0x3b11 0x9639 0x3cf 0x3c45 0x9605 0x3cf 0x3d7a 0x95d2 0x3cf 0x3eae 0x95a3 0x3cf 0x3fe3 0x9576 0x3d6 0x4118 0x954a 0x3e7 0x424c 0x951e 0x3d5 0x4381 0x94f6 0x3dc 0x44b5 0x94d1 0x3e8 0x45ea 0x94ac 0x3e8 0x471f 0x9488 0x3e8 0x4853 0x9467 0x3f4 0x4988 0x9449 0x401 0x4abc 0x942c 0x401 0x4bf1 0x940e 0x413 0x4d25 0x93f0 0x40f 0x4e5a 0x93d4 0x406 0x4f8f 0x93be 0x418 0x50c3 0x93a8 0x41a 0x51f8 0x938d 0x41a 0x532c 0x9370 0x416 0x5461 0x9353 0x404 0x5596 0x9328 0x3e1 0x56ca 0x92ff 0x3c6 0x57ff 0x92da 0x3b9 0x5933 0x92b6 0x3cb 0x5a68 0x9290 0x3de 0x5b9d 0x926b 0x3e8 0x5cd1 0x9247 0x3ea 0x5e06 0x922a 0x3fc 0x5f3a 0x9201 0x40f 0x606f 0x91ce 0x41a 0x61a3 0x9193 0x41b 0x62d8 0x9158 0x42d 0x640d 0x911d 0x440 0x6541 0x90dc 0x453 0x6676 0x9092 0x465 0x67aa 0x904e 0x478 0x68df 0x9029 0x48a 0x6a14 0x9015 0x4a2 0x6b48 0x9007 0x4c7 0x6c7d 0x8ff8 0x510 0x6db1 0x8fdb 0x55b 0x6ee6 0x8f87 0x59b 0x701a 0x8eab 0x5bf 0x714f 0x8cc8 0x617 0x7284 0x8a41 0x6b3 0x73b8 0x86c7 0x7d9 0x74ed 0x8136 0xa5c 0x7621 0x776a 0x196f 0x7756 0x7616 0x162b>;
		battery2_profile_t2_num = <0x64>;
		battery2_profile_t2 = <0x00 0xa94c 0x979 0x135 0xa870 0x979 0x269 0xa7bb 0x9a9 0x39e 0xa725 0x9e8 0x4d2 0xa6a1 0xa0d 0x607 0xa621 0xa21 0x73c 0xa5a2 0xa28 0x870 0xa526 0xa23 0x9a5 0xa4a9 0xa11 0xad9 0xa430 0xa0f 0xc0e 0xa3bd 0xa19 0xd42 0xa34d 0xa24 0xe77 0xa2d8 0xa12 0xfac 0xa266 0xa1f 0x10e0 0xa1f7 0xa32 0x1215 0xa189 0xa3e 0x1349 0xa11a 0xa2c 0x147e 0xa0aa 0xa28 0x15b3 0xa03e 0xa1f 0x16e7 0x9fda 0xa1d 0x181c 0x9f91 0xa9d 0x1950 0x9f46 0xb2e 0x1a85 0x9eef 0xb86 0x1bb9 0x9e84 0xb80 0x1cee 0x9ddb 0xb12 0x1e23 0x9d25 0xa87 0x1f57 0x9c7b 0xa14 0x208c 0x9bef 0x9dd 0x21c0 0x9b86 0x9dd 0x22f5 0x9b32 0x9f6 0x242a 0x9aed 0xa26 0x255e 0x9ab3 0xa70 0x2693 0x9a76 0xaa9 0x27c7 0x9a37 0xaca 0x28fc 0x99f2 0xad7 0x2a31 0x99a9 0xad7 0x2b65 0x9957 0xac6 0x2c9a 0x98f5 0xa9e 0x2dce 0x9883 0xa5b 0x2f03 0x9806 0x9ed 0x3037 0x9794 0x99d 0x316c 0x9730 0x966 0x32a1 0x96da 0x947 0x33d5 0x968e 0x947 0x350a 0x964b 0x947 0x363e 0x960f 0x947 0x3773 0x95db 0x94a 0x38a8 0x95a7 0x95c 0x39dc 0x9574 0x960 0x3b11 0x9543 0x968 0x3c45 0x9516 0x979 0x3d7a 0x94ea 0x979 0x3eae 0x94c3 0x979 0x3fe3 0x949e 0x980 0x4118 0x9479 0x994 0x424c 0x945b 0x9b8 0x4381 0x9439 0x9b7 0x44b5 0x9416 0x9ab 0x45ea 0x93f8 0x9ab 0x471f 0x93e9 0x9cf 0x4853 0x93da 0xa01 0x4988 0x93cc 0xa33 0x4abc 0x93bd 0xa58 0x4bf1 0x93ae 0xa8e 0x4d25 0x93a4 0xadc 0x4e5a 0x9398 0xb30 0x4f8f 0x9382 0xb67 0x50c3 0x9373 0xbcf 0x51f8 0x935c 0xc2b 0x532c 0x933e 0xc81 0x5461 0x9321 0xd02 0x5596 0x92f7 0xd73 0x56ca 0x92ca 0xdeb 0x57ff 0x929e 0xe74 0x5933 0x927a 0xf19 0x5a68 0x9249 0xfb0 0x5b9d 0x9212 0x1055 0x5cd1 0x91d6 0x1111 0x5e06 0x919b 0x11c8 0x5f3a 0x915b 0x128d 0x606f 0x9115 0x1359 0x61a3 0x90ca 0x1427 0x62d8 0x9081 0x14df 0x640d 0x9041 0x15b4 0x6541 0x900f 0x16b5 0x6676 0x8ff2 0x17ed 0x67aa 0x8fd4 0x1952 0x68df 0x8fac 0x1afc 0x6a14 0x8f67 0x1ce4 0x6b48 0x8eea 0x1f0b 0x6c7d 0x8db1 0x2150 0x6db1 0x8bc5 0x2445 0x6ee6 0x890b 0x2841 0x701a 0x852b 0x2dff 0x714f 0x7d22 0x27be 0x7284 0x7332 0xef1 0x73b8 0x7332 0xef1 0x74ed 0x7332 0xef1 0x7621 0x7332 0xef1 0x7756 0x7332 0xef1>;
		battery2_profile_t3_num = <0x64>;
		battery2_profile_t3 = <0x00 0xa80c 0x1211 0x135 0xa6ba 0x1211 0x269 0xa5be 0x12dd 0x39e 0xa502 0x13d6 0x4d2 0xa468 0x1432 0x607 0xa3d8 0x145b 0x73c 0xa350 0x1474 0x870 0xa2ce 0x1487 0x9a5 0xa251 0x1499 0xad9 0xa1d1 0x148a 0xc0e 0xa157 0x1482 0xd42 0xa0e2 0x148a 0xe77 0xa072 0x14af 0xfac 0xa023 0x1535 0x10e0 0x9fc9 0x15a3 0x1215 0x9f5c 0x15dd 0x1349 0x9edf 0x15ca 0x147e 0x9e4a 0x158a 0x15b3 0x9da3 0x151c 0x16e7 0x9cf3 0x148e 0x181c 0x9c61 0x1432 0x1950 0x9be2 0x140f 0x1a85 0x9b75 0x140d 0x1bb9 0x9b17 0x1423 0x1cee 0x9ace 0x145a 0x1e23 0x9a78 0x1477 0x1f57 0x9a22 0x1491 0x208c 0x99d1 0x14b4 0x21c0 0x9976 0x14b4 0x22f5 0x991d 0x14b4 0x242a 0x98c2 0x14a7 0x255e 0x9860 0x1481 0x2693 0x9801 0x145d 0x27c7 0x979c 0x1438 0x28fc 0x9739 0x1413 0x2a31 0x96df 0x13ed 0x2b65 0x968e 0x13ec 0x2c9a 0x9645 0x13ec 0x2dce 0x9604 0x13f1 0x2f03 0x95c9 0x1404 0x3037 0x958e 0x1405 0x316c 0x955b 0x1424 0x32a1 0x952e 0x1458 0x33d5 0x9502 0x147d 0x350a 0x94db 0x14a3 0x363e 0x94b6 0x14be 0x3773 0x9491 0x14d0 0x38a8 0x946c 0x14e3 0x39dc 0x945a 0x1534 0x3b11 0x9447 0x157e 0x3c45 0x9432 0x15b5 0x3d7a 0x9423 0x15ee 0x3eae 0x9414 0x1660 0x3fe3 0x9406 0x16d8 0x4118 0x93f7 0x174b 0x424c 0x93e8 0x17f4 0x4381 0x93d4 0x1871 0x44b5 0x93c0 0x18fc 0x45ea 0x93b1 0x19b4 0x471f 0x939b 0x1a83 0x4853 0x9380 0x1b42 0x4988 0x9365 0x1c00 0x4abc 0x934f 0x1cca 0x4bf1 0x9329 0x1dab 0x4d25 0x9304 0x1e95 0x4e5a 0x92dd 0x1f7f 0x4f8f 0x92b1 0x205b 0x50c3 0x9284 0x2160 0x51f8 0x9253 0x2258 0x532c 0x921e 0x2347 0x5461 0x91e3 0x2436 0x5596 0x91a7 0x255b 0x56ca 0x916c 0x2684 0x57ff 0x9131 0x27ad 0x5933 0x90f6 0x28e6 0x5a68 0x90c1 0x2a43 0x5b9d 0x9089 0x2bb7 0x5cd1 0x904c 0x2d3a 0x5e06 0x9001 0x2ec5 0x5f3a 0x8fb7 0x3075 0x606f 0x8f67 0x321d 0x61a3 0x8f0b 0x33ac 0x62d8 0x8e83 0x34ff 0x640d 0x8db6 0x3614 0x6541 0x8c69 0x372e 0x6676 0x8a60 0x3895 0x67aa 0x86f6 0x3c3e 0x68df 0x816f 0x323c 0x6a14 0x7896 0x1c20 0x6b48 0x7896 0x1c20 0x6c7d 0x7896 0x1c20 0x6db1 0x7896 0x1c20 0x6ee6 0x7896 0x1c20 0x701a 0x7896 0x1c20 0x714f 0x7896 0x1c20 0x7284 0x7896 0x1c20 0x73b8 0x7896 0x1c20 0x74ed 0x7896 0x1c20 0x7621 0x7896 0x1c20 0x7756 0x7896 0x1c20>;
		battery2_profile_t4_num = <0x64>;
		battery2_profile_t4 = <0x00 0xa6fe 0x2328 0x135 0xa5e7 0x2328 0x269 0xa4c2 0x2424 0x39e 0xa3a2 0x259c 0x4d2 0xa2a1 0x26e6 0x607 0xa1d8 0x280e 0x73c 0xa129 0x28d4 0x870 0xa095 0x2953 0x9a5 0xa020 0x29c1 0xad9 0x9f89 0x29bb 0xc0e 0x9ed9 0x2976 0xd42 0x9e15 0x28fe 0xe77 0x9d4e 0x286b 0xfac 0x9ca7 0x27f8 0x10e0 0x9c16 0x27a4 0x1215 0x9b97 0x276b 0x1349 0x9b22 0x2734 0x147e 0x9ab8 0x271a 0x15b3 0x9a4d 0x2720 0x16e7 0x99dc 0x2742 0x181c 0x996e 0x2742 0x1950 0x98f8 0x2718 0x1a85 0x9887 0x26ef 0x1bb9 0x9820 0x26dd 0x1cee 0x97b9 0x26cb 0x1e23 0x9760 0x26b8 0x1f57 0x9711 0x26b3 0x208c 0x96c8 0x26c5 0x21c0 0x9684 0x26d8 0x22f5 0x9646 0x26de 0x242a 0x960e 0x26e4 0x255e 0x95da 0x26f6 0x2693 0x95ad 0x271b 0x27c7 0x957c 0x2729 0x28fc 0x954c 0x2733 0x2a31 0x9526 0x2759 0x2b65 0x9508 0x277d 0x2c9a 0x94eb 0x27b7 0x2dce 0x94cf 0x2801 0x2f03 0x94b9 0x284c 0x3037 0x949c 0x28a6 0x316c 0x9482 0x290c 0x32a1 0x946c 0x297e 0x33d5 0x9456 0x2a01 0x350a 0x9440 0x2a92 0x363e 0x9426 0x2b1c 0x3773 0x9409 0x2ba3 0x38a8 0x93ea 0x2c5f 0x39dc 0x93cd 0x2d0a 0x3b11 0x93ac 0x2db7 0x3c45 0x9388 0x2e6e 0x3d7a 0x9362 0x2f17 0x3eae 0x9332 0x2fb0 0x3fe3 0x9302 0x3050 0x4118 0x92d5 0x3108 0x424c 0x92a1 0x31c4 0x4381 0x926d 0x3271 0x44b5 0x9239 0x3316 0x45ea 0x9206 0x33bc 0x471f 0x91ca 0x3477 0x4853 0x918f 0x353c 0x4988 0x9150 0x35fc 0x4abc 0x9107 0x36a1 0x4bf1 0x90b5 0x3739 0x4d25 0x905f 0x37ad 0x4e5a 0x900a 0x3819 0x4f8f 0x8fc0 0x38bf 0x50c3 0x8f6f 0x3927 0x51f8 0x8f0d 0x39a1 0x532c 0x8e88 0x3a27 0x5461 0x8d8e 0x3a71 0x5596 0x8b95 0x3af9 0x56ca 0x889f 0x3c19 0x57ff 0x8444 0x3939 0x5933 0x8174 0x3232 0x5a68 0x8174 0x3232 0x5b9d 0x8174 0x3232 0x5cd1 0x8174 0x3232 0x5e06 0x8174 0x3232 0x5f3a 0x8174 0x3232 0x606f 0x8174 0x3232 0x61a3 0x8174 0x3232 0x62d8 0x8174 0x3232 0x640d 0x8174 0x3232 0x6541 0x8174 0x3232 0x6676 0x8174 0x3232 0x67aa 0x8174 0x3232 0x68df 0x8174 0x3232 0x6a14 0x8174 0x3232 0x6b48 0x8174 0x3232 0x6c7d 0x8174 0x3232 0x6db1 0x8174 0x3232 0x6ee6 0x8174 0x3232 0x701a 0x8174 0x3232 0x714f 0x8174 0x3232 0x7284 0x8174 0x3232 0x73b8 0x8174 0x3232 0x74ed 0x8174 0x3232 0x7621 0x8174 0x3232 0x7756 0x8174 0x3232>;
		battery3_profile_t0_num = <0x64>;
		battery3_profile_t0 = <0x00 0xaa6e 0x460 0x135 0xaa42 0x460 0x269 0xa9d2 0x44d 0x39e 0xa943 0x441 0x4d2 0xa8c6 0x45f 0x607 0xa849 0x460 0x73c 0xa7cb 0x460 0x870 0xa74c 0x458 0x9a5 0xa6cf 0x43b 0xad9 0xa658 0x452 0xc0e 0xa5e1 0x460 0xd42 0xa568 0x45a 0xe77 0xa4eb 0x43c 0xfac 0xa474 0x438 0x10e0 0xa3fd 0x438 0x1215 0xa387 0x43d 0x1349 0xa318 0x45a 0x147e 0xa2a4 0x449 0x15b3 0xa231 0x445 0x16e7 0xa1c0 0x463 0x181c 0xa152 0x481 0x1950 0xa0de 0x472 0x1a85 0xa06d 0x46c 0x1bb9 0xa004 0x486 0x1cee 0x9f96 0x469 0x1e23 0x9f2b 0x475 0x1f57 0x9ec2 0x488 0x208c 0x9e5b 0x488 0x21c0 0x9dfc 0x4a6 0x22f5 0x9d96 0x49d 0x242a 0x9d2d 0x491 0x255e 0x9cc7 0x4af 0x2693 0x9c6e 0x4b0 0x27c7 0x9c19 0x4c2 0x28fc 0x9bc5 0x4d8 0x2a31 0x9b6c 0x4d8 0x2b65 0x9b1b 0x4f3 0x2c9a 0x9ac9 0x510 0x2dce 0x9a77 0x52e 0x2f03 0x9a26 0x54c 0x3037 0x99d5 0x582 0x316c 0x997c 0x5a0 0x32a1 0x9916 0x596 0x33d5 0x9899 0x55c 0x350a 0x980d 0x4d7 0x363e 0x9798 0x47a 0x3773 0x9741 0x45d 0x38a8 0x96f0 0x43f 0x39dc 0x96af 0x44f 0x3b11 0x9673 0x460 0x3c45 0x9639 0x460 0x3d7a 0x9604 0x460 0x3eae 0x95d0 0x460 0x3fe3 0x959d 0x455 0x4118 0x9569 0x438 0x424c 0x953c 0x456 0x4381 0x9515 0x460 0x44b5 0x94ee 0x460 0x45ea 0x94c2 0x460 0x471f 0x949c 0x460 0x4853 0x9477 0x473 0x4988 0x9454 0x490 0x4abc 0x9437 0x4ad 0x4bf1 0x9412 0x495 0x4d25 0x93f1 0x499 0x4e5a 0x93d5 0x4b6 0x4f8f 0x93bf 0x4d4 0x50c3 0x93a2 0x4d8 0x51f8 0x9384 0x4d8 0x532c 0x9363 0x4d3 0x5461 0x9330 0x4b6 0x5596 0x92e3 0x47f 0x56ca 0x929c 0x452 0x57ff 0x9264 0x43c 0x5933 0x923f 0x459 0x5a68 0x9214 0x460 0x5b9d 0x91e7 0x453 0x5cd1 0x91bc 0x43a 0x5e06 0x919f 0x457 0x5f3a 0x917b 0x460 0x606f 0x9156 0x46b 0x61a3 0x9131 0x488 0x62d8 0x90f6 0x488 0x640d 0x90b6 0x474 0x6541 0x9077 0x46a 0x6676 0x9044 0x487 0x67aa 0x8ff4 0x488 0x68df 0x8fb9 0x476 0x6a14 0x8f96 0x468 0x6b48 0x8f8f 0x486 0x6c7d 0x8f81 0x4a3 0x6db1 0x8f6d 0x4c1 0x6ee6 0x8f4a 0x4e5 0x701a 0x8ef9 0x520 0x714f 0x8da8 0x528 0x7284 0x8bca 0x567 0x73b8 0x895e 0x5f6 0x74ed 0x85f4 0x6ff 0x7621 0x7f1e 0x1902 0x7756 0x72a6 0x16d0>;
		battery3_profile_t1_num = <0x64>;
		battery3_profile_t1 = <0x00 0xaa3c 0x690 0x135 0xa9dc 0x690 0x269 0xa95f 0x690 0x39e 0xa8d3 0x690 0x4d2 0xa84f 0x690 0x607 0xa7d1 0x690 0x73c 0xa757 0x6a2 0x870 0xa6de 0x6b0 0x9a5 0xa661 0x693 0xad9 0xa5ea 0x690 0xc0e 0xa573 0x690 0xd42 0xa4fb 0x690 0xe77 0xa486 0x690 0xfac 0xa410 0x690 0x10e0 0xa39d 0x69f 0x1215 0xa32b 0x6b3 0x1349 0xa2b6 0x696 0x147e 0xa246 0x6a7 0x15b3 0xa1d7 0x6b8 0x16e7 0xa166 0x6bb 0x181c 0xa0f8 0x6d9 0x1950 0xa084 0x6ca 0x1a85 0xa013 0x6c4 0x1bb9 0x9fab 0x6e0 0x1cee 0x9f4b 0x6e0 0x1e23 0x9f09 0x749 0x1f57 0x9eca 0x7be 0x208c 0x9e79 0x7f7 0x21c0 0x9dcc 0x77f 0x22f5 0x9d18 0x71c 0x242a 0x9c73 0x6e9 0x255e 0x9bf6 0x707 0x2693 0x9b9a 0x708 0x27c7 0x9b5c 0x752 0x28fc 0x9b32 0x7c8 0x2a31 0x9b0c 0x840 0x2b65 0x9acc 0x82c 0x2c9a 0x9a81 0x820 0x2dce 0x9a2f 0x826 0x2f03 0x99d4 0x845 0x3037 0x9975 0x848 0x316c 0x9905 0x809 0x32a1 0x9885 0x78b 0x33d5 0x9809 0x6f8 0x350a 0x979c 0x695 0x363e 0x973f 0x64a 0x3773 0x96f0 0x618 0x38a8 0x96ae 0x618 0x39dc 0x9671 0x618 0x3b11 0x9639 0x618 0x3c45 0x9605 0x618 0x3d7a 0x95d2 0x618 0x3eae 0x95a3 0x618 0x3fe3 0x9576 0x624 0x4118 0x954a 0x63f 0x424c 0x951e 0x621 0x4381 0x94f6 0x62d 0x44b5 0x94d1 0x640 0x45ea 0x94ac 0x640 0x471f 0x9488 0x640 0x4853 0x9467 0x653 0x4988 0x9449 0x668 0x4abc 0x942c 0x668 0x4bf1 0x940e 0x684 0x4d25 0x93f0 0x67e 0x4e5a 0x93d4 0x66f 0x4f8f 0x93be 0x68d 0x50c3 0x93a8 0x690 0x51f8 0x938d 0x690 0x532c 0x9370 0x68a 0x5461 0x9353 0x66d 0x5596 0x9328 0x635 0x56ca 0x92ff 0x609 0x57ff 0x92da 0x5f4 0x5933 0x92b6 0x612 0x5a68 0x9290 0x630 0x5b9d 0x926b 0x640 0x5cd1 0x9247 0x643 0x5e06 0x922a 0x660 0x5f3a 0x9201 0x67e 0x606f 0x91ce 0x690 0x61a3 0x9193 0x691 0x62d8 0x9158 0x6af 0x640d 0x911d 0x6cd 0x6541 0x90dc 0x6eb 0x6676 0x9092 0x708 0x67aa 0x904e 0x726 0x68df 0x9029 0x744 0x6a14 0x9015 0x76a 0x6b48 0x9007 0x7a5 0x6c7d 0x8ff8 0x81a 0x6db1 0x8fdb 0x891 0x6ee6 0x8f87 0x8f7 0x701a 0x8eab 0x932 0x714f 0x8cc8 0x9bf 0x7284 0x8a41 0xab8 0x73b8 0x86c7 0xc8e 0x74ed 0x8136 0x1093 0x7621 0x776a 0x28b1 0x7756 0x7616 0x2378>;
		battery3_profile_t2_num = <0x64>;
		battery3_profile_t2 = <0x00 0xa866 0xf28 0x135 0xa833 0xf28 0x269 0xa7bb 0xf75 0x39e 0xa725 0xfda 0x4d2 0xa6a1 0x1015 0x607 0xa621 0x1035 0x73c 0xa5a2 0x1040 0x870 0xa526 0x1038 0x9a5 0xa4a9 0x101b 0xad9 0xa430 0x1018 0xc0e 0xa3bd 0x1029 0xd42 0xa34d 0x103a 0xe77 0xa2d8 0x101c 0xfac 0xa266 0x1032 0x10e0 0xa1f7 0x104f 0x1215 0xa189 0x1063 0x1349 0xa11a 0x1046 0x147e 0xa0aa 0x1040 0x15b3 0xa03e 0x1032 0x16e7 0x9fda 0x102e 0x181c 0x9f91 0x10fc 0x1950 0x9f46 0x11e4 0x1a85 0x9eef 0x1270 0x1bb9 0x9e84 0x1266 0x1cee 0x9ddb 0x11b6 0x1e23 0x9d25 0x10d8 0x1f57 0x9c7b 0x1020 0x208c 0x9bef 0xfc8 0x21c0 0x9b86 0xfc8 0x22f5 0x9b32 0xff0 0x242a 0x9aed 0x103d 0x255e 0x9ab3 0x10b3 0x2693 0x9a76 0x110e 0x27c7 0x9a37 0x1142 0x28fc 0x99f2 0x1158 0x2a31 0x99a9 0x1158 0x2b65 0x9957 0x113d 0x2c9a 0x98f5 0x10fd 0x2dce 0x9883 0x1092 0x2f03 0x9806 0xfe2 0x3037 0x9794 0xf61 0x316c 0x9730 0xf09 0x32a1 0x96da 0xed8 0x33d5 0x968e 0xed8 0x350a 0x964b 0xed8 0x363e 0x960f 0xed8 0x3773 0x95db 0xedc 0x38a8 0x95a7 0xefa 0x39dc 0x9574 0xf00 0x3b11 0x9543 0xf0d 0x3c45 0x9516 0xf28 0x3d7a 0x94ea 0xf28 0x3eae 0x94c3 0xf28 0x3fe3 0x949e 0xf33 0x4118 0x9479 0xf53 0x424c 0x945b 0xf8d 0x4381 0x9439 0xf8c 0x44b5 0x9416 0xf78 0x45ea 0x93f8 0xf78 0x471f 0x93e9 0xfb2 0x4853 0x93da 0x1001 0x4988 0x93cc 0x1052 0x4abc 0x93bd 0x108d 0x4bf1 0x93ae 0x10e3 0x4d25 0x93a4 0x1160 0x4e5a 0x9398 0x11e6 0x4f8f 0x9382 0x123e 0x50c3 0x9373 0x12e5 0x51f8 0x935c 0x1378 0x532c 0x933e 0x1402 0x5461 0x9321 0x14cf 0x5596 0x92f7 0x1584 0x56ca 0x92ca 0x1645 0x57ff 0x929e 0x1720 0x5933 0x927a 0x1829 0x5a68 0x9249 0x191a 0x5b9d 0x9212 0x1a21 0x5cd1 0x91d6 0x1b4e 0x5e06 0x919b 0x1c74 0x5f3a 0x915b 0x1daf 0x606f 0x9115 0x1ef5 0x61a3 0x90ca 0x203f 0x62d8 0x9081 0x2165 0x640d 0x9041 0x22b9 0x6541 0x900f 0x2454 0x6676 0x8ff2 0x2648 0x67aa 0x8fd4 0x2884 0x68df 0x8fac 0x2b2d 0x6a14 0x8f67 0x2e39 0x6b48 0x8eea 0x31ab 0x6c7d 0x8db1 0x354d 0x6db1 0x8bc5 0x3a08 0x6ee6 0x890b 0x4069 0x701a 0x852b 0x4998 0x714f 0x7d22 0x3f96 0x7284 0x7332 0x17e8 0x73b8 0x7332 0x17e8 0x74ed 0x7332 0x17e8 0x7621 0x7332 0x17e8 0x7756 0x7332 0x17e8>;
		battery3_profile_t3_num = <0x64>;
		battery3_profile_t3 = <0x00 0xa6cc 0x1ce8 0x135 0xa665 0x1ce8 0x269 0xa5be 0x1e2f 0x39e 0xa502 0x1fbe 0x4d2 0xa468 0x2051 0x607 0xa3d8 0x2091 0x73c 0xa350 0x20ba 0x870 0xa2ce 0x20d8 0x9a5 0xa251 0x20f5 0xad9 0xa1d1 0x20dd 0xc0e 0xa157 0x20d0 0xd42 0xa0e2 0x20dd 0xe77 0xa072 0x2119 0xfac 0xa023 0x21ef 0x10e0 0x9fc9 0x229f 0x1215 0x9f5c 0x22fa 0x1349 0x9edf 0x22dd 0x147e 0x9e4a 0x2276 0x15b3 0x9da3 0x21c7 0x16e7 0x9cf3 0x20e3 0x181c 0x9c61 0x2051 0x1950 0x9be2 0x2019 0x1a85 0x9b75 0x2015 0x1bb9 0x9b17 0x2038 0x1cee 0x9ace 0x2090 0x1e23 0x9a78 0x20be 0x1f57 0x9a22 0x20e7 0x208c 0x99d1 0x2120 0x21c0 0x9976 0x2120 0x22f5 0x991d 0x2120 0x242a 0x98c2 0x210b 0x255e 0x9860 0x20cf 0x2693 0x9801 0x2094 0x27c7 0x979c 0x2059 0x28fc 0x9739 0x201e 0x2a31 0x96df 0x1fe2 0x2b65 0x968e 0x1fe0 0x2c9a 0x9645 0x1fe0 0x2dce 0x9604 0x1fe8 0x2f03 0x95c9 0x2006 0x3037 0x958e 0x2008 0x316c 0x955b 0x203a 0x32a1 0x952e 0x208d 0x33d5 0x9502 0x20c8 0x350a 0x94db 0x2104 0x363e 0x94b6 0x2130 0x3773 0x9491 0x214d 0x38a8 0x946c 0x216b 0x39dc 0x945a 0x21ed 0x3b11 0x9447 0x2263 0x3c45 0x9432 0x22bc 0x3d7a 0x9423 0x2316 0x3eae 0x9414 0x23cc 0x3fe3 0x9406 0x248d 0x4118 0x93f7 0x2545 0x424c 0x93e8 0x2654 0x4381 0x93d4 0x271c 0x44b5 0x93c0 0x27fa 0x45ea 0x93b1 0x2921 0x471f 0x939b 0x2a6c 0x4853 0x9380 0x2b9d 0x4988 0x9365 0x2ccd 0x4abc 0x934f 0x2e10 0x4bf1 0x9329 0x2f78 0x4d25 0x9304 0x30ef 0x4e5a 0x92dd 0x3265 0x4f8f 0x92b1 0x33c5 0x50c3 0x9284 0x3566 0x51f8 0x9253 0x36f4 0x532c 0x921e 0x3872 0x5461 0x91e3 0x39f0 0x5596 0x91a7 0x3bc5 0x56ca 0x916c 0x3da0 0x57ff 0x9131 0x3f7c 0x5933 0x90f6 0x4170 0x5a68 0x90c1 0x439f 0x5b9d 0x9089 0x45f1 0x5cd1 0x904c 0x485c 0x5e06 0x9001 0x4ad4 0x5f3a 0x8fb7 0x4d88 0x606f 0x8f67 0x502f 0x61a3 0x8f0b 0x52ad 0x62d8 0x8e83 0x54cb 0x640d 0x8db6 0x5686 0x6541 0x8c69 0x5849 0x6676 0x8a60 0x5a88 0x67aa 0x86f6 0x6063 0x68df 0x816f 0x5060 0x6a14 0x7896 0x2d00 0x6b48 0x7896 0x2d00 0x6c7d 0x7896 0x2d00 0x6db1 0x7896 0x2d00 0x6ee6 0x7896 0x2d00 0x701a 0x7896 0x2d00 0x714f 0x7896 0x2d00 0x7284 0x7896 0x2d00 0x73b8 0x7896 0x2d00 0x74ed 0x7896 0x2d00 0x7621 0x7896 0x2d00 0x7756 0x7896 0x2d00>;
		battery3_profile_t4_num = <0x64>;
		battery3_profile_t4 = <0x00 0xa5b4 0x3840 0x135 0xa58f 0x3840 0x269 0xa4c2 0x39d4 0x39e 0xa3a2 0x3c2c 0x4d2 0xa2a1 0x3e3d 0x607 0xa1d8 0x4016 0x73c 0xa129 0x4154 0x870 0xa095 0x421e 0x9a5 0xa020 0x42ce 0xad9 0x9f89 0x42c6 0xc0e 0x9ed9 0x4257 0xd42 0x9e15 0x4197 0xe77 0x9d4e 0x40ac 0xfac 0x9ca7 0x3ff3 0x10e0 0x9c16 0x3f6c 0x1215 0x9b97 0x3f12 0x1349 0x9b22 0x3eba 0x147e 0x9ab8 0x3e91 0x15b3 0x9a4d 0x3e9a 0x16e7 0x99dc 0x3ed0 0x181c 0x996e 0x3ed0 0x1950 0x98f8 0x3e8d 0x1a85 0x9887 0x3e4c 0x1bb9 0x9820 0x3e2e 0x1cee 0x97b9 0x3e11 0x1e23 0x9760 0x3df3 0x1f57 0x9711 0x3deb 0x208c 0x96c8 0x3e08 0x21c0 0x9684 0x3e26 0x22f5 0x9646 0x3e30 0x242a 0x960e 0x3e39 0x255e 0x95da 0x3e57 0x2693 0x95ad 0x3e92 0x27c7 0x957c 0x3ea8 0x28fc 0x954c 0x3eb8 0x2a31 0x9526 0x3ef4 0x2b65 0x9508 0x3f2f 0x2c9a 0x94eb 0x3f8c 0x2dce 0x94cf 0x4002 0x2f03 0x94b9 0x407a 0x3037 0x949c 0x410a 0x316c 0x9482 0x41ad 0x32a1 0x946c 0x4263 0x33d5 0x9456 0x4335 0x350a 0x9440 0x441c 0x363e 0x9426 0x44fa 0x3773 0x9409 0x45d2 0x38a8 0x93ea 0x46ff 0x39dc 0x93cd 0x4810 0x3b11 0x93ac 0x4924 0x3c45 0x9388 0x4a49 0x3d7a 0x9362 0x4b58 0x3eae 0x9332 0x4c4d 0x3fe3 0x9302 0x4d4e 0x4118 0x92d5 0x4e74 0x424c 0x92a1 0x4fa1 0x4381 0x926d 0x50b5 0x44b5 0x9239 0x51bd 0x45ea 0x9206 0x52c6 0x471f 0x91ca 0x53f1 0x4853 0x91b4 0x5460 0x4988 0x91b4 0x5460 0x4abc 0x91b4 0x5460 0x4bf1 0x91b4 0x5460 0x4d25 0x91b4 0x5460 0x4e5a 0x91b4 0x5460 0x4f8f 0x91b4 0x5460 0x50c3 0x91b4 0x5460 0x51f8 0x91b4 0x5460 0x532c 0x91b4 0x5460 0x5461 0x91b4 0x5460 0x5596 0x91b4 0x5460 0x56ca 0x91b4 0x5460 0x57ff 0x91b4 0x5460 0x5933 0x91b4 0x5460 0x5a68 0x91b4 0x5460 0x5b9d 0x91b4 0x5460 0x5cd1 0x91b4 0x5460 0x5e06 0x91b4 0x5460 0x5f3a 0x91b4 0x5460 0x606f 0x91b4 0x5460 0x61a3 0x91b4 0x5460 0x62d8 0x91b4 0x5460 0x640d 0x91b4 0x5460 0x6541 0x91b4 0x5460 0x6676 0x91b4 0x5460 0x67aa 0x91b4 0x5460 0x68df 0x91b4 0x5460 0x6a14 0x91b4 0x5460 0x6b48 0x91b4 0x5460 0x6c7d 0x91b4 0x5460 0x6db1 0x91b4 0x5460 0x6ee6 0x91b4 0x5460 0x701a 0x91b4 0x5460 0x714f 0x91b4 0x5460 0x7284 0x91b4 0x5460 0x73b8 0x91b4 0x5460 0x74ed 0x91b4 0x5460 0x7621 0x91b4 0x5460 0x7756 0x91b4 0x5460>;
		linux,phandle = <0x78>;
		phandle = <0x78>;
	};

	topmisc@10011000 {
		compatible = "mediatek,topmisc";
		reg = <0x00 0x10011000 0x00 0x1000>;
	};

	dvfsrc@10012000 {
		compatible = "mediatek,dvfsrc";
		reg = <0x00 0x10012000 0x00 0x1000 0x00 0x110780 0x00 0x80>;
	};

	mbist_ao@10013000 {
		compatible = "mediatek,mbist_ao";
		reg = <0x00 0x10013000 0x00 0x1000>;
	};

	apcldmain_ao@10014000 {
		compatible = "mediatek,apcldmain_ao";
		reg = <0x00 0x10014000 0x00 0x400>;
	};

	apcldmaout_ao@10014400 {
		compatible = "mediatek,apcldmaout_ao";
		reg = <0x00 0x10014400 0x00 0x400>;
	};

	apcldmamisc_ao@10014800 {
		compatible = "mediatek,apcldmamisc_ao";
		reg = <0x00 0x10014800 0x00 0x400>;
	};

	ddrphy@10015000 {
		compatible = "mediatek,ddrphy";
		reg = <0x00 0x10015000 0x00 0x1000>;
	};

	aes_top0@10016000 {
		compatible = "mediatek,aes_top0";
		reg = <0x00 0x10016000 0x00 0x1000>;
	};

	sys_timer@10017000 {
		compatible = "mediatek,sys_timer";
		reg = <0x00 0x10017000 0x00 0x1000>;
		reg-names = "sys_timer_base";
		interrupts = <0x00 0xc2 0x04>;
	};

	modem_temp_share@10018000 {
		compatible = "mediatek,modem_temp_share";
		reg = <0x00 0x10018000 0x00 0x1000>;
	};

	security_ao@1001a000 {
		compatible = "mediatek,security_ao";
		reg = <0x00 0x1001a000 0x00 0x1000>;
	};

	topckgen_ao@1001b000 {
		compatible = "mediatek,topckgen_ao";
		reg = <0x00 0x1001b000 0x00 0x1000>;
	};

	dramc0@1001d000 {
		compatible = "mediatek,dramc0";
		reg = <0x00 0x1001d000 0x00 0x1000>;
	};

	ddrphy@1001e000 {
		compatible = "mediatek,ddrphy";
		reg = <0x00 0x1001e000 0x00 0x1000>;
	};

	iocfg_0@10002000 {
		compatible = "mediatek,iocfg_0";
		reg = <0x00 0x10002000 0x00 0x200>;
	};

	iocfg_1@10002200 {
		compatible = "mediatek,iocfg_1";
		reg = <0x00 0x10002200 0x00 0x200>;
	};

	iocfg_2@10002400 {
		compatible = "mediatek,iocfg_2";
		reg = <0x00 0x10002400 0x00 0x200>;
	};

	iocfg_3@10002600 {
		compatible = "mediatek,iocfg_3";
		reg = <0x00 0x10002600 0x00 0x200>;
	};

	iocfg_4@10002800 {
		compatible = "mediatek,iocfg_4";
		reg = <0x00 0x10002800 0x00 0x200>;
	};

	iocfg_5@10002a00 {
		compatible = "mediatek,iocfg_5";
		reg = <0x00 0x10002a00 0x00 0x200>;
	};

	mdcldmain_ao@10015000 {
		compatible = "mediatek,mdcldmain_ao";
		reg = <0x00 0x10015000 0x00 0x400>;
	};

	mdcldmaout_ao@10015400 {
		compatible = "mediatek,mdcldmaout_ao";
		reg = <0x00 0x10015400 0x00 0x400>;
	};

	mdcldmamisc_ao@10015800 {
		compatible = "mediatek,mdcldmamisc_ao";
		reg = <0x00 0x10015800 0x00 0x400>;
	};

	sys_cirq@10204000 {
		compatible = "mediatek,sys_cirq";
		reg = <0x00 0x10204000 0x00 0x1000>;
		mediatek,cirq_num = <0xd1>;
		mediatek,spi_start_offset = <0x48>;
		interrupts = <0x00 0x118 0x08>;
	};

	mcucfg@10200000 {
		compatible = "mediatek,mcucfg";
		reg = <0x00 0x10200000 0x00 0x1000>;
		interrupts = <0x00 0x00 0x08>;
	};

	mcucfg_mp0_counter@10200000 {
		compatible = "mediatek,mcucfg_mp0_counter";
		reg = <0x00 0x10200000 0x00 0x4000>;
	};

	m4u@10205000 {
		cell-index = <0x00>;
		compatible = "mediatek,iommu_v0";
		reg = <0x00 0x10205000 0x00 0x1000>;
		mediatek,larbs = <0x20 0x21 0x22 0x23>;
		interrupts = <0x00 0x9e 0x08>;
		#iommu-cells = <0x01>;
		linux,phandle = <0x4e>;
		phandle = <0x4e>;
	};

	devapc@10207000 {
		compatible = "mediatek,devapc";
		reg = <0x00 0x10207000 0x00 0x1000 0x00 0x1000e000 0x00 0x1000>;
		interrupts = <0x00 0x8e 0x08>;
		clocks = <0x24 0x28>;
		clock-names = "devapc-infra-clock";
	};

	bus_dbg@10208000 {
		compatible = "mediatek,bus_dbg-v2";
		reg = <0x00 0x10208000 0x00 0x1000 0x00 0x10001000 0x00 0x1000>;
		mediatek,bus_dbg_con_offset = <0x2fc>;
		interrupts = <0x00 0x8d 0x08>;
	};

	ap_ccif0@10209000 {
		compatible = "mediatek,ap_ccif0";
		reg = <0x00 0x10209000 0x00 0x1000>;
		interrupts = <0x00 0x94 0x08>;
	};

	md_ccif0@1020a000 {
		compatible = "mediatek,md_ccif0";
		reg = <0x00 0x1020a000 0x00 0x1000>;
	};

	ap_ccif1@1020b000 {
		compatible = "mediatek,ap_ccif1";
		reg = <0x00 0x1020b000 0x00 0x1000>;
		interrupts = <0x00 0x96 0x08>;
	};

	md_ccif1@1020c000 {
		compatible = "mediatek,md_ccif1";
		reg = <0x00 0x1020c000 0x00 0x1000>;
	};

	infra_mbist@1020d000 {
		compatible = "mediatek,infra_mbist";
		reg = <0x00 0x1020d000 0x00 0x1000>;
	};

	infracfg@1020e000 {
		compatible = "mediatek,infracfg";
		reg = <0x00 0x1020e000 0x00 0x1000>;
	};

	trng@1020f000 {
		compatible = "mediatek,trng";
		reg = <0x00 0x1020f000 0x00 0x1000>;
		interrupts = <0x00 0xa1 0x08>;
	};

	dxcc_sec@10210000 {
		compatible = "mediatek,dxcc_sec";
		reg = <0x00 0x10210000 0x00 0x1000>;
		interrupts = <0x00 0xa2 0x04>;
	};

	mcupm_sram2@10211000 {
		compatible = "mediatek,mcupm_sram2";
		reg = <0x00 0x10211000 0x00 0x1000>;
	};

	cq_dma@10212000 {
		compatible = "mediatek,mt-cqdma-v1";
		reg = <0x00 0x10212000 0x00 0x80 0x00 0x10212080 0x00 0x80>;
		interrupts = <0x00 0x71 0x08 0x00 0x72 0x08>;
		nr_channel = <0x02>;
		keep_clock_ao = "yes";
		clocks = <0x24 0x43>;
		clock-names = "cqdma";
	};

	mcupm_sram3@10213000 {
		compatible = "mediatek,mcupm_sram3";
		reg = <0x00 0x10213000 0x00 0x1000>;
	};

	sramrom@10214000 {
		compatible = "mediatek,sramrom";
		reg = <0x00 0x10214000 0x00 0x1000>;
	};

	mcupm_reg@10216000 {
		compatible = "mediatek,mcupm_reg";
		reg = <0x00 0x10216000 0x00 0x1000>;
	};

	mcupm_sram0@10217000 {
		compatible = "mediatek,mcupm_sram0";
		reg = <0x00 0x10217000 0x00 0x1000>;
	};

	mcupm_sram1@10218000 {
		compatible = "mediatek,mcupm_sram1";
		reg = <0x00 0x10218000 0x00 0x1000>;
	};

	emi@10219000 {
		compatible = "mediatek,emi";
		reg = <0x00 0x10219000 0x00 0x1000 0x00 0x10226000 0x00 0x1000 0x00 0x1022d000 0x00 0x1000 0x00 0x10235000 0x00 0x1000>;
		interrupts = <0x00 0x90 0x08>;
	};

	apcldmain@1021b000 {
		compatible = "mediatek,apcldmain";
		reg = <0x00 0x1021b000 0x00 0x00>;
	};

	apcldmaout@1021b400 {
		compatible = "mediatek,apcldmaout";
		reg = <0x00 0x1021b400 0x00 0x00>;
	};

	apcldmamisc@1021b800 {
		compatible = "mediatek,apcldmamisc";
		reg = <0x00 0x1021b800 0x00 0x00>;
		interrupts = <0x00 0xa5 0x04>;
	};

	mdcldmain@1021c000 {
		compatible = "mediatek,mdcldmain";
		reg = <0x00 0x1021c000 0x00 0x400>;
	};

	mdcldmaout@1021c400 {
		compatible = "mediatek,mdcldmaout";
		reg = <0x00 0x1021c400 0x00 0x400>;
	};

	mdcldmamisc@1021c800 {
		compatible = "mediatek,mdcldmamisc";
		reg = <0x00 0x1021c800 0x00 0x1000>;
	};

	mdcldma@10014000 {
		compatible = "mediatek,mdcldma";
		reg = <0x00 0x10014000 0x00 0x1000 0x00 0x1021b000 0x00 0x1000 0x00 0x10209000 0x00 0x1000 0x00 0x1020a000 0x00 0x1000>;
		interrupts = <0x00 0xa5 0x04 0x00 0x94 0x08 0x00 0x95 0x08 0x00 0x105 0x02>;
		mediatek,md_id = <0x00>;
		mediatek,cldma_capability = <0x06>;
		clocks = <0x25 0x00 0x24 0x32 0x24 0x29 0x24 0x2c 0x24 0x23 0x24 0x24 0x24 0x51 0x24 0x52>;
		clock-names = "scp-sys-md1-main", "infra-cldma-bclk", "infra-ccif-ap", "infra-ccif-md", "infra-ccif1-ap", "infra-ccif1-md", "infra-ccif2-ap", "infra-ccif2-md";
		linux,phandle = <0x1c>;
		phandle = <0x1c>;
	};

	dramc_nao@1021d000 {
		compatible = "mediatek,dramc_nao";
		reg = <0x00 0x1021d000 0x00 0x1000>;
	};

	bpi_bsi_slv0@1021e000 {
		compatible = "mediatek,bpi_bsi_slv0";
		reg = <0x00 0x1021e000 0x00 0x1000>;
	};

	bpi_bsi_slv1@1021f000 {
		compatible = "mediatek,bpi_bsi_slv1";
		reg = <0x00 0x1021f000 0x00 0x6000>;
	};

	bpi_bsi_slv2@10225000 {
		compatible = "mediatek,bpi_bsi_slv2";
		reg = <0x00 0x10225000 0x00 0x1000>;
	};

	dvfsp@10227000 {
		compatible = "mediatek,dvfsp";
		reg = <0x00 0x10227000 0x00 0x1000>;
	};

	dvfsp@00110800 {
		compatible = "mediatek,mt6765-dvfsp";
		reg = <0x00 0x110800 0x00 0x1400 0x00 0x110800 0x00 0x1400>;
	};

	eem_fsm@1100b000 {
		compatible = "mediatek,eem_fsm";
		reg = <0x00 0x1100b000 0x00 0x1000>;
		interrupts = <0x00 0x7d 0x08>;
	};

	dramc@1022a000 {
		compatible = "mediatek,dramc";
		reg = <0x00 0x1022a000 0x00 0x2000 0x00 0x10232000 0x00 0x2000 0x00 0x1022c000 0x00 0x1000 0x00 0x10234000 0x00 0x1000 0x00 0x10228000 0x00 0x2000 0x00 0x10230000 0x00 0x2000 0x00 0x1022e000 0x00 0x1000 0x00 0x10236000 0x00 0x1000>;
	};

	gce@10238000 {
		compatible = "mediatek,gce", "syscon";
		reg = <0x00 0x10238000 0x00 0x4000>;
		#clock-cells = <0x01>;
		interrupts = <0x00 0x9a 0x08 0x00 0x9b 0x08>;
		g3d_config_base = <0x13000000 0x00 0xffff0000>;
		mmsys_config_base = <0x14000000 0x01 0xffff0000>;
		disp_dither_base = <0x14010000 0x02 0xffff0000>;
		mm_na_base = <0x14020000 0x03 0xffff0000>;
		imgsys_base = <0x15020000 0x04 0xffff0000>;
		vdec_gcon_base = <0x18800000 0x05 0xffff0000>;
		venc_gcon_base = <0x18810000 0x06 0xffff0000>;
		conn_peri_base = <0x18820000 0x07 0xffff0000>;
		topckgen_base = <0x18830000 0x08 0xffff0000>;
		kp_base = <0x18840000 0x09 0xffff0000>;
		scp_sram_base = <0x10000000 0x0a 0xffff0000>;
		infra_na3_base = <0x10010000 0x0b 0xffff0000>;
		infra_na4_base = <0x10020000 0x0c 0xffff0000>;
		scp_base = <0x10030000 0x0d 0xffff0000>;
		mcucfg_base = <0x10040000 0x0e 0xffff0000>;
		gcpu_base = <0x10050000 0x0f 0xffff0000>;
		usb0_base = <0x10200000 0x10 0xffff0000>;
		usb_sif_base = <0x10280000 0x11 0xffff0000>;
		audio_base = <0x17000000 0x12 0xffff0000>;
		vdec_base = <0x17010000 0x13 0xffff0000>;
		msdc2_base = <0x17020000 0x14 0xffff0000>;
		vdec1_base = <0x17030000 0x15 0xffff0000>;
		msdc3_base = <0x18000000 0x16 0xffff0000>;
		ap_dma_base = <0x18010000 0x17 0xffff0000>;
		gce_base = <0x18020000 0x18 0xffff0000>;
		vdec2_base = <0x18040000 0x19 0xffff0000>;
		vdec3_base = <0x18050000 0x1a 0xffff0000>;
		camsys_base = <0x18080000 0x1b 0xffff0000>;
		camsys1_base = <0x180a0000 0x1c 0xffff0000>;
		camsys2_base = <0x180b0000 0x1d 0xffff0000>;
		pwm_sw_base = <0x1100e000 0x63 0xffff0000>;
		mipitx0_base = <0x11c80000 0x63 0xffff0000>;
		mdp_rdma0_sof = <0x00>;
		mdp_ccorr0_sof = <0x01>;
		mdp_rsz0_sof = <0x02>;
		mdp_rsz1_sof = <0x03>;
		mdp_wdma_sof = <0x04>;
		mdp_wrot0_sof = <0x05>;
		mdp_tdshp0_sof = <0x06>;
		disp_ovl0_sof = <0x07>;
		disp_2l_ovl0_sof = <0x08>;
		disp_rdma0_sof = <0x09>;
		disp_wdma0_sof = <0x0a>;
		disp_color0_sof = <0x0b>;
		disp_ccorr0_sof = <0x0c>;
		disp_aal0_sof = <0x0d>;
		disp_gamma0_sof = <0x0e>;
		disp_dither0_sof = <0x0f>;
		disp_dsi0_sof = <0x10>;
		disp_rsz0_sof = <0x11>;
		img_dl_relay_sof = <0x12>;
		disp_pwm0_sof = <0x13>;
		mdp_rdma0_frame_done = <0x14>;
		mdp_ccorr0_frame_done = <0x15>;
		mdp_rsz0_frame_done = <0x16>;
		mdp_rsz1_frame_done = <0x17>;
		mdp_wrot0_write_frame_done = <0x18>;
		mdp_wdma_frame_done = <0x19>;
		mdp_tdshp0_frame_done = <0x1a>;
		disp_ovl0_frame_done = <0x1b>;
		disp_2l_ovl0_frame_done = <0x1c>;
		disp_rsz0_frame_done = <0x1d>;
		disp_rdma0_frame_done = <0x1e>;
		disp_wdma0_frame_done = <0x1f>;
		disp_color0_frame_done = <0x20>;
		disp_ccorr0_frame_done = <0x21>;
		disp_aal0_frame_done = <0x22>;
		disp_gamma0_frame_done = <0x23>;
		disp_dither0_frame_done = <0x24>;
		disp_dsi0_frame_done = <0x25>;
		stream_done_0 = <0x82>;
		stream_done_1 = <0x83>;
		stream_done_2 = <0x84>;
		stream_done_3 = <0x85>;
		stream_done_4 = <0x86>;
		stream_done_5 = <0x87>;
		stream_done_6 = <0x88>;
		stream_done_7 = <0x89>;
		stream_done_8 = <0x8a>;
		stream_done_9 = <0x8b>;
		buf_underrun_event_0 = <0x8c>;
		dsi0_te_event = <0x8d>;
		dsi0_irq_event = <0x8e>;
		dsi0_done_event = <0x8f>;
		disp_wdma0_rst_done = <0x93>;
		mdp_wdma_rst_done = <0x94>;
		mdp_wrot0_rst_done = <0x95>;
		mdp_rdma0_rst_done = <0x97>;
		disp_ovl0_frame_rst_done_pusle = <0x98>;
		dip_cq_thread0_frame_done = <0x101>;
		dip_cq_thread1_frame_done = <0x102>;
		dip_cq_thread2_frame_done = <0x103>;
		dip_cq_thread3_frame_done = <0x104>;
		dip_cq_thread4_frame_done = <0x105>;
		dip_cq_thread5_frame_done = <0x106>;
		dip_cq_thread6_frame_done = <0x107>;
		dip_cq_thread7_frame_done = <0x108>;
		dip_cq_thread8_frame_done = <0x109>;
		dip_cq_thread9_frame_done = <0x10a>;
		dip_cq_thread10_frame_done = <0x10b>;
		dip_cq_thread11_frame_done = <0x10c>;
		dip_cq_thread12_frame_done = <0x10d>;
		dip_cq_thread13_frame_done = <0x10e>;
		dip_cq_thread14_frame_done = <0x10f>;
		dip_cq_thread15_frame_done = <0x110>;
		dip_cq_thread16_frame_done = <0x111>;
		dip_cq_thread17_frame_done = <0x112>;
		dip_cq_thread18_frame_done = <0x113>;
		dve_frame_done = <0x114>;
		wmf_frame_done = <0x115>;
		rsc_frame_done = <0x116>;
		venc_done = <0x121>;
		jpgenc_done = <0x122>;
		jpgdec_done = <0x123>;
		venc_mb_done = <0x124>;
		venc_128byte_cnt_done = <0x125>;
		max_prefetch_cnt = <0x01>;
		prefetch_size = <0x60>;
		sram_size_cpr_64 = <0x40>;
		mmsys_config = <0x26>;
		mdp_rdma0 = <0x27>;
		mdp_rsz0 = <0x28>;
		mdp_rsz1 = <0x29>;
		mdp_wdma0 = <0x2a>;
		mdp_wrot0 = <0x2b>;
		mdp_tdshp0 = <0x2c>;
		mdp_color0 = <0x2d>;
		mdp_ccorr0 = <0x2e>;
		mm_mutex = <0x2f>;
		sram_share_cnt = <0x01>;
		sram_share_engine = <0x0a>;
		sram_share_event = <0x2c6>;
		clocks = <0x24 0x09 0x24 0x18>;
		clock-names = "GCE", "GCE_TIMER";
		mediatek,mailbox-gce = <0x30>;
		thread_count = <0x10>;
		secure_thread = <0x08 0x0a>;
		mboxes = <0x30 0x00 0x00 0x04 0x30 0x01 0x00 0x04 0x30 0x02 0x00 0x05 0x30 0x03 0x00 0x04 0x30 0x04 0x00 0x04 0x30 0x05 0x00 0x04 0x30 0x06 0x00 0x03 0x30 0x07 0xffffffff 0x02 0x30 0x08 0x00 0x01 0x30 0x09 0x00 0x01 0x30 0x0a 0x00 0x01 0x30 0x0b 0x00 0x01 0x30 0x0c 0x00 0x01 0x30 0x0d 0x00 0x01 0x30 0x0e 0x00 0x01 0x30 0x0f 0x00 0x01>;
		linux,phandle = <0x79>;
		phandle = <0x79>;
	};

	gce_mbox@10238000 {
		compatible = "mediatek,mt6761-gce";
		reg = <0x00 0x10238000 0x00 0x4000>;
		interrupts = <0x00 0x9a 0x08 0x00 0x9b 0x08>;
		#mbox-cells = <0x03>;
		#gce-event-cells = <0x01>;
		#gce-subsys-cells = <0x02>;
		clocks = <0x24 0x09 0x24 0x18>;
		clock-names = "gce", "gce-timer";
		linux,phandle = <0x30>;
		phandle = <0x30>;
	};

	gce_mbox_svp@10238000 {
		compatible = "mediatek,mailbox-gce-svp";
		reg = <0x00 0x10238000 0x00 0x4000>;
		interrupts = <0x00 0x9a 0x08 0x00 0x9b 0x08>;
		#mbox-cells = <0x03>;
		clocks = <0x24 0x09 0x24 0x18>;
		clock-names = "gce", "gce-timer";
		linux,phandle = <0x7a>;
		phandle = <0x7a>;
	};

	ap_ccif2@1023c000 {
		compatible = "mediatek,ap_ccif2";
		reg = <0x00 0x1023c000 0x00 0x1000>;
		interrupts = <0x00 0x8f 0x08>;
	};

	md_ccif2@1023d000 {
		compatible = "mediatek,md_ccif2";
		reg = <0x00 0x1023d000 0x00 0x1000>;
	};

	ap_ccif3@1023e000 {
		compatible = "mediatek,ap_ccif3";
		reg = <0x00 0x1023e000 0x00 0x1000>;
		interrupts = <0x00 0x92 0x08>;
	};

	md_ccif3@1023f000 {
		compatible = "mediatek,md_ccif3";
		reg = <0x00 0x1023f000 0x00 0x1000>;
	};

	sspm@10440000 {
		compatible = "mediatek,sspm";
		reg = <0x00 0x10440000 0x00 0x10000 0x00 0x10450000 0x00 0x100 0x00 0x10451000 0x00 0x08 0x00 0x10460000 0x00 0x100 0x00 0x10461000 0x00 0x08 0x00 0x10470000 0x00 0x100 0x00 0x10471000 0x00 0x08 0x00 0x10480000 0x00 0x100 0x00 0x10481000 0x00 0x08 0x00 0x10490000 0x00 0x100 0x00 0x10491000 0x00 0x08>;
		reg-names = "cfgreg", "mbox0_base", "mbox0_ctrl", "mbox1_base", "mbox1_ctrl", "mbox2_base", "mbox2_ctrl", "mbox3_base", "mbox3_ctrl", "mbox4_base", "mbox4_ctrl";
		interrupts = <0x00 0xca 0x04 0x00 0xcd 0x04 0x00 0xce 0x04 0x00 0xcf 0x04 0x00 0xd0 0x04 0x00 0xd1 0x04>;
		interrupt-names = "ipc", "mbox0", "mbox1", "mbox2", "mbox3", "mbox4";
	};

	gic500@0c000000 {
		compatible = "mediatek,gic500";
		reg = <0x00 0xc000000 0x00 0x1000>;
	};

	gic_cpu@0c400000 {
		compatible = "mediatek,gic_cpu";
		reg = <0x00 0xc400000 0x00 0x40000>;
	};

	dfd@10200b00 {
		compatible = "mediatek,dfd";
		reg = <0x00 0x10200b00 0x00 0x10000>;
		mediatek,enabled = <0x01>;
		mediatek,chain_length = <0xc350>;
		mediatek,rg_dfd_timeout = <0xa0>;
	};

	dbg_cti@0d020000 {
		compatible = "mediatek,dbg_cti";
		reg = <0x00 0xd020000 0x00 0x10000>;
	};

	dbg_etr@0d030000 {
		compatible = "mediatek,dbg_etr";
		reg = <0x00 0xd030000 0x00 0x10000>;
	};

	dbg_funnel@0d040000 {
		compatible = "mediatek,dbg_funnel";
		reg = <0x00 0xd040000 0x00 0x10000>;
	};

	dbg_dem@0d0a0000 {
		compatible = "mediatek,dbg_dem";
		reg = <0x00 0xd0a0000 0x00 0x10000>;
		interrupts = <0x00 0x8c 0x08>;
	};

	dbg_mdsys1@0d0c0000 {
		compatible = "mediatek,dbg_mdsys1";
		reg = <0x00 0xd0c0000 0x00 0x40000>;
	};

	dbg_apmcu_mp0@0d400000 {
		compatible = "mediatek,dbg_apmcu_mp0";
		reg = <0x00 0xd400000 0x00 0x1000>;
	};

	dbg_apmcu_mp0@0d410000 {
		compatible = "mediatek,dbg_apmcu_mp0";
		reg = <0x00 0xd410000 0x00 0x1000>;
	};

	dbg_apmcu_mp0@0d420000 {
		compatible = "mediatek,dbg_apmcu_mp0";
		reg = <0x00 0xd420000 0x00 0x1000>;
	};

	dbg_apmcu_mp0@0d430000 {
		compatible = "mediatek,dbg_apmcu_mp0";
		reg = <0x00 0xd430000 0x00 0x1000>;
	};

	dbg_apmcu_mp0@0d440000 {
		compatible = "mediatek,dbg_apmcu_mp0";
		reg = <0x00 0xd440000 0x00 0x1000>;
	};

	dbg_apmcu_mp0@0d510000 {
		compatible = "mediatek,dbg_apmcu_mp0";
		reg = <0x00 0xd510000 0x00 0x1000>;
	};

	dbg_apmcu_mp0@0d520000 {
		compatible = "mediatek,dbg_apmcu_mp0";
		reg = <0x00 0xd520000 0x00 0x1000>;
	};

	dbg_apmcu_mp0@0d530000 {
		compatible = "mediatek,dbg_apmcu_mp0";
		reg = <0x00 0xd530000 0x00 0x1000>;
	};

	dbg_apmcu_mp0@0d540000 {
		compatible = "mediatek,dbg_apmcu_mp0";
		reg = <0x00 0xd540000 0x00 0x1000>;
	};

	dbg_apmcu_mp0@0d610000 {
		compatible = "mediatek,dbg_apmcu_mp0";
		reg = <0x00 0xd610000 0x00 0x1000>;
	};

	dbg_apmcu_mp0@0d620000 {
		compatible = "mediatek,dbg_apmcu_mp0";
		reg = <0x00 0xd620000 0x00 0x1000>;
	};

	dbg_apmcu_mp0@0d630000 {
		compatible = "mediatek,dbg_apmcu_mp0";
		reg = <0x00 0xd630000 0x00 0x1000>;
	};

	dbg_apmcu_mp0@0d640000 {
		compatible = "mediatek,dbg_apmcu_mp0";
		reg = <0x00 0xd640000 0x00 0x1000>;
	};

	dbg_apmcu_mp0@0d710000 {
		compatible = "mediatek,dbg_apmcu_mp0";
		reg = <0x00 0xd710000 0x00 0x1000>;
	};

	dbg_apmcu_mp0@0d720000 {
		compatible = "mediatek,dbg_apmcu_mp0";
		reg = <0x00 0xd720000 0x00 0x1000>;
	};

	dbg_apmcu_mp0@0d730000 {
		compatible = "mediatek,dbg_apmcu_mp0";
		reg = <0x00 0xd730000 0x00 0x1000>;
	};

	dbg_apmcu_mp0@0d740000 {
		compatible = "mediatek,dbg_apmcu_mp0";
		reg = <0x00 0xd740000 0x00 0x1000>;
	};

	dbg_apmcu_mp1@0d800000 {
		compatible = "mediatek,dbg_apmcu_mp1";
		reg = <0x00 0xd800000 0x00 0x1000>;
	};

	dbg_apmcu_mp1@0d810000 {
		compatible = "mediatek,dbg_apmcu_mp1";
		reg = <0x00 0xd810000 0x00 0x1000>;
	};

	dbg_apmcu_mp1@0d820000 {
		compatible = "mediatek,dbg_apmcu_mp1";
		reg = <0x00 0xd820000 0x00 0x1000>;
	};

	dbg_apmcu_mp1@0d830000 {
		compatible = "mediatek,dbg_apmcu_mp1";
		reg = <0x00 0xd830000 0x00 0x1000>;
	};

	dbg_apmcu_mp1@0d840000 {
		compatible = "mediatek,dbg_apmcu_mp1";
		reg = <0x00 0xd840000 0x00 0x1000>;
	};

	dbg_apmcu_mp1@0d910000 {
		compatible = "mediatek,dbg_apmcu_mp1";
		reg = <0x00 0xd910000 0x00 0x1000>;
	};

	dbg_apmcu_mp1@0d920000 {
		compatible = "mediatek,dbg_apmcu_mp1";
		reg = <0x00 0xd920000 0x00 0x1000>;
	};

	dbg_apmcu_mp1@0d930000 {
		compatible = "mediatek,dbg_apmcu_mp1";
		reg = <0x00 0xd930000 0x00 0x1000>;
	};

	dbg_apmcu_mp1@0d940000 {
		compatible = "mediatek,dbg_apmcu_mp1";
		reg = <0x00 0xd940000 0x00 0x1000>;
	};

	dbg_apmcu_mp1@0da10000 {
		compatible = "mediatek,dbg_apmcu_mp1";
		reg = <0x00 0xda10000 0x00 0x1000>;
	};

	dbg_apmcu_mp1@0da20000 {
		compatible = "mediatek,dbg_apmcu_mp1";
		reg = <0x00 0xda20000 0x00 0x1000>;
	};

	dbg_apmcu_mp1@0da30000 {
		compatible = "mediatek,dbg_apmcu_mp1";
		reg = <0x00 0xda30000 0x00 0x1000>;
	};

	dbg_apmcu_mp1@0da40000 {
		compatible = "mediatek,dbg_apmcu_mp1";
		reg = <0x00 0xda40000 0x00 0x1000>;
	};

	dbg_apmcu_mp1@0db10000 {
		compatible = "mediatek,dbg_apmcu_mp1";
		reg = <0x00 0xdb10000 0x00 0x1000>;
	};

	dbg_apmcu_mp1@0db20000 {
		compatible = "mediatek,dbg_apmcu_mp1";
		reg = <0x00 0xdb20000 0x00 0x1000>;
	};

	dbg_apmcu_mp1@0db30000 {
		compatible = "mediatek,dbg_apmcu_mp1";
		reg = <0x00 0xdb30000 0x00 0x1000>;
	};

	dbg_apmcu_mp1@0db40000 {
		compatible = "mediatek,dbg_apmcu_mp1";
		reg = <0x00 0xdb40000 0x00 0x1000>;
	};

	ap_dma@11000000 {
		compatible = "mediatek,ap_dma";
		reg = <0x00 0x11000000 0x00 0x1000>;
		interrupts = <0x00 0x61 0x08>;
	};

	auxadc@11001000 {
		compatible = "mediatek,mt6765-auxadc";
		reg = <0x00 0x11001000 0x00 0x1000>;
		interrupts = <0x00 0x4c 0x02>;
		clocks = <0x24 0x21>;
		clock-names = "main";
		#io-channel-cells = <0x01>;
		linux,phandle = <0x7b>;
		phandle = <0x7b>;
	};

	dma-controller@11000580 {
		compatible = "mediatek,mt6577-uart-dma";
		reg = <0x00 0x11000680 0x00 0x80 0x00 0x11000700 0x00 0x80 0x00 0x11000780 0x00 0x80 0x00 0x11000800 0x00 0x80>;
		interrupts = <0x00 0x6d 0x08 0x00 0x6e 0x08 0x00 0x6f 0x08 0x00 0x74 0x08>;
		clocks = <0x24 0x26>;
		clock-names = "apdma";
		#dma-cells = <0x01>;
		linux,phandle = <0x31>;
		phandle = <0x31>;
	};

	serial@11020000 {
		compatible = "mediatek,mt6758-uart", "mediatek,mt6577-uart";
		reg = <0x00 0x11002000 0x00 0x1000>;
		interrupts = <0x00 0x5b 0x08>;
		clocks = <0x1f 0x24 0x16>;
		clock-names = "baud", "bus";
		dmas = <0x31 0x00 0x31 0x01>;
		dma-names = "tx", "rx";
		linux,phandle = <0x7c>;
		phandle = <0x7c>;
	};

	serial@11030000 {
		compatible = "mediatek,mt6758-uart", "mediatek,mt6577-uart";
		reg = <0x00 0x11003000 0x00 0x1000>;
		interrupts = <0x00 0x5c 0x08>;
		clocks = <0x1f 0x24 0x17>;
		clock-names = "baud", "bus";
		linux,phandle = <0x7d>;
		phandle = <0x7d>;
	};

	i2c_common {
		compatible = "mediatek,i2c_common";
		dma_support = [02];
		idvfs = [01];
		set_dt_div = [01];
		check_max_freq = [01];
		ver = [02];
		set_ltiming = [01];
		ext_time_config = [18 01];
		cnt_constraint = [01];
		linux,phandle = <0x7e>;
		phandle = <0x7e>;
	};

	i2c0@11007000 {
		compatible = "mediatek,i2c";
		id = <0x00>;
		reg = <0x00 0x11007000 0x00 0x1000 0x00 0x11000080 0x00 0x80>;
		interrupts = <0x00 0x54 0x08>;
		clocks = <0x24 0x0b 0x24 0x26>;
		clock-names = "main", "dma";
		clock-div = <0x05>;
		scl-gpio-id = <0x53>;
		sda-gpio-id = <0x52>;
		gpio_start = <0x10002a00>;
		mem_len = <0x200>;
		eh_cfg = <0x20>;
		pu_cfg = <0x50>;
		rsel_cfg = <0x70>;
		aed = <0x1a>;
		mediatek,hs_only;
		linux,phandle = <0x7f>;
		phandle = <0x7f>;
	};

	i2c1@11008000 {
		compatible = "mediatek,i2c";
		id = <0x01>;
		reg = <0x00 0x11008000 0x00 0x1000 0x00 0x11000100 0x00 0x80>;
		interrupts = <0x00 0x55 0x08>;
		clocks = <0x24 0x0b 0x24 0x26>;
		clock-names = "main", "dma";
		clock-div = <0x05>;
		scl-gpio-id = <0x54>;
		sda-gpio-id = <0x51>;
		gpio_start = <0x10002a00>;
		mem_len = <0x200>;
		eh_cfg = <0x20>;
		pu_cfg = <0x50>;
		rsel_cfg = <0x70>;
		aed = <0x1a>;
		mediatek,hs_only;
		linux,phandle = <0x80>;
		phandle = <0x80>;
	};

	i2c2@11009000 {
		compatible = "mediatek,i2c";
		id = <0x02>;
		reg = <0x00 0x11009000 0x00 0x1000 0x00 0x11000180 0x00 0x180>;
		interrupts = <0x00 0x56 0x08>;
		clocks = <0x24 0x0b 0x24 0x26>;
		clock-names = "main", "dma";
		clock-div = <0x05>;
		scl-gpio-id = <0x67>;
		sda-gpio-id = <0x68>;
		gpio_start = <0x10002800>;
		mem_len = <0x200>;
		eh_cfg = <0x20>;
		pu_cfg = <0x60>;
		rsel_cfg = <0xa0>;
		aed = <0x1a>;
		ch_offset_default = <0x100>;
		ch_offset_ccu = <0x200>;
		mediatek,hs_only;
		linux,phandle = <0x81>;
		phandle = <0x81>;
	};

	i2c3@1100f000 {
		compatible = "mediatek,i2c";
		id = <0x03>;
		reg = <0x00 0x1100f000 0x00 0x1000 0x00 0x11000300 0x00 0x100>;
		interrupts = <0x00 0x57 0x08>;
		clocks = <0x24 0x0b 0x24 0x26>;
		clock-names = "main", "dma";
		clock-div = <0x05>;
		scl-gpio-id = <0x32>;
		sda-gpio-id = <0x33>;
		gpio_start = <0x10002600>;
		mem_len = <0x200>;
		eh_cfg = <0x20>;
		pu_cfg = <0x90>;
		rsel_cfg = <0xb0>;
		aed = <0x1a>;
		ch_offset_default = <0x100>;
		mediatek,hs_only;
		linux,phandle = <0x82>;
		phandle = <0x82>;
	};

	i2c4@11011000 {
		compatible = "mediatek,i2c";
		id = <0x04>;
		reg = <0x00 0x11011000 0x00 0x1000 0x00 0x11000400 0x00 0x180>;
		interrupts = <0x00 0x58 0x08>;
		clocks = <0x24 0x0b 0x24 0x26>;
		clock-names = "main", "dma";
		clock-div = <0x05>;
		scl-gpio-id = <0x69>;
		sda-gpio-id = <0x6a>;
		gpio_start = <0x10002800>;
		mem_len = <0x200>;
		eh_cfg = <0x20>;
		pu_cfg = <0x60>;
		rsel_cfg = <0xa0>;
		aed = <0x1a>;
		ch_offset_default = <0x100>;
		ch_offset_ccu = <0x200>;
		mediatek,hs_only;
		linux,phandle = <0x83>;
		phandle = <0x83>;
	};

	i2c5@11016000 {
		compatible = "mediatek,i2c";
		id = <0x05>;
		reg = <0x00 0x11016000 0x00 0x1000 0x00 0x11000580 0x00 0x80>;
		interrupts = <0x00 0x82 0x08>;
		clocks = <0x24 0x0b 0x24 0x26>;
		clock-names = "main", "dma";
		clock-div = <0x05>;
		scl-gpio-id = <0x30>;
		sda-gpio-id = <0x31>;
		gpio_start = <0x10002600>;
		mem_len = <0x200>;
		eh_cfg = <0x20>;
		pu_cfg = <0x90>;
		rsel_cfg = <0xb0>;
		aed = <0x1a>;
		mediatek,hs_only;
		linux,phandle = <0x84>;
		phandle = <0x84>;
	};

	i2c6@1100d000 {
		compatible = "mediatek,i2c";
		id = <0x06>;
		reg = <0x00 0x1100d000 0x00 0x1000 0x00 0x11000600 0x00 0x80>;
		interrupts = <0x00 0x83 0x08>;
		clocks = <0x24 0x0b 0x24 0x26>;
		clock-names = "main", "dma";
		clock-div = <0x05>;
		scl-gpio-id = <0xa1>;
		sda-gpio-id = <0xa2>;
		gpio_start = <0x10002c00>;
		mem_len = <0x200>;
		eh_cfg = <0x20>;
		pu_cfg = <0x50>;
		rsel_cfg = <0x70>;
		aed = <0x1a>;
		ch_offset_default = <0x100>;
		ch_offset_ccu = <0x200>;
		mediatek,hs_only;
		linux,phandle = <0x85>;
		phandle = <0x85>;
	};

	pwm@11006000 {
		compatible = "mediatek,pwm";
		reg = <0x00 0x11006000 0x00 0x10000>;
		interrupts = <0x00 0x4d 0x08>;
		clocks = <0x24 0x10 0x24 0x11 0x24 0x12 0x24 0x13 0x24 0x14 0x24 0x30 0x24 0x0f 0x24 0x15>;
		clock-names = "PWM1-main", "PWM2-main", "PWM3-main", "PWM4-main", "PWM5-main", "PWM6-main", "PWM-HCLK-main", "PWM-main";
		linux,phandle = <0x86>;
		phandle = <0x86>;
	};

	spi@1100a000 {
		compatible = "mediatek,mt6765-spi";
		mediatek,pad-select = <0x00>;
		reg = <0x00 0x1100a000 0x00 0x1000>;
		interrupts = <0x00 0x76 0x08>;
		clocks = <0x1e 0x0b 0x1e 0x6b 0x24 0x1b>;
		clock-names = "parent-clk", "sel-clk", "spi-clk";
		linux,phandle = <0x87>;
		phandle = <0x87>;
	};

	therm_ctrl@1100b000 {
		compatible = "mediatek,therm_ctrl";
		reg = <0x00 0x1100b000 0x00 0x1000>;
		interrupts = <0x00 0x4e 0x08>;
		clocks = <0x24 0x0a>;
		clock-names = "therm-main";
	};

	tboard_thermistor1 {
		compatible = "mediatek,mtboard-thermistor1";
		io-channels = <0x7b 0x00>;
		io-channel-names = "thermistor-ch0";
	};

	tboard_thermistor2 {
		compatible = "mediatek,mtboard-thermistor2";
		io-channels = <0x7b 0x01>;
		io-channel-names = "thermistor-ch1";
	};

	tboard_thermistor3 {
		compatible = "mediatek,mtboard-thermistor3";
		io-channels = <0x7b 0x02>;
		io-channel-names = "thermistor-ch2";
	};

	btif@1100c000 {
		compatible = "mediatek,btif";
		reg = <0x00 0x1100c000 0x00 0x1000 0x00 0x11000880 0x00 0x80 0x00 0x11000900 0x00 0x80>;
		interrupts = <0x00 0x70 0x08 0x00 0x84 0x08 0x00 0x85 0x08>;
		clocks = <0x24 0x1a 0x24 0x26>;
		clock-names = "btifc", "apdmac";
	};

	consys@18002000 {
		compatible = "mediatek,mt6765-consys";
		#address-cells = <0x02>;
		#size-cells = <0x02>;
		reg = <0x00 0x18002000 0x00 0x1000 0x00 0x10007000 0x00 0x100 0x00 0x10001000 0x00 0x1000 0x00 0x10006000 0x00 0x1000 0x00 0x18007000 0x00 0x1000 0x00 0x180b1000 0x00 0x1000 0x00 0x180a3000 0x00 0x1000 0x00 0x180a5000 0x00 0x800 0x00 0x180c1000 0x00 0x1000 0x00 0x18004000 0x00 0x1000 0x00 0x00 0x00 0x00 0x00 0x00 0x00 0x00 0x00 0x1020e000 0x00 0x1000>;
		interrupts = <0x00 0x10b 0x08 0x00 0x10d 0x08 0x00 0x10e 0x01>;
		clocks = <0x25 0x01>;
		clock-names = "conn";
		linux,phandle = <0x1b>;
		phandle = <0x1b>;
	};

	wifi@18000000 {
		compatible = "mediatek,wifi";
		reg = <0x00 0x18000000 0x00 0x100000>;
		interrupts = <0x00 0x10c 0x08>;
	};

	disp_pwm@1100e000 {
		compatible = "mediatek,disp_pwm";
		reg = <0x00 0x1100e000 0x00 0x1000>;
	};

	spi@11010000 {
		compatible = "mediatek,mt6765-spi";
		mediatek,pad-select = <0x00>;
		reg = <0x00 0x11010000 0x00 0x1000>;
		interrupts = <0x00 0x7a 0x08>;
		clocks = <0x1e 0x0b 0x1e 0x6b 0x24 0x34>;
		clock-names = "parent-clk", "sel-clk", "spi-clk";
		linux,phandle = <0x88>;
		phandle = <0x88>;
	};

	spi@11012000 {
		compatible = "mediatek,mt6765-spi";
		mediatek,pad-select = <0x00>;
		reg = <0x00 0x11012000 0x00 0x1000>;
		interrupts = <0x00 0x80 0x08>;
		clocks = <0x1e 0x0b 0x1e 0x6b 0x24 0x37>;
		clock-names = "parent-clk", "sel-clk", "spi-clk";
		linux,phandle = <0x89>;
		phandle = <0x89>;
	};

	spi@11013000 {
		compatible = "mediatek,mt6765-spi";
		mediatek,pad-select = <0x00>;
		reg = <0x00 0x11013000 0x00 0x1000>;
		interrupts = <0x00 0x81 0x08>;
		clocks = <0x1e 0x0b 0x1e 0x6b 0x24 0x38>;
		clock-names = "parent-clk", "sel-clk", "spi-clk";
		linux,phandle = <0x8a>;
		phandle = <0x8a>;
	};

	spi@11014000 {
		compatible = "mediatek,mt6765-spi";
		mediatek,pad-select = <0x00>;
		reg = <0x00 0x11014000 0x00 0x1000>;
		interrupts = <0x00 0x5f 0x08>;
		clocks = <0x1e 0x0b 0x1e 0x6b 0x24 0x41>;
		clock-names = "parent-clk", "sel-clk", "spi-clk";
		linux,phandle = <0x8b>;
		phandle = <0x8b>;
	};

	spi@11015000 {
		compatible = "mediatek,mt6765-spi";
		mediatek,pad-select = <0x00>;
		reg = <0x00 0x11015000 0x00 0x1000>;
		interrupts = <0x00 0x60 0x08>;
		clocks = <0x1e 0x0b 0x1e 0x6b 0x24 0x42>;
		clock-names = "parent-clk", "sel-clk", "spi-clk";
		linux,phandle = <0x8c>;
		phandle = <0x8c>;
	};

	imp_iic@11017000 {
		compatible = "mediatek,imp_iic";
		reg = <0x00 0x11017000 0x00 0x1000>;
	};

	nfi@11018000 {
		compatible = "mediatek,nfi";
		reg = <0x00 0x11018000 0x00 0x1000>;
	};

	nfiecc@11019000 {
		compatible = "mediatek,nfiecc";
		reg = <0x00 0x11019000 0x00 0x1000>;
	};

	usb0@11200000 {
		compatible = "mediatek,mt6765-usb20";
		reg = <0x00 0x11200000 0x00 0x10000 0x00 0x11cc0000 0x00 0x10000>;
		interrupts = <0x00 0x49 0x08>;
		mode = <0x02>;
		multipoint = <0x01>;
		num_eps = <0x10>;
		clocks = <0x24 0x08 0x1e 0x76 0x1e 0x20>;
		clock-names = "usb0", "usb0_clk_top_sel", "usb0_clk_univpll3_d4";
	};

	usb_sif@11210000 {
		compatible = "mediatek,usb_sif";
		reg = <0x00 0x11210000 0x00 0x10000>;
	};

	msdc@11230000 {
		compatible = "mediatek,msdc";
		reg = <0x00 0x11230000 0x00 0x10000>;
		interrupts = <0x00 0x4f 0x08>;
		index = [00];
		clk_src = [01];
		bus-width = <0x08>;
		max-frequency = <0xbebc200>;
		cap-mmc-highspeed;
		mmc-ddr-1_8v;
		mmc-hs200-1_8v;
		mmc-hs400-1_8v;
		no-sd;
		no-sdio;
		non-removable;
		pinctl = <0x32>;
		pinctl_hs400 = <0x33>;
		pinctl_hs200 = <0x34>;
		register_setting = <0x35>;
		host_function = [00];
		bootable;
		status = "okay";
		vmmc-supply = <0x36>;
		clocks = <0x24 0x4c 0x24 0x1c 0x24 0x44>;
		clock-names = "msdc0-clock", "msdc0-hclock", "msdc0-aes-clock";
		linux,phandle = <0x8d>;
		phandle = <0x8d>;
	};

	msdc@11240000 {
		compatible = "mediatek,msdc";
		reg = <0x00 0x11240000 0x00 0x10000>;
		interrupts = <0x00 0x50 0x08>;
		index = [01];
		clk_src = [02];
		bus-width = <0x04>;
		max-frequency = <0xbebc200>;
		cap-sd-highspeed;
		sd-uhs-sdr12;
		sd-uhs-sdr25;
		sd-uhs-sdr50;
		sd-uhs-sdr104;
		sd-uhs-ddr50;
		no-mmc;
		no-sdio;
		pinctl = <0x37>;
		pinctl_sdr104 = <0x38>;
		pinctl_sdr50 = <0x39>;
		pinctl_ddr50 = <0x3a>;
		register_setting = <0x3b>;
		host_function = [01];
		cd_level = [00];
		cd-gpios = <0x3c 0x01 0x00>;
		status = "okay";
		vmmc-supply = <0x3d>;
		vqmmc-supply = <0x3e>;
		clocks = <0x24 0x4d 0x24 0x1d>;
		clock-names = "msdc1-clock", "msdc1-hclock";
		linux,phandle = <0x8e>;
		phandle = <0x8e>;
	};

	msdc@11250000 {
		compatible = "mediatek,msdc2";
		reg = <0x00 0x11250000 0x00 0x10000>;
		status = "disable";
		linux,phandle = <0x8f>;
		phandle = <0x8f>;
	};

	msdc@11260000 {
		compatible = "mediatek,msdc3";
		reg = <0x00 0x11250000 0x00 0x10000>;
		status = "disable";
		linux,phandle = <0x90>;
		phandle = <0x90>;
	};

	msdc1_ins@0 {
		compatible = "mediatek,mt6765-sdcard-ins";
		linux,phandle = <0x91>;
		phandle = <0x91>;
	};

	msdc0_top@11cd0000 {
		compatible = "mediatek,msdc0_top";
		reg = <0x00 0x11cd0000 0x00 0x1000>;
	};

	msdc1_top@11c90000 {
		compatible = "mediatek,msdc1_top";
		reg = <0x00 0x11c90000 0x00 0x1000>;
	};

	usb1p_sif@11210000 {
		compatible = "mediatek,usb1p_sif";
		reg = <0x00 0x11210000 0x00 0x10000>;
	};

	audio@11220000 {
		compatible = "mediatek,audio", "syscon";
		reg = <0x00 0x11220000 0x00 0x1000>;
		#clock-cells = <0x01>;
		mediatek,btcvsd_snd = <0x3f>;
		linux,phandle = <0x40>;
		phandle = <0x40>;
	};

	mt_soc_dl1_pcm@11220000 {
		compatible = "mediatek,mt_soc_pcm_dl1";
		reg = <0x00 0x11220000 0x00 0x1000>;
		interrupts = <0x00 0x99 0x08>;
		clocks = <0x40 0x00 0x40 0x04 0x40 0x05 0x40 0x03 0x40 0x01 0x40 0x02 0x40 0x06 0x24 0x2b 0x24 0x33 0x1e 0x6f 0x1e 0x70 0x1e 0x03 0x1e 0x71 0x1e 0x29 0x1e 0x72 0x1e 0x2c 0x41 0x08 0x1f>;
		clock-names = "aud_afe_clk", "aud_dac_clk", "aud_dac_predis_clk", "aud_adc_clk", "aud_apll22m_clk", "aud_apll1_tuner_clk", "aud_tml_clk", "aud_infra_clk", "mtkaif_26m_clk", "top_mux_audio", "top_mux_audio_int", "top_sys_pll1_d4", "top_mux_aud_1", "top_apll1_ck", "top_mux_aud_eng1", "top_apll1_d8", "apmixed_apll1", "top_clk26m_clk";
		linux,phandle = <0x92>;
		phandle = <0x92>;
	};

	audio_sram@11221000 {
		compatible = "mediatek,audio_sram";
		reg = <0x00 0x11221000 0x00 0x9000>;
	};

	mtk-btcvsd-snd@18050000 {
		compatible = "mediatek,mtk-btcvsd-snd";
		reg = <0x00 0x18050000 0x00 0x1000 0x00 0x18080000 0x00 0x10000>;
		interrupts = <0x00 0x10a 0x08>;
		mediatek,infracfg = <0x24>;
		mediatek,offset = <0xf00 0x800 0x140 0x144 0x148>;
		linux,phandle = <0x3f>;
		phandle = <0x3f>;
	};

	mipi_rx_ana_csi0a@11c10000 {
		compatible = "mediatek,mipi_rx_ana_csi0a", "syscon";
		reg = <0x00 0x11c10000 0x00 0x1000>;
		#clock-cells = <0x01>;
		linux,phandle = <0x48>;
		phandle = <0x48>;
	};

	mipi_rx_ana_csi0b@11c11000 {
		compatible = "mediatek,mipi_rx_ana_csi0b", "syscon";
		reg = <0x00 0x11c11000 0x00 0x1000>;
		#clock-cells = <0x01>;
		linux,phandle = <0x49>;
		phandle = <0x49>;
	};

	mipi_rx_ana_csi1a@11c12000 {
		compatible = "mediatek,mipi_rx_ana_csi1a", "syscon";
		reg = <0x00 0x11c12000 0x00 0x1000>;
		#clock-cells = <0x01>;
		linux,phandle = <0x4a>;
		phandle = <0x4a>;
	};

	mipi_rx_ana_csi1b@11c13000 {
		compatible = "mediatek,mipi_rx_ana_csi1b", "syscon";
		reg = <0x00 0x11c13000 0x00 0x1000>;
		#clock-cells = <0x01>;
		linux,phandle = <0x4b>;
		phandle = <0x4b>;
	};

	mipi_rx_ana_csi2a@11c14000 {
		compatible = "mediatek,mipi_rx_ana_csi2a", "syscon";
		reg = <0x00 0x11c14000 0x00 0x1000>;
		#clock-cells = <0x01>;
		linux,phandle = <0x4c>;
		phandle = <0x4c>;
	};

	mipi_rx_ana_csi2b@11c15000 {
		compatible = "mediatek,mipi_rx_ana_csi2b", "syscon";
		reg = <0x00 0x11c15000 0x00 0x1000>;
		#clock-cells = <0x01>;
		linux,phandle = <0x4d>;
		phandle = <0x4d>;
	};

	efusec@11c50000 {
		compatible = "mediatek,devinfo";
		reg = <0x00 0x11c50000 0x00 0x10000>;
		#address-cells = <0x01>;
		#size-cells = <0x01>;
		segment@78 {
			reg = <0x78 0x04>;
		};
		segment@1c {
			reg = <0x1c 0x04>;
		};
		segment@190 {
			reg = <0x190 0x0c>;
		};
		ly@210 {
			reg = <0x210 0x04>;
		};
	};

	mipi_tx0@11c80000 {
		compatible = "mediatek,mipi_tx0";
		reg = <0x00 0x11c80000 0x00 0x10000>;
	};

	msdc1_pad_macro@11c90000 {
		compatible = "mediatek,msdc1_pad_macro";
		reg = <0x00 0x11c90000 0x00 0x10000>;
	};

	msdc0_pad_macro@11cd0000 {
		compatible = "mediatek,msdc0_pad_macro";
		reg = <0x00 0x11cd0000 0x00 0x10000>;
	};

	mfg_doma@13000000 {
		compatible = "mediatek,doma";
		reg = <0x00 0x13000000 0x00 0x80000>;
		interrupts = <0x00 0x103 0x08>;
		interrupt-names = "RGX";
		clock-frequency = <0x21f98280>;
	};

	mfg_cfg@13ffe000 {
		compatible = "mediatek,mfgcfg", "syscon";
		reg = <0x00 0x13ffe000 0x00 0x1000>;
		#clock-cells = <0x01>;
		linux,phandle = <0x93>;
		phandle = <0x93>;
	};

	gpufreq {
		compatible = "mediatek,mt6765-gpufreq";
		clocks = <0x1e 0x64 0x1e 0x26 0x1f 0x25 0x08 0x25 0x04 0x25 0x07>;
		clock-names = "clk_mux", "clk_main_parent", "clk_sub_parent", "mtcmos_mfg_async", "mtcmos_mfg", "mtcmos_mfg_core0";
	};

	mmsys_config@14000000 {
		compatible = "mediatek,mmsys_config", "mediatek,mt6765-mmsys_config", "syscon";
		reg = <0x00 0x14000000 0x00 0x1000>;
		interrupts = <0x00 0xe3 0x08>;
		#clock-cells = <0x01>;
		clocks = <0x26 0x17 0x26 0x1a 0x26 0x1b>;
		clock-names = "CAM_MDP", "IMG_DL_RELAY", "IMG_DL_ASYNC_TOP";
		linux,phandle = <0x26>;
		phandle = <0x26>;
	};

	nfc {
		compatible = "mediatek,nfc-gpio-v2";
		gpio-rst = <0xac>;
		gpio-rst-std = <0x3c 0xac 0x00>;
		gpio-irq = <0x0a>;
		gpio-irq-std = <0x3c 0x0a 0x00>;
		linux,phandle = <0x94>;
		phandle = <0x94>;
	};

	irq_nfc {
		compatible = "mediatek,irq_nfc-eint";
		linux,phandle = <0x95>;
		phandle = <0x95>;
	};

	disp_mutex0@14001000 {
		compatible = "mediatek,disp_mutex0";
		reg = <0x00 0x14001000 0x00 0x1000>;
		interrupts = <0x00 0xd2 0x08>;
		linux,phandle = <0x2f>;
		phandle = <0x2f>;
	};

	smi_common@14002000 {
		compatible = "mediatek,smi_common";
		mediatek,smi-id = <0x04>;
		mediatek,smi-cnt = <0x05>;
		reg = <0x00 0x14002000 0x00 0x1000>;
		nr_larbs = <0x04>;
		larbs = <0x20 0x21 0x22 0x23>;
		mmsys_config = <0x26>;
		clocks = <0x25 0x03 0x26 0x15 0x26 0x16 0x26 0x13 0x1e 0x62 0x1e 0x21 0x1e 0x17 0x1e 0x22>;
		clock-names = "mtcmos-mm", "smi-common-gals-comm0", "smi-common-gals-comm1", "smi-common", "mmdvfs_clk_mm_sel_ck", "mmdvfs_clk_mmpll_ck", "mmdvfs_clk_univpll1_d2_ck", "mmdvfs_clk_mmpll_d2_ck";
	};

	mmdvfs_pmqos {
		compatible = "mediatek,mmdvfs_pmqos";
		mm_step0 = <0x1c9 0x01 0x00 0x01>;
		mm_step1 = <0x138 0x01 0x00 0x02>;
		mm_step2 = <0xe4 0x01 0x00 0x03>;
		vopp_steps = <0x00 0x01 0x03>;
		disp_freq = "mm_step0", "mm_step1", "mm_step2";
		mdp_freq = "mm_step0", "mm_step1", "mm_step2";
		cam_freq = "mm_step0", "mm_step1", "mm_step2";
		img_freq = "mm_step0", "mm_step1", "mm_step2";
		vdec_freq = "mm_step0", "mm_step1", "mm_step2";
		venc_freq = "mm_step0", "mm_step1", "mm_step2";
		clocks = <0x1e 0x62 0x1e 0x21 0x1e 0x17 0x1e 0x22>;
		clock-names = "mmdvfs_clk_mm_sel_ck", "mmdvfs_clk_mmpll_ck", "mmdvfs_clk_univpll1_d2_ck", "mmdvfs_clk_mmpll_d2_ck";
	};

	imgsys@15020000 {
		compatible = "mediatek,mt6765-imgsys", "mediatek,imgsys", "syscon";
		reg = <0x00 0x15020000 0x00 0x1000>;
		#clock-cells = <0x01>;
		clocks = <0x25 0x03 0x25 0x05 0x25 0x09 0x42 0x01 0x43 0x02 0x43 0x03 0x43 0x04 0x43 0x05 0x43 0x06 0x43 0x07>;
		clock-names = "ISP_SCP_SYS_DIS", "ISP_SCP_SYS_ISP", "ISP_SCP_SYS_CAM", "ISP_CLK_IMG_DIP", "ISP_CLK_CAM", "ISP_CLK_CAMTG", "ISP_CLK_CAM_SENINF", "ISP_CLK_CAMSV0", "ISP_CLK_CAMSV1", "ISP_CLK_CAMSV2";
		linux,phandle = <0x42>;
		phandle = <0x42>;
	};

	dip1@15022000 {
		compatible = "mediatek,dip1";
		reg = <0x00 0x15022000 0x00 0x3000>;
		interrupts = <0x00 0xff 0x08>;
	};

	dpe@15028000 {
		compatible = "mediatek,dpe";
		reg = <0x00 0x15028000 0x00 0x1000>;
		interrupts = <0x00 0x100 0x08>;
		clocks = <0x42 0x03>;
		clock-names = "DPE_CG_IMG_DPE";
	};

	smi_larb0@14003000 {
		cell-index = <0x00>;
		compatible = "mediatek,smi_larb0", "mediatek,smi_larb";
		mediatek,smi-id = <0x00>;
		reg = <0x00 0x14003000 0x00 0x1000>;
		clocks = <0x25 0x03 0x26 0x14>;
		clock-names = "mtcmos-mm", "mm-larb0";
		linux,phandle = <0x20>;
		phandle = <0x20>;
	};

	mdp_rdma0@14004000 {
		compatible = "mediatek,mdp_rdma0";
		reg = <0x00 0x14004000 0x00 0x1000>;
		interrupts = <0x00 0xd3 0x08>;
		clocks = <0x26 0x00>;
		clock-names = "MDP_RDMA0";
		linux,phandle = <0x27>;
		phandle = <0x27>;
	};

	mdp_ccorr0@14005000 {
		compatible = "mediatek,mdp_ccorr0";
		reg = <0x00 0x14005000 0x00 0x1000>;
		interrupts = <0x00 0xe2 0x08>;
		clocks = <0x26 0x01>;
		clock-names = "MDP_CCORR";
		linux,phandle = <0x2e>;
		phandle = <0x2e>;
	};

	mdp_rsz0@14006000 {
		compatible = "mediatek,mdp_rsz0";
		reg = <0x00 0x14006000 0x00 0x1000>;
		interrupts = <0x00 0xd4 0x08>;
		clocks = <0x26 0x02>;
		clock-names = "MDP_RSZ0";
		linux,phandle = <0x28>;
		phandle = <0x28>;
	};

	mdp_rsz1@14007000 {
		compatible = "mediatek,mdp_rsz1";
		reg = <0x00 0x14007000 0x00 0x1000>;
		interrupts = <0x00 0xd5 0x08>;
		clocks = <0x26 0x03>;
		clock-names = "MDP_RSZ1";
		linux,phandle = <0x29>;
		phandle = <0x29>;
	};

	mdp_wdma0@14008000 {
		compatible = "mediatek,mdp_wdma0";
		reg = <0x00 0x14008000 0x00 0x1000>;
		interrupts = <0x00 0xd8 0x08>;
		clocks = <0x26 0x06>;
		clock-names = "MDP_WDMA";
		linux,phandle = <0x2a>;
		phandle = <0x2a>;
	};

	mdp_wrot0@14009000 {
		compatible = "mediatek,mdp_wrot0";
		reg = <0x00 0x14009000 0x00 0x1000>;
		interrupts = <0x00 0xd7 0x08>;
		clocks = <0x26 0x05>;
		clock-names = "MDP_WROT0";
		linux,phandle = <0x2b>;
		phandle = <0x2b>;
	};

	mdp_tdshp0@1400a000 {
		compatible = "mediatek,mdp_tdshp0";
		reg = <0x00 0x1400a000 0x00 0x1000>;
		clocks = <0x26 0x04>;
		clock-names = "MDP_TDSHP";
		linux,phandle = <0x2c>;
		phandle = <0x2c>;
	};

	disp_ovl0@1400b000 {
		compatible = "mediatek,disp_ovl0";
		reg = <0x00 0x1400b000 0x00 0x1000>;
		interrupts = <0x00 0xd9 0x08>;
	};

	disp_ovl0_2l@1400c000 {
		compatible = "mediatek,disp_ovl0_2l";
		reg = <0x00 0x1400c000 0x00 0x1000>;
		interrupts = <0x00 0xe5 0x08>;
	};

	disp_rdma0@1400d000 {
		compatible = "mediatek,disp_rdma0";
		reg = <0x00 0x1400d000 0x00 0x1000>;
		interrupts = <0x00 0xda 0x08>;
	};

	disp_wdma0@1400e000 {
		compatible = "mediatek,disp_wdma0";
		reg = <0x00 0x1400e000 0x00 0x1000>;
		interrupts = <0x00 0xdb 0x08>;
	};

	disp_color0@1400f000 {
		compatible = "mediatek,disp_color0";
		reg = <0x00 0x1400f000 0x00 0x1000>;
		interrupts = <0x00 0xdc 0x08>;
		clocks = <0x26 0x0c>;
		clock-names = "MDP_COLOR";
		linux,phandle = <0x2d>;
		phandle = <0x2d>;
	};

	disp_ccorr0@14010000 {
		compatible = "mediatek,disp_ccorr0";
		reg = <0x00 0x14010000 0x00 0x1000>;
		interrupts = <0x00 0xdd 0x08>;
	};

	disp_aal0@14011000 {
		compatible = "mediatek,disp_aal0";
		reg = <0x00 0x14011000 0x00 0x1000>;
		interrupts = <0x00 0xde 0x08>;
	};

	disp_gamma0@14012000 {
		compatible = "mediatek,disp_gamma0";
		reg = <0x00 0x14012000 0x00 0x1000>;
		interrupts = <0x00 0xdf 0x08>;
	};

	disp_dither0@14013000 {
		compatible = "mediatek,disp_dither0";
		reg = <0x00 0x14013000 0x00 0x1000>;
		interrupts = <0x00 0xe0 0x08>;
	};

	dsi0@14014000 {
		compatible = "mediatek,dsi0";
		reg = <0x00 0x14014000 0x00 0x1000>;
		interrupts = <0x00 0xe1 0x08>;
	};

	disp_rsz0@14015000 {
		compatible = "mediatek,disp_rsz0";
		reg = <0x00 0x14015000 0x00 0x1000>;
		interrupts = <0x00 0x114 0x08>;
	};

	mtkfb@0 {
		compatible = "mediatek,MTKFB", "mediatek,mtkfb";
		linux,phandle = <0x96>;
		phandle = <0x96>;
	};

	dispsys {
		compatible = "mediatek,dispsys";
		mediatek,larb = <0x20>;
		clocks = <0x25 0x03 0x26 0x13 0x26 0x14 0x26 0x15 0x26 0x16 0x26 0x07 0x26 0x08 0x26 0x0a 0x26 0x0b 0x26 0x0c 0x26 0x0d 0x26 0x0e 0x26 0x0f 0x26 0x10 0x26 0x11 0x26 0x1c 0x26 0x1d 0x26 0x09 0x41 0x15 0x1e 0x73 0x24 0x31 0x1f 0x1e 0x1b 0x1e 0x2e 0x1e 0x30>;
		clock-names = "MMSYS_MTCMOS", "MMSYS_SMI_COMMON", "MMSYS_SMI_LARB0", "MMSYS_GALS_COMM0", "MMSYS_GALS_COMM1", "MMSYS_DISP_OVL0", "MMSYS_DISP_OVL0_2L", "MMSYS_DISP_RDMA0", "MMSYS_DISP_WDMA0", "MMSYS_DISP_COLOR0", "MMSYS_DISP_CCORR0", "MMSYS_DISP_AAL0", "MMSYS_DISP_GAMMA0", "MMSYS_DISP_DITHER0", "MMSYS_DSI0_MM_CK", "MMSYS_DSI0_IF_CK", "MMSYS_26M", "MMSYS_DISP_RSZ0", "APMIXED_MIPI_26M", "TOP_MUX_DISP_PWM", "DISP_PWM", "TOP_26M", "TOP_UNIVPLL2_D4", "TOP_ULPOSC1_D2", "TOP_ULPOSC1_D8";
	};

	swtp {
		compatible = "mediatek, swtp-eint";
		linux,phandle = <0x97>;
		phandle = <0x97>;
	};

	dsi_te {
		compatible = "mediatek, DSI_TE-eint";
		status = "disabled";
		linux,phandle = <0x98>;
		phandle = <0x98>;
	};

	smi_larb2@15021000 {
		cell-index = <0x02>;
		compatible = "mediatek,smi_larb2", "mediatek,smi_larb";
		mediatek,smi-id = <0x02>;
		reg = <0x00 0x15021000 0x00 0x1000>;
		clocks = <0x25 0x05 0x26 0x18 0x42 0x00>;
		clock-names = "mtcmos-isp", "gals-img2mm", "img-larb2";
		linux,phandle = <0x22>;
		phandle = <0x22>;
	};

	fdvt@1502b000 {
		compatible = "mediatek,fdvt";
		reg = <0x00 0x1502b000 0x00 0x1000>;
		interrupts = <0x00 0x102 0x08>;
		clocks = <0x42 0x02>;
		clock-names = "FD_CLK_IMG_FDVT";
	};

	venc_gcon@17000000 {
		compatible = "mediatek,mt6765-vcodecsys", "mediatek,venc_gcon", "syscon";
		reg = <0x00 0x17000000 0x00 0x10000>;
		clocks = <0x25 0x03 0x25 0x0a 0x26 0x15 0x26 0x16 0x26 0x13 0x44 0x03 0x44 0x01>;
		clock-names = "MT_SCP_SYS_DIS", "MT_SCP_SYS_VCODEC", "MT_CG_MM_SMI_COMM0", "MT_CG_MM_SMI_COMM1", "MT_CG_MM_SMI_COMMON", "MT_CG_VDEC", "MT_CG_VENC";
		#clock-cells = <0x01>;
		linux,phandle = <0x44>;
		phandle = <0x44>;
	};

	smi_larb1@17010000 {
		cell-index = <0x01>;
		compatible = "mediatek,smi_larb1", "mediatek,smi_larb";
		mediatek,smi-id = <0x01>;
		reg = <0x00 0x17010000 0x00 0x1000>;
		clocks = <0x25 0x0a 0x44 0x01>;
		clock-names = "mtcmos-vcodec", "venc-larb1";
		linux,phandle = <0x21>;
		phandle = <0x21>;
	};

	venc@17020000 {
		compatible = "mediatek,venc";
		reg = <0x00 0x17020000 0x00 0x10000>;
		interrupts = <0x00 0xe6 0x08>;
	};

	venc_jpg@17030000 {
		compatible = "mediatek,venc_jpg";
		reg = <0x00 0x17030000 0x00 0x10000>;
		interrupts = <0x00 0xe8 0x08>;
		clocks = <0x44 0x02>;
		clock-names = "MT_CG_VENC_JPGENC";
	};

	vdec@17040000 {
		compatible = "mediatek,vdec";
		reg = <0x00 0x17040000 0x00 0x10000>;
		interrupts = <0x00 0xe9 0x08>;
	};

	mbist@17050000 {
		compatible = "mediatek,mbist";
		reg = <0x00 0x17050000 0x00 0x10000>;
	};

	camsys@1a000000 {
		compatible = "mediatek,camsys", "mediatek,mt6765-camsys", "syscon";
		reg = <0x00 0x1a000000 0x00 0x1000>;
		#clock-cells = <0x01>;
		linux,phandle = <0x43>;
		phandle = <0x43>;
	};

	smi_larb3@1a002000 {
		cell-index = <0x03>;
		compatible = "mediatek,smi_larb3", "mediatek,smi_larb";
		mediatek,smi-id = <0x03>;
		reg = <0x00 0x1a002000 0x00 0x1000>;
		clocks = <0x25 0x09 0x26 0x19 0x43 0x00>;
		clock-names = "mtcmos-cam", "gals-cam2mm", "cam-larb3";
		linux,phandle = <0x23>;
		phandle = <0x23>;
	};

	cam1@1a003000 {
		compatible = "mediatek,cam1";
		reg = <0x00 0x1a003000 0x00 0x1000>;
		interrupts = <0x00 0xeb 0x08>;
	};

	cam2@1a004000 {
		compatible = "mediatek,cam2";
		reg = <0x00 0x1a004000 0x00 0x1000>;
		interrupts = <0x00 0xec 0x08>;
	};

	cam3@1a005000 {
		compatible = "mediatek,cam3";
		reg = <0x00 0x1a005000 0x00 0x1000>;
		interrupts = <0x00 0xed 0x08>;
	};

	cam_set@1a00b000 {
		compatible = "mediatek,cam_set";
		reg = <0x00 0x1a00b000 0x00 0x1000>;
	};

	cama_set@1a00c000 {
		compatible = "mediatek,cama_set";
		reg = <0x00 0x1a00c000 0x00 0x1000>;
	};

	camb_set@1a00d000 {
		compatible = "mediatek,camb_set";
		reg = <0x00 0x1a00d000 0x00 0x1000>;
	};

	cam_inner@1a013000 {
		compatible = "mediatek,cam_inner";
		reg = <0x00 0x1a013000 0x00 0x1000>;
	};

	cama_inner@1a014000 {
		compatible = "mediatek,cama_inner";
		reg = <0x00 0x1a014000 0x00 0x1000>;
	};

	camb_inner@1a015000 {
		compatible = "mediatek,camb_inner";
		reg = <0x00 0x1a015000 0x00 0x1000>;
	};

	cam_clear@1a01b000 {
		compatible = "mediatek,cam_clear";
		reg = <0x00 0x1a01b000 0x00 0x1000>;
	};

	cama_clear@1a01c000 {
		compatible = "mediatek,cama_clear";
		reg = <0x00 0x1a01c000 0x00 0x1000>;
	};

	camb_clear@1a01d000 {
		compatible = "mediatek,camb_clear";
		reg = <0x00 0x1a01d000 0x00 0x1000>;
	};

	cama_ext@1a024000 {
		compatible = "mediatek,cama_ext";
		reg = <0x00 0x1a024000 0x00 0x1000>;
	};

	camb_ext@1a025000 {
		compatible = "mediatek,camb_ext";
		reg = <0x00 0x1a025000 0x00 0x1000>;
	};

	seninf1@1a040000 {
		compatible = "mediatek,seninf1";
		reg = <0x00 0x1a040000 0x00 0x1000>;
	};

	seninf2@1a041000 {
		compatible = "mediatek,seninf2";
		reg = <0x00 0x1a041000 0x00 0x1000>;
	};

	seninf3@1a042000 {
		compatible = "mediatek,seninf3";
		reg = <0x00 0x1a042000 0x00 0x1000>;
	};

	seninf4@1a043000 {
		compatible = "mediatek,seninf4";
		reg = <0x00 0x1a043000 0x00 0x1000>;
	};

	kd_camera_hw1@1a040000 {
		cam0_enable_sensor = "cactus_ov13855_ofilm_mipi_raw cactus_s5k3l8_sunny_mipi_raw cereus_imx486_sunny_mipi_raw cereus_ov12a10_ofilm_mipi_raw";
		cam0_vcama-supply = <0x45>;
		cam0_vcamd-supply = <0x46>;
		cam0_vcamio-supply = <0x47>;
		cam1_enable_sensor = "cactus_hi556_sunny_mipi_raw cactus_s5k5e8yx_ofilm_mipi_raw cereus_s5k5e8yx_ofilm_mipi_raw cereus_s5k5e8yx_sunny_mipi_raw";
		cam1_vcama-supply = <0x45>;
		cam1_vcamd-supply = <0x46>;
		cam1_vcamio-supply = <0x47>;
		cam2_enable_sensor = "cereus_s5k5e8yxaux_ofilm_mipi_raw cereus_s5k5e8yxaux_sunny_mipi_raw";
		cam2_vcama-supply = <0x45>;
		cam2_vcamd-supply = <0x46>;
		cam2_vcamio-supply = <0x47>;
		compatible = "mediatek,camera_hw";
		reg = <0x00 0x1a040000 0x00 0x1000>;
		clocks = <0x1e 0x66 0x1e 0x67 0x1e 0x68 0x1e 0x69 0x1e 0x14 0x1e 0x13 0x1e 0x1d 0x1e 0x11 0x1e 0x1c 0x1e 0x12 0x1f 0x43 0x04 0x41 0x0e 0x41 0x12 0x48 0x00 0x49 0x00 0x4a 0x00 0x4b 0x00 0x4c 0x00 0x4d 0x00 0x1e 0x7d 0x1e 0x1a 0x25 0x09>;
		clock-names = "CLK_TOP_CAMTG_SEL", "CLK_TOP_CAMTG1_SEL", "CLK_TOP_CAMTG2_SEL", "CLK_TOP_CAMTG3_SEL", "CLK_MCLK_6M", "CLK_MCLK_12M", "CLK_MCLK_13M", "CLK_MCLK_48M", "CLK_MCLK_52M", "CLK_MCLK_24M", "CLK_MCLK_26M", "CLK_CAM_SENINF_CG", "CLK_MIPI_C0_26M_CG", "CLK_MIPI_C1_26M_CG", "CLK_MIPI_ANA_0A_CG", "CLK_MIPI_ANA_0B_CG", "CLK_MIPI_ANA_1A_CG", "CLK_MIPI_ANA_1B_CG", "CLK_MIPI_ANA_2A_CG", "CLK_MIPI_ANA_2B_CG", "CLK_TOP_CAMTM_SEL_CG", "CLK_TOP_CAMTM_208_CG", "CLK_SCP_SYS_CAM";
		linux,phandle = <0x99>;
		phandle = <0x99>;
	};

	camsv1@1a050000 {
		compatible = "mediatek,camsv1";
		reg = <0x00 0x1a050000 0x00 0x1000>;
		interrupts = <0x00 0xf3 0x08>;
	};

	camsv2@1a051000 {
		compatible = "mediatek,camsv2";
		reg = <0x00 0x1a051000 0x00 0x1000>;
		interrupts = <0x00 0xf4 0x08>;
	};

	camsv3@1a052000 {
		compatible = "mediatek,camsv3";
		reg = <0x00 0x1a052000 0x00 0x1000>;
		interrupts = <0x00 0xf1 0x08>;
	};

	camsv4@1a053000 {
		compatible = "mediatek,camsv4";
		reg = <0x00 0x1a053000 0x00 0x1000>;
		interrupts = <0x00 0xf2 0x08>;
	};

	flashlight_core {
		compatible = "mediatek,flashlight_core";
		linux,phandle = <0x9a>;
		phandle = <0x9a>;
	};

	flashlights_mt6370 {
		compatible = "mediatek,flashlights_mt6370";
		decouple = <0x01>;
		linux,phandle = <0x9b>;
		phandle = <0x9b>;

		channel@1 {
			type = <0x00>;
			ct = <0x00>;
			part = <0x00>;
		};

		channel@2 {
			type = <0x00>;
			ct = <0x01>;
			part = <0x00>;
		};
	};

	gps {
		compatible = "mediatek,gps";
	};

	ccu@1a0b0000 {
		compatible = "mediatek,ccu";
		reg = <0x00 0x1a0b1000 0x00 0x1000>;
		interrupts = <0x00 0xf6 0x08>;
		clocks = <0x43 0x08>;
		clock-names = "CCU_CLK_CAM_CCU";
	};

	mt_charger {
		compatible = "mediatek,mt-charger";
		linux,phandle = <0x9c>;
		phandle = <0x9c>;
	};

	lk_charger {
		compatible = "mediatek,lk_charger";
		enable_anime;
		enable_pe_plus;
		enable_pd20_reset;
		power_path_support;
		max_charger_voltage = <0x5b8d80>;
		fast_charge_voltage = <0x2dc6c0>;
		usb_charger_current = <0x7a120>;
		ac_charger_current = <0x10c8e0>;
		ac_charger_input_current = <0x10c8e0>;
		non_std_ac_charger_current = <0x10c8e0>;
		charging_host_charger_current = <0x10c8e0>;
		ta_ac_charger_current = <0x2dc6c0>;
		pd_charger_current = <0x7a120>;
		temp_t4_threshold = <0x37>;
		temp_t3_threshold = <0x2d>;
		temp_t1_threshold = <0x00>;
		linux,phandle = <0x9d>;
		phandle = <0x9d>;
	};

	charger {
		compatible = "mediatek,charger";
		algorithm_name = "SwitchCharging";
		enable_sw_jeita;
		enable_pe_plus;
		enable_pe_2;
		enable_pe_3;
		enable_pe_4;
		enable_type_c;
		power_path_support;
		enable_dynamic_mivr;
		disable_pd_dual;
		battery_cv = <0x432380>;
		max_charger_voltage = <0x5b8d80>;
		min_charger_voltage = <0x4630c0>;
		min_charger_voltage_1 = <0x432380>;
		min_charger_voltage_2 = <0x401640>;
		max_dmivr_charger_current = <0x155cc0>;
		usb_charger_current_suspend = <0x00>;
		usb_charger_current_unconfigured = <0x11170>;
		usb_charger_current_configured = <0x7a120>;
		usb_charger_current = <0x7a120>;
		ac_charger_current = <0x10c8e0>;
		ac_charger_input_current = <0x10c8e0>;
		non_std_ac_charger_current = <0x10c8e0>;
		charging_host_charger_current = <0x10c8e0>;
		apple_1_0a_charger_current = <0x9eb10>;
		apple_2_1a_charger_current = "", "\f5";
		ta_ac_charger_current = <0x2dc6c0>;
		jeita_temp_above_t4_cv = <0x3e8fa0>;
		jeita_temp_t3_to_t4_cv = <0x3e8fa0>;
		jeita_temp_t2_to_t3_cv = <0x432380>;
		jeita_temp_t1_to_t2_cv = <0x432380>;
		jeita_temp_t0_to_t1_cv = <0x432380>;
		jeita_temp_below_t0_cv = <0x432380>;
		temp_t4_thres = <0x37>;
		temp_t4_thres_minus_x_degree = <0x35>;
		temp_t3_thres = <0x2d>;
		temp_t3_thres_minus_x_degree = <0x2b>;
		temp_t2_thres = <0x0f>;
		temp_t2_thres_plus_x_degree = <0x11>;
		temp_t1_thres = <0x00>;
		temp_t1_thres_plus_x_degree = <0x02>;
		temp_t0_thres = <0x00>;
		temp_t0_thres_plus_x_degree = <0x00>;
		temp_neg_10_thres = <0x00>;
		enable_min_charge_temp;
		min_charge_temp = <0x00>;
		min_charge_temp_plus_x_degree = <0x02>;
		max_charge_temp = <0x37>;
		max_charge_temp_minus_x_degree = <0x35>;
		ta_12v_support;
		ta_9v_support;
		pe_ichg_level_threshold = <0xf4240>;
		ta_ac_12v_input_current = <0x30d400>;
		ta_ac_9v_input_current = <0x30d400>;
		ta_ac_7v_input_current = <0x30d400>;
		pe20_ichg_level_threshold = <0xf4240>;
		ta_start_battery_soc = <0x00>;
		ta_stop_battery_soc = <0x55>;
		high_temp_to_leave_pe40 = <0x2e>;
		high_temp_to_enter_pe40 = <0x27>;
		low_temp_to_leave_pe40 = <0x0a>;
		low_temp_to_enter_pe40 = <0x10>;
		pe40_single_charger_input_current = <0x2dc6c0>;
		pe40_single_charger_current = <0x2dc6c0>;
		pe40_dual_charger_input_current = <0x2dc6c0>;
		pe40_dual_charger_chg1_current = <0x1e8480>;
		pe40_dual_charger_chg2_current = <0x1e8480>;
		pe40_stop_battery_soc = <0x50>;
		pe40_r_cable_1a_lower = <0x229>;
		pe40_r_cable_2a_lower = <0x19f>;
		pe40_r_cable_3a_lower = <0x113>;
		chg1_ta_ac_charger_current = <0x16e360>;
		chg2_ta_ac_charger_current = <0x16e360>;
		slave_mivr_diff = <0x186a0>;
		dual_polling_ieoc = <0x6ddd0>;
		cable_imp_threshold = <0x2bb>;
		vbat_cable_imp_threshold = <0x3b8260>;
		bif_threshold1 = <0x40d990>;
		bif_threshold2 = <0x419ce0>;
		bif_cv_under_threshold2 = <0x43e6d0>;
		pd_vbus_low_bound = <0x4c4b40>;
		pd_vbus_upper_bound = <0x4c4b40>;
		pd_ichg_level_threshold = <0xf4240>;
		pd_stop_battery_soc = <0x50>;
		ibus_err = <0x0e>;
		vsys_watt = <0x4c4b40>;
		linux,phandle = <0x9e>;
		phandle = <0x9e>;
	};

	pd_adapter {
		compatible = "mediatek,pd_adapter";
		adapter_name = "pd_adapter";
		linux,phandle = <0x9f>;
		phandle = <0x9f>;
	};

	rt9465_slave_chr {
		compatible = "richtek,rt9465";
		status = "disabled";
		linux,phandle = <0xa0>;
		phandle = <0xa0>;
	};

	rt-pd-manager {
		compatible = "mediatek,rt-pd-manager";
	};

	mt6370_pmu_eint {
		linux,phandle = <0xa1>;
		phandle = <0xa1>;
	};

	mt6370_pd_eint {
		linux,phandle = <0xa2>;
		phandle = <0xa2>;
	};

	irtx_pwm {
		compatible = "mediatek,irtx-pwm";
		pwm_ch = <0x00>;
		pwm_data_invert = <0x00>;
		linux,phandle = <0xa3>;
		phandle = <0xa3>;
	};

	odm {
		compatible = "simple-bus";
		linux,phandle = <0xa4>;
		phandle = <0xa4>;
	};

	memory-ssmr-features {
		compatible = "mediatek,memory-ssmr-features";
		svp-size = <0x00 0x10000000>;
		iris-recognition-size = <0x00 0x10000000>;
		2d_fr-size = <0x00 0x8000000>;
		tui-size = <0x00 0x4000000>;
		wfd-size = <0x00 0x4000000>;
		prot-sharedmem-size = <0x00 0x8000000>;
		ta-elf-size = <0x00 0x1000000>;
		ta-stack-heap-size = <0x00 0x6000000>;
		sdsp-tee-sharedmem-size = <0x00 0x1000000>;
		sdsp-firmware-size = <0x00 0x1000000>;
		linux,phandle = <0xa5>;
		phandle = <0xa5>;
	};

	audio_snd_card {
		compatible = "mediatek,audio_snd_card";
	};

	mt_soc_deep_buffer_dl_pcm {
		compatible = "mediatek,mt_soc_pcm_deep_buffer_dl";
	};

	mt_soc_ul1_pcm {
		compatible = "mediatek,mt_soc_pcm_capture";
	};

	mt_soc_voice_md1 {
		compatible = "mediatek,mt_soc_pcm_voice_md1";
	};

	mt_soc_uldlloopback_pcm {
		compatible = "mediatek,mt_soc_pcm_uldlloopback";
	};

	mt_soc_i2s0_pcm {
		compatible = "mediatek,mt_soc_pcm_dl1_i2s0";
	};

	mt_soc_mrgrx_pcm {
		compatible = "mediatek,mt_soc_pcm_mrgrx";
	};

	mt_soc_mrgrx_awb_pcm {
		compatible = "mediatek,mt_soc_pcm_mrgrx_awb";
	};

	mt_soc_fm_i2s_pcm {
		compatible = "mediatek,mt_soc_pcm_fm_i2s";
	};

	mt_soc_fm_i2s_awb_pcm {
		compatible = "mediatek,mt_soc_pcm_fm_i2s_awb";
	};

	mt_soc_i2s0dl1_pcm {
		compatible = "mediatek,mt_soc_pcm_dl1_i2s0dl1";
	};

	mt_soc_dl1_awb_pcm {
		compatible = "mediatek,mt_soc_pcm_dl1_awb";
	};

	mt_soc_voice_md1_bt {
		compatible = "mediatek,mt_soc_pcm_voice_md1_bt";
	};

	mt_soc_voip_bt_out {
		compatible = "mediatek,mt_soc_pcm_dl1_bt";
	};

	mt_soc_voip_bt_in {
		compatible = "mediatek,mt_soc_pcm_bt_dai";
	};

	mt_soc_tdmrx_pcm {
		compatible = "mediatek,mt_soc_tdm_capture";
	};

	mt_soc_fm_mrgtx_pcm {
		compatible = "mediatek,mt_soc_pcm_fmtx";
	};

	mt_soc_ul2_pcm {
		compatible = "mediatek,mt_soc_pcm_capture2";
	};

	mt_soc_i2s0_awb_pcm {
		compatible = "mediatek,mt_soc_pcm_i2s0_awb";
	};

	mt_soc_voice_md2 {
		compatible = "mediatek,mt_soc_pcm_voice_md2";
	};

	mt_soc_pcm_dl1_scp_spk {
		compatible = "mediatek,mt_soc_pcm_dl1_scp_spk";
	};

	mt_soc_pcm_voice_scp {
		compatible = "mediatek,mt_soc_pcm_voice_scp";
	};

	mt_soc_routing_pcm {
		compatible = "mediatek,mt_soc_pcm_routing";
	};

	mt_soc_voice_md2_bt {
		compatible = "mediatek,mt_soc_pcm_voice_md2_bt";
	};

	mt_soc_hp_impedance_pcm {
		compatible = "mediatek,mt_soc_pcm_hp_impedance";
	};

	mt_soc_codec_name {
		compatible = "mediatek,mt_soc_codec_63xx";
		use_hp_depop_flow = <0x00>;
		use_ul_260k = <0x00>;
	};

	mt_soc_dummy_pcm {
		compatible = "mediatek,mt_soc_pcm_dummy";
	};

	mt_soc_codec_dummy_name {
		compatible = "mediatek,mt_soc_codec_dummy";
	};

	mt_soc_routing_dai_name {
		compatible = "mediatek,mt_soc_dai_routing";
	};

	mt_soc_dai_name {
		compatible = "mediatek,mt_soc_dai_stub";
	};

	mt_soc_dl2_pcm {
		compatible = "mediatek,mt_soc_pcm_dl2";
	};

	mt_soc_anc_pcm {
		compatible = "mediatek,mt_soc_pcm_anc";
	};

	mt_soc_pcm_voice_ultra {
		compatible = "mediatek,mt_soc_pcm_voice_ultra";
	};

	mt_soc_pcm_voice_usb {
		compatible = "mediatek,mt_soc_pcm_voice_usb";
	};

	mt_soc_pcm_voice_usb_echoref {
		compatible = "mediatek,mt_soc_pcm_voice_usb_echoref";
	};

	pmic_clock_buffer_ctrl {
		compatible = "mediatek,pmic_clock_buffer";
		mediatek,clkbuf-quantity = <0x07>;
		mediatek,clkbuf-config = <0x02 0x01 0x01 0x02 0x00 0x00 0x00>;
		mediatek,clkbuf-driving-current = <0x01 0x01 0x01 0x01 0x01 0x01 0x01>;
		linux,phandle = <0xa6>;
		phandle = <0xa6>;
	};

	i2c7 {
		linux,phandle = <0xa7>;
		phandle = <0xa7>;
	};

	i2c8 {
		linux,phandle = <0xa8>;
		phandle = <0xa8>;
	};

	i2c9 {
		linux,phandle = <0xa9>;
		phandle = <0xa9>;
	};

	smart_pa {
		linux,phandle = <0xaa>;
		phandle = <0xaa>;
	};

	md1_sim1_hot_plug_eint {
		linux,phandle = <0xab>;
		phandle = <0xab>;
	};

	md1_sim2_hot_plug_eint {
		linux,phandle = <0xac>;
		phandle = <0xac>;
	};

	pseudo_m4u {
		compatible = "mediatek,mt-pseudo_m4u";
		iommus = <0x4e 0x02>;
	};

	pseudo_m4u-larb0 {
		compatible = "mediatek,mt-pseudo_m4u-port";
		mediatek,larbid = <0x00>;
		iommus = <0x4e 0x00 0x4e 0x01 0x4e 0x02 0x4e 0x03 0x4e 0x04 0x4e 0x05 0x4e 0x06 0x4e 0x07>;
	};

	pseudo_m4u-larb1 {
		compatible = "mediatek,mt-pseudo_m4u-port";
		mediatek,larbid = <0x01>;
		iommus = <0x4e 0x20 0x4e 0x21>;
	};

	pseudo_m4u-larb2 {
		compatible = "mediatek,mt-pseudo_m4u-port";
		mediatek,larbid = <0x02>;
		iommus = <0x4e 0x40 0x4e 0x41>;
	};

	pseudo_m4u-larb3 {
		compatible = "mediatek,mt-pseudo_m4u-port";
		mediatek,larbid = <0x03>;
		iommus = <0x4e 0x60 0x4e 0x61>;
	};

	eas {
		eff_turn_point = <0x1d3>;
		tiny = <0x32>;
	};

	radio_md_cfg {
		compatible = "mediatek,radio_md_cfg";
		linux,phandle = <0xad>;
		phandle = <0xad>;
	};

	dynamic_options {
		compatible = "mediatek,dynamic_options";
		linux,phandle = <0xae>;
		phandle = <0xae>;
	};

	mt6370_pmu_dts {
		interrupt-controller;
		#interrupt-cells = <0x01>;
		mt6370,intr_gpio_num = <0x03>;
		mt6370,intr_gpio = <0x3c 0x03 0x00>;
		linux,phandle = <0xaf>;
		phandle = <0xaf>;

		core {
			compatible = "mediatek,mt6370_pmu_core";
			interrupt-names = "otp", "vdda_ovp", "vdda_uv";
			i2cstmr_rst_tmr = <0x00>;
			mrstb_en;
			mrstb_tmr = <0x03>;
			int_wdt = <0x00>;
			int_deg = <0x00>;
		};

		charger {
			compatible = "mediatek,mt6370_pmu_charger";
			interrupt-names = "chg_mivr", "chg_aiclmeasi", "attachi", "ovpctrl_uvp_d_evt", "chg_wdtmri", "chg_vbusov", "chg_tmri", "chg_treg", "dcdti";
			charger_name = "primary_chg";
			load_switch_name = "primary_load_switch";
			ichg = <0x1e8480>;
			aicr = <0x7a120>;
			mivr = <0x432380>;
			cv = <0x426030>;
			ieoc = <0x30d40>;
			safety_timer = <0x0c>;
			dc_wdt = "", "=\t";
			ircmp_resistor = <0x61a8>;
			ircmp_vclamp = <0x7d00>;
			enable_te;
			enable_wdt;
			lbp_hys_sel = <0x01>;
			lbp_dt = <0x01>;
		};

		mt6370_pmu_fled1 {
			compatible = "mediatek,mt6370_pmu_fled1";
			interrupt-names = "fled_lvf", "fled2_short", "fled1_short";
			fled_enable = <0x01>;
			torch_cur = <0x493e0>;
			strobe_cur = <0x124f80>;
			strobe_timeout = <0x960>;
		};

		mt6370_pmu_fled2 {
			compatible = "mediatek,mt6370_pmu_fled2";
			fled_enable = <0x01>;
			torch_cur = <0x30d40>;
			strobe_cur = <0xf4240>;
			strobe_timeout = <0x4b0>;
		};

		ldo {
			compatible = "mediatek,mt6370_pmu_ldo";
			interrupt-names = "ldo_oc";
			ldo_oms = <0x01>;
			ldo_vrc_lt = <0x01>;

			mt6370_ldo {
				regulator-name = "irtx_ldo";
				regulator-min-microvolt = <0x186a00>;
				regulator-max-microvolt = "", "=\t";
			};
		};

		rgbled {
			compatible = "mediatek,mt6370_pmu_rgbled";
			interrupt-names = "isink4_short", "isink3_short", "isink2_short", "isink1_short", "isink4_open", "isink3_open", "isink2_open", "isink1_open";
			mt,led_name = "mt6370_pmu_led1", "mt6370_pmu_led2", "mt6370_pmu_led3", "mt6370_pmu_led4";
			mt,led_default_trigger = "cc_mode", "cc_mode", "cc_mode", "none";
		};

		bled {
			compatible = "mediatek,mt6370_pmu_bled";
			interrupt-names = "bled_ocp";
			mt,bled_name = "mt6370_pmu_bled";
			mt,chan_en = <0x0f>;
			mt,map_linear;
			mt,bl_ovp_level = <0x03>;
			mt,bl_ocp_level = <0x02>;
			mt,use_pwm;
			mt,pwm_fsample = <0x02>;
			mt,pwm_deglitch = <0x01>;
			mt,pwm_hys_en = <0x01>;
			mt,pwm_hys = <0x01>;
			mt,pwm_avg_cycle = <0x00>;
			mt,bled_ramptime = <0x03>;
			mt,bled_flash_ramp = <0x01>;
			mt,max_bled_brightness = <0x2aa>;
			mt,bled_curr_scale = <0x00>;
			mt,pwm_lpf_coef = <0x00>;
		};

		dsv {
			compatible = "mediatek,mt6370_pmu_dsv";
			interrupt-names = "dsv_vneg_ocp", "dsv_vpos_ocp", "dsv_bst_ocp", "dsv_vneg_scp", "dsv_vpos_scp";
			db_ext_en = <0x00>;
			db_periodic_fix = <0x00>;
			db_single_pin = <0x00>;
			db_freq_pm = <0x00>;
			db_periodic_mode = <0x00>;
			db_startup = <0x00>;
			db_vneg_20ms = <0x01>;
			db_vneg_disc = <0x00>;
			db_vpos_20ms = <0x01>;
			db_vpos_disc = <0x00>;
			db_delay = <0x03>;
			db_vbst = <0x1838>;
			db_vpos_slew = <0x01>;
			db_vneg_slew = <0x01>;

			mt6370_dsvp {
				regulator-name = "dsv_pos";
				regulator-min-microvolt = "", "=\t";
				regulator-max-microvolt = <0x5b8d80>;
			};

			mt6370_dsvn {
				regulator-name = "dsv_neg";
				regulator-min-microvolt = "", "=\t";
				regulator-max-microvolt = <0x5b8d80>;
			};
		};
	};

	type_c_port0 {
		tcpc-dual,supported_modes = <0x00>;
		mt-tcpc,name = "type_c_port0";
		mt-tcpc,role_def = <0x04>;
		mt-tcpc,rp_level = <0x00>;
		mt-tcpc,vconn_supply = <0x01>;
		mt6370pd,intr_gpio = <0x3c 0x18 0x00>;
		mt6370pd,intr_gpio_num = <0x18>;
		linux,phandle = <0xb0>;
		phandle = <0xb0>;

		pd-data {
			pd,vid = <0x29cf>;
			pd,pid = <0x5081>;
			pd,source-cap-ext = <0x171129cf 0x00 0x102 0x00 0x00 0x2000000>;
			pd,mfrs = "RichtekTCPC";
			pd,charging_policy = <0x21>;
			pd,source-pdo-size = <0x01>;
			pd,source-pdo-data = <0x19032>;
			pd,sink-pdo-size = <0x02>;
			pd,sink-pdo-data = <0x190c8 0xc0761e3c>;
			pd,id-vdo-size = <0x03>;
			pd,id-vdo-data = <0xd10029cf 0x00 0x10000>;
			bat,nr = <0x01>;
			pd,country_nr = <0x00>;

			bat-info0 {
				bat,vid = <0x29cf>;
				bat,pid = <0x1711>;
				bat,mfrs = "bat1";
				bat,design_cap = <0xbb8>;
			};
		};

		dpm_caps {
			local_dr_power;
			local_dr_data;
			local_usb_comm;
			local_no_suspend;
			local_vconn_supply;
			attemp_enter_dp_mode;
			attemp_discover_cable;
			attemp_discover_id;
			pr_check = <0x00>;
			pr_check_gp_source;
			dr_check = <0x00>;
		};
	};

	__symbols__ {
		chosen = "/chosen";
		cpu0 = "/cpus/cpu@000";
		cpu1 = "/cpus/cpu@001";
		cpu2 = "/cpus/cpu@002";
		cpu3 = "/cpus/cpu@003";
		cpu4 = "/cpus/cpu@100";
		cpu5 = "/cpus/cpu@101";
		cpu6 = "/cpus/cpu@102";
		cpu7 = "/cpus/cpu@103";
		STANDBY = "/cpus/idle-states/standby";
		MCDI_CPU = "/cpus/idle-states/mcdi-cpu";
		MCDI_CLUSTER = "/cpus/idle-states/mcdi-cluster";
		SODI = "/cpus/idle-states/sodi";
		SODI3 = "/cpus/idle-states/sodi3";
		DPIDLE = "/cpus/idle-states/dpidle";
		SUSPEND = "/cpus/idle-states/suspend";
		reserved_memory = "/reserved-memory";
		cpu_dbgapb = "/cpu_dbgapb@0d410000";
		gic = "/interrupt-controller@0c000000";
		sysirq = "/intpol-controller@10200a80";
		infracfg_ao = "/infracfg_ao@10001000";
		scpsys = "/scpsys@10001000";
		topckgen = "/topckgen@10000000";
		syscfg_pctl_1 = "/syscfg_pctl_1@0x10002000";
		syscfg_pctl_2 = "/syscfg_pctl_2@0x10002200";
		syscfg_pctl_3 = "/syscfg_pctl_3@0x10002400";
		syscfg_pctl_4 = "/syscfg_pctl_4@0x10002600";
		syscfg_pctl_5 = "/syscfg_pctl_5@0x10002800";
		syscfg_pctl_6 = "/syscfg_pctl_6@0x10002a00";
		syscfg_pctl_7 = "/syscfg_pctl_7@0x10002c00";
		pericfg = "/pericfg@10003000";
		gpio_usage_mapping = "/gpio";
		gpio = "/gpio@10005000";
		syscfg_pctl_0 = "/syscfg_pctl_0@10005000";
		pio = "/pinctrl@1000b000";
		msdc0_pins_default = "/pinctrl@1000b000/msdc0@default";
		msdc0_pins_hs400 = "/pinctrl@1000b000/msdc0@hs400";
		msdc0_pins_hs200 = "/pinctrl@1000b000/msdc0@hs200";
		msdc0_register_setting_default = "/pinctrl@1000b000/msdc0@register_default";
		msdc1_pins_default = "/pinctrl@1000b000/msdc1@default";
		msdc1_pins_sdr104 = "/pinctrl@1000b000/msdc1@sdr104";
		msdc1_pins_sdr50 = "/pinctrl@1000b000/msdc1@sdr50";
		msdc1_pins_ddr50 = "/pinctrl@1000b000/msdc1@ddr50";
		msdc1_register_setting_default = "/pinctrl@1000b000/msdc1@register_default";
		msdc3_pins_default = "/pinctrl@1000b000/msdc3@default";
		msdc3_register_setting_default = "/pinctrl@1000b000/msdc3@register_default";
		clk26m = "/clocks/clk26m";
		clk32k = "/clocks/clk32k";
		apmixed = "/apmixed@1000c000";
		main_pmic = "/mt-pmic";
		pmic_auxadc = "/mt-pmic/mt635x-auxadc";
		mt_pmic_vs1_buck_reg = "/mt-pmic/buck_regulators/buck_vs1";
		mt_pmic_vmodem_buck_reg = "/mt-pmic/buck_regulators/buck_vmodem";
		mt_pmic_vcore_buck_reg = "/mt-pmic/buck_regulators/buck_vcore";
		mt_pmic_vproc_buck_reg = "/mt-pmic/buck_regulators/buck_vproc";
		mt_pmic_vpa_buck_reg = "/mt-pmic/buck_regulators/buck_vpa";
		mt_pmic_vfe28_ldo_reg = "/mt-pmic/ldo_regulators/ldo_vfe28";
		mt_pmic_vxo22_ldo_reg = "/mt-pmic/ldo_regulators/ldo_vxo22";
		mt_pmic_vrf18_ldo_reg = "/mt-pmic/ldo_regulators/ldo_vrf18";
		mt_pmic_vrf12_ldo_reg = "/mt-pmic/ldo_regulators/ldo_vrf12";
		mt_pmic_vefuse_ldo_reg = "/mt-pmic/ldo_regulators/ldo_vefuse";
		mt_pmic_vcn33_bt_ldo_reg = "/mt-pmic/ldo_regulators/ldo_vcn33_bt";
		mt_pmic_vcn33_wifi_ldo_reg = "/mt-pmic/ldo_regulators/ldo_vcn33_wifi";
		mt_pmic_vcn28_ldo_reg = "/mt-pmic/ldo_regulators/ldo_vcn28";
		mt_pmic_vcn18_ldo_reg = "/mt-pmic/ldo_regulators/ldo_vcn18";
		mt_pmic_vcama_ldo_reg = "/mt-pmic/ldo_regulators/ldo_vcama";
		mt_pmic_vcamd_ldo_reg = "/mt-pmic/ldo_regulators/ldo_vcamd";
		mt_pmic_vcamio_ldo_reg = "/mt-pmic/ldo_regulators/ldo_vcamio";
		mt_pmic_vldo28_ldo_reg = "/mt-pmic/ldo_regulators/ldo_vldo28";
		mt_pmic_vsram_others_ldo_reg = "/mt-pmic/ldo_regulators/ldo_vsram_others";
		mt_pmic_vsram_proc_ldo_reg = "/mt-pmic/ldo_regulators/ldo_vsram_proc";
		mt_pmic_vaux18_ldo_reg = "/mt-pmic/ldo_regulators/ldo_vaux18";
		mt_pmic_vaud28_ldo_reg = "/mt-pmic/ldo_regulators/ldo_vaud28";
		mt_pmic_vio28_ldo_reg = "/mt-pmic/ldo_regulators/ldo_vio28";
		mt_pmic_vio18_ldo_reg = "/mt-pmic/ldo_regulators/ldo_vio18";
		mt_pmic_vdram_ldo_reg = "/mt-pmic/ldo_regulators/ldo_vdram";
		mt_pmic_vmc_ldo_reg = "/mt-pmic/ldo_regulators/ldo_vmc";
		mt_pmic_vmch_ldo_reg = "/mt-pmic/ldo_regulators/ldo_vmch";
		mt_pmic_vemc_ldo_reg = "/mt-pmic/ldo_regulators/ldo_vemc";
		mt_pmic_vsim1_ldo_reg = "/mt-pmic/ldo_regulators/ldo_vsim1";
		mt_pmic_vsim2_ldo_reg = "/mt-pmic/ldo_regulators/ldo_vsim2";
		mt_pmic_vibr_ldo_reg = "/mt-pmic/ldo_regulators/ldo_vibr";
		mt_pmic_vusb33_ldo_reg = "/mt-pmic/ldo_regulators/ldo_vusb33";
		keypad = "/kp@10010000";
		otg_iddig = "/otg_iddig";
		mrdump_ext_rst = "/mrdump_ext_rst";
		touch = "/touch";
		accdet = "/accdet";
		goodix_fp = "/fingerprint";
		bat_gm30 = "/battery";
		iommu = "/m4u@10205000";
		mdcldma = "/mdcldma@10014000";
		gce = "/gce@10238000";
		gce_mbox = "/gce_mbox@10238000";
		gce_mbox_svp = "/gce_mbox_svp@10238000";
		auxadc = "/auxadc@11001000";
		apdma = "/dma-controller@11000580";
		uart0 = "/serial@11020000";
		uart1 = "/serial@11030000";
		i2c_common = "/i2c_common";
		i2c0 = "/i2c0@11007000";
		i2c1 = "/i2c1@11008000";
		i2c2 = "/i2c2@11009000";
		i2c3 = "/i2c3@1100f000";
		i2c4 = "/i2c4@11011000";
		i2c5 = "/i2c5@11016000";
		i2c6 = "/i2c6@1100d000";
		pwm = "/pwm@11006000";
		spi0 = "/spi@1100a000";
		consys = "/consys@18002000";
		spi1 = "/spi@11010000";
		spi2 = "/spi@11012000";
		spi3 = "/spi@11013000";
		spi4 = "/spi@11014000";
		spi5 = "/spi@11015000";
		msdc0 = "/msdc@11230000";
		msdc1 = "/msdc@11240000";
		msdc2 = "/msdc@11250000";
		msdc3 = "/msdc@11260000";
		msdc1_ins = "/msdc1_ins@0";
		audio = "/audio@11220000";
		audgpio = "/mt_soc_dl1_pcm@11220000";
		btcvsd_snd = "/mtk-btcvsd-snd@18050000";
		mipi_rx_ana_csi0a = "/mipi_rx_ana_csi0a@11c10000";
		mipi_rx_ana_csi0b = "/mipi_rx_ana_csi0b@11c11000";
		mipi_rx_ana_csi1a = "/mipi_rx_ana_csi1a@11c12000";
		mipi_rx_ana_csi1b = "/mipi_rx_ana_csi1b@11c13000";
		mipi_rx_ana_csi2a = "/mipi_rx_ana_csi2a@11c14000";
		mipi_rx_ana_csi2b = "/mipi_rx_ana_csi2b@11c15000";
		mfg_cfg = "/mfg_cfg@13ffe000";
		mmsys_config = "/mmsys_config@14000000";
		nfc = "/nfc";
		irq_nfc = "/irq_nfc";
		disp_mutex0 = "/disp_mutex0@14001000";
		imgsys = "/imgsys@15020000";
		smi_larb0 = "/smi_larb0@14003000";
		mdp_rdma0 = "/mdp_rdma0@14004000";
		mdp_ccorr = "/mdp_ccorr0@14005000";
		mdp_rsz0 = "/mdp_rsz0@14006000";
		mdp_rsz1 = "/mdp_rsz1@14007000";
		mdp_wdma0 = "/mdp_wdma0@14008000";
		mdp_wrot0 = "/mdp_wrot0@14009000";
		mdp_tdshp0 = "/mdp_tdshp0@1400a000";
		disp_color0 = "/disp_color0@1400f000";
		mtkfb = "/mtkfb@0";
		swtp = "/swtp";
		dsi_te = "/dsi_te";
		smi_larb2 = "/smi_larb2@15021000";
		venc_gcon = "/venc_gcon@17000000";
		smi_larb1 = "/smi_larb1@17010000";
		camsys = "/camsys@1a000000";
		smi_larb3 = "/smi_larb3@1a002000";
		kd_camera_hw1 = "/kd_camera_hw1@1a040000";
		flashlight_core = "/flashlight_core";
		flashlights_mt6370 = "/flashlights_mt6370";
		mt_charger = "/mt_charger";
		lk_charger = "/lk_charger";
		charger = "/charger";
		pd_adapter = "/pd_adapter";
		rt9465_slave_chr = "/rt9465_slave_chr";
		subpmic_pmu_eint = "/mt6370_pmu_eint";
		tcpc_pd = "/mt6370_pd_eint";
		irtx_pwm = "/irtx_pwm";
		odm = "/odm";
		memory_ssmr_features = "/memory-ssmr-features";
		pmic_clock_buffer_ctrl = "/pmic_clock_buffer_ctrl";
		i2c7 = "/i2c7";
		i2c8 = "/i2c8";
		i2c9 = "/i2c9";
		smart_pa = "/smart_pa";
		md1_sim1_hot_plug_eint = "/md1_sim1_hot_plug_eint";
		md1_sim2_hot_plug_eint = "/md1_sim2_hot_plug_eint";
		radio_md_cfg = "/radio_md_cfg";
		dynamic_options = "/dynamic_options";
		mt6370_pmu = "/mt6370_pmu_dts";
		mt6370_typec = "/type_c_port0";
	};
};
